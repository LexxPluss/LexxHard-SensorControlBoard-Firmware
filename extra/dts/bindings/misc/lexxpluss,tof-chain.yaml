## extra/dts/bindings/misc/lexxpluss,tof-chain.yaml
```yaml
# Copyright (c) 2026, LexxPluss Inc.
# SPDX-License-Identifier: BSD-2-Clause

description: |
  Control lines and timing for the daisy-chained ToF enable chain
  (distributed D flip-flop, one per carrier board, shared clock).

compatible: "lexxpluss,tof-chain"

include: base.yaml

properties:
  data-gpios:
    type: phandle-array
    required: true
    description: Enable data line; also chain position 1's enable directly.

  clock-gpios:
    type: phandle-array
    required: true
    description: Shared flip-flop clock propagating the enable pattern.

  data-settle-ms:
    type: int
    required: true
    description: |
      Wait after changing the data line level before the next clock edge.
      DS20001 provisional value; the line settles over seconds at the
      register end. Final value pending hardware documentation (Request B).

  sensor-boot-ms:
    type: int
    required: true
    description: |
      Wait after a position's enable rises before probing it. DS20001
      provisional value.

  cycle-period-ms:
    type: int
    required: true
    description: |
      Acquisition cycle period. UNRESOLVED in the cliff wire contract: there is
      no approved value yet, which is exactly why it is required here instead of
      defaulted in firmware. A provisional number in an overlay is visible in a
      diff and belongs to whoever owns the deployment; the same number inside a
      scheduler becomes the specification by being the only one anybody can find.

  health-period-ms:
    type: int
    required: true
    description: |
      Health frame period, on its own timer and independent of the acquisition
      path. Also unresolved in the contract; required for the same reason.

  stop-join-timeout-ms:
    type: int
    required: true
    description: |
      How long a caller waits for the acquisition thread to finish its cycle
      and exit before giving up. On a timeout commissioning refuses to run and
      nothing is killed, so this value decides how patient that refusal is --
      a deployment decision, not a scheduler's, which is why it is required
      here and has no firmware default. It must exceed one cycle period plus
      the worst-case blocking time of a single sensor read.

  acq-stack-size:
    type: int
    required: true
    description: |
      Stack for the acquisition thread. It calls into the vendor ULD, whose
      depth is not ours to predict, so the value is provisional until a
      watermark has been measured on hardware -- and required, so that the
      provisional number is one somebody wrote down.

  acq-thread-priority:
    type: int
    required: true
    description: |
      Zephyr priority for the acquisition thread. Every value is legal,
      including 0, so nothing can range-check this; being required is the only
      guarantee that it was chosen rather than inherited.

  cliff-timing-budget-us:
    type: int
    required: true
    description: |
      VL53L4CX measurement timing budget for the four cliff sensors.

      Required, and this is a BEHAVIOUR CHANGE rather than a value being
      written down: until the acquisition layer could inject one, configure()
      was a no-op that reported success and the parts ran on whatever
      VL53LX_DataInit had left them, which is 33333 at MEDIUM.

      15000 is the value the E3 rate experiment ran at, and the per-corner
      rate recorded for that experiment belongs to it. That rate is a
      historical measurement on a different image; it is not a property of
      this one and not a guarantee.

      A shorter budget buys rate and the ranging performance at it cannot be
      inferred from the rate it allows: maximum distance, ambient-light
      behaviour and error rate over the installed harness have to be measured
      on the robot, and have not been at this value.

  cliff-distance-mode:
    type: int
    required: true
    description: |
      VL53LX_DISTANCEMODE_* for the four cliff sensors. Only 2 (MEDIUM) and
      3 (LONG) are accepted; 2 is what DataInit leaves.

      1 (SHORT) is defined by the enumeration but is refused for an L4 part by
      the ULD itself -- VL53LX_SetDistanceMode returns INVALID_PARAMS when
      IsL4(Dev) -- so it is rejected at bootstrap and again at acquisition
      init() rather than allowed to fail at bring-up on every sensor with the
      reason buried in a vendor error code.

      The ULD's own numbering rather than a private enumeration, because a
      mapping onto three integers is only a chance to get it wrong.
```

## lexxpluss_apps/tests/auto_charge/testcase.yaml
```yaml
tests:
  power_control.auto_charge.standard:
    platform_allow: native_sim
    tags: auto_charge
    timeout: 300
  power_control.auto_charge.push:
    platform_allow: native_sim
    tags: auto_charge
    timeout: 300
    extra_args: ENABLE_PUSH_MODE=1
```

## lexxpluss_apps/tests/gpio_fault_detector/testcase.yaml
```yaml
tests:
  gpio_fault_detector.emul:
    platform_allow: native_sim
    tags: motor_driver
```

## lexxpluss_apps/tests/lcs_diag/testcase.yaml
```yaml
tests:
  lcs_diag.host:
    platform_allow: native_sim
    tags: lcs
  lcs_diag.host.names:
    platform_allow: native_sim
    tags: lcs
    extra_args: ENABLE_LCS_DIAG_NAMES=1
```

## lexxpluss_apps/tests/motor_driver/testcase.yaml
```yaml
tests:
  motor_driver.calc:
    platform_allow: native_sim
    tags: motor_driver
```

## lexxpluss_apps/tests/runtime_progress/testcase.yaml
```yaml
common:
  platform_allow: native_sim
  tags: tof watchdog
tests:
  runtime.progress: {}
```

## lexxpluss_apps/tests/tof_commission_bind_session/testcase.yaml
```yaml
tests:
  tof.commission_bind_session:
    platform_allow: native_sim
    tags: tof
```

## lexxpluss_apps/tests/tof_commission_entropy_poll/testcase.yaml
```yaml
tests:
  tof.commission_entropy_poll:
    platform_allow: native_sim
    tags: tof
```
