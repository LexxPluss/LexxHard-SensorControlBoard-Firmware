## west.yml
```
# Copyright (c) 2022-2024, LexxPluss Inc.
# All rights reserved.
#
# Redistribution and use in source and binary forms, with or without
# modification, are permitted provided that the following conditions are met:
#
# 1. Redistributions of source code must retain the above copyright notice,
#    this list of conditions and the following disclaimer.
# 2. Redistributions in binary form must reproduce the above copyright notice,
#    this list of conditions and the following disclaimer in the documentation
#    and/or other materials provided with the distribution.
#
# THIS SOFTWARE IS PROVIDED BY THE COPYRIGHT HOLDERS AND CONTRIBUTORS "AS IS" AND
# ANY EXPRESS OR IMPLIED WARRANTIES, INCLUDING, BUT NOT LIMITED TO, THE IMPLIED
# WARRANTIES OF MERCHANTABILITY AND FITNESS FOR A PARTICULAR PURPOSE ARE
# DISCLAIMED. IN NO EVENT SHALL THE COPYRIGHT OWNER OR CONTRIBUTORS BE LIABLE FOR
# ANY DIRECT, INDIRECT, INCIDENTAL, SPECIAL, EXEMPLARY, OR CONSEQUENTIAL DAMAGES
# (INCLUDING, BUT NOT LIMITED TO, PROCUREMENT OF SUBSTITUTE GOODS OR SERVICES;
# LOSS OF USE, DATA, OR PROFITS; OR BUSINESS INTERRUPTION) HOWEVER CAUSED AND
# ON ANY THEORY OF LIABILITY, WHETHER IN CONTRACT, STRICT LIABILITY, OR TORT
# (INCLUDING NEGLIGENCE OR OTHERWISE) ARISING IN ANY WAY OUT OF THE USE OF THIS
# SOFTWARE, EVEN IF ADVISED OF THE POSSIBILITY OF SUCH DAMAGE.

manifest:
  projects:
    - name: zephyr
      url: https://github.com/zephyrproject-rtos/zephyr.git
      revision: refs/tags/v3.6.0
      import: true
  self:
    path: lexxpluss_apps
```

## prj.conf
```kconfig
# Copyright (c) 2022-2024, LexxPluss Inc.
# All rights reserved.
#
# Redistribution and use in source and binary forms, with or without
# modification, are permitted provided that the following conditions are met:
#
# 1. Redistributions of source code must retain the above copyright notice,
#    this list of conditions and the following disclaimer.
# 2. Redistributions in binary form must reproduce the above copyright notice,
#    this list of conditions and the following disclaimer in the documentation
#    and/or other materials provided with the distribution.
#
# THIS SOFTWARE IS PROVIDED BY THE COPYRIGHT HOLDERS AND CONTRIBUTORS "AS IS" AND
# ANY EXPRESS OR IMPLIED WARRANTIES, INCLUDING, BUT NOT LIMITED TO, THE IMPLIED
# WARRANTIES OF MERCHANTABILITY AND FITNESS FOR A PARTICULAR PURPOSE ARE
# DISCLAIMED. IN NO EVENT SHALL THE COPYRIGHT OWNER OR CONTRIBUTORS BE LIABLE FOR
# ANY DIRECT, INDIRECT, INCIDENTAL, SPECIAL, EXEMPLARY, OR CONSEQUENTIAL DAMAGES
# (INCLUDING, BUT NOT LIMITED TO, PROCUREMENT OF SUBSTITUTE GOODS OR SERVICES;
# LOSS OF USE, DATA, OR PROFITS; OR BUSINESS INTERRUPTION) HOWEVER CAUSED AND
# ON ANY THEORY OF LIABILITY, WHETHER IN CONTRACT, STRICT LIABILITY, OR TORT
# (INCLUDING NEGLIGENCE OR OTHERWISE) ARISING IN ANY WAY OUT OF THE USE OF THIS
# SOFTWARE, EVEN IF ADVISED OF THE POSSIBILITY OF SUCH DAMAGE.

CONFIG_SHELL=y
# Shell conveniences off to save flash (about 6 KB); the commands themselves stay.
CONFIG_SHELL_HISTORY=n
CONFIG_SHELL_TAB=n
CONFIG_SHELL_TAB_AUTOCOMPLETION=n
CONFIG_SHELL_WILDCARD=n
CONFIG_SHELL_VT100_COLORS=n
CONFIG_SHELL_STATS=n
CONFIG_SHELL_CMDS_RESIZE=n
# Five more conveniences off: measured after the LCS host (#134), the ToF Package image does not
# link with only the seven above. Help text, `device list`, the built-in shell commands and
# metakey/VT100 handling go; kernel reboot, devmem and the app-registered commands stay.
CONFIG_SHELL_HELP=n
CONFIG_DEVICE_SHELL=n
CONFIG_SHELL_CMDS=n
CONFIG_SHELL_METAKEYS=n
CONFIG_SHELL_VT100_COMMANDS=n
CONFIG_FPU=y
CONFIG_NEWLIB_LIBC=y
CONFIG_NEWLIB_LIBC_FLOAT_PRINTF=y
CONFIG_CPP=y
CONFIG_STD_CPP20=y
CONFIG_GLIBCXX_LIBCPP=y
CONFIG_CPP_RTTI=y
CONFIG_RING_BUFFER=y
CONFIG_PRINTK=y
CONFIG_DISK_ACCESS=y
CONFIG_DISK_DRIVER_SDMMC=y
CONFIG_FILE_SYSTEM=y
CONFIG_FAT_FILESYSTEM_ELM=y
CONFIG_FS_FATFS_LFN=y
CONFIG_HEAP_MEM_POOL_SIZE=32768
CONFIG_FILE_SYSTEM_SHELL=y
CONFIG_BOOTLOADER_MCUBOOT=y
CONFIG_MCUBOOT_SIGNATURE_KEY_FILE="bootloader/mcuboot/root-rsa-2048.pem"
CONFIG_MCUBOOT_GENERATE_CONFIRMED_IMAGE=y
CONFIG_FLASH=y
CONFIG_FLASH_MAP=y
CONFIG_REBOOT=y
CONFIG_WDT_LOG_LEVEL_DBG=y
CONFIG_WATCHDOG=y
CONFIG_WDT_DISABLE_AT_BOOT=n
CONFIG_MAXBOTIX=y
CONFIG_ADIS16470=n
CONFIG_IIM42652=y
CONFIG_I2C=y

# THE RESET CAUSE, so a watchdog reset with no retained record can be told from a clean boot.
#
# "No retained watchdog record" reads identically on a board that has never tripped and on one that
# tripped and lost its record -- the case the DTCM reservation exists to prevent and cannot prove it
# prevented. The hardware's own reset cause distinguishes them, and it is the one source that does
# not depend on anything this subsystem wrote.
#
# Reported and never acted on: see report_reset_cause() in src/tof_watchdog_feeder.cpp. A reset
# cause that drove behaviour would be a second, weaker copy of the record.
CONFIG_HWINFO=y
```

## src/main.cpp
```c
/*
 * Copyright (c) 2022, LexxPluss Inc.
 * All rights reserved.
 *
 * Redistribution and use in source and binary forms, with or without
 * modification, are permitted provided that the following conditions are met:
 *
 * 1. Redistributions of source code must retain the above copyright notice,
 *    this list of conditions and the following disclaimer.
 * 2. Redistributions in binary form must reproduce the above copyright notice,
 *    this list of conditions and the following disclaimer in the documentation
 *    and/or other materials provided with the distribution.
 *
 * THIS SOFTWARE IS PROVIDED BY THE COPYRIGHT HOLDERS AND CONTRIBUTORS "AS IS" AND
 * ANY EXPRESS OR IMPLIED WARRANTIES, INCLUDING, BUT NOT LIMITED TO, THE IMPLIED
 * WARRANTIES OF MERCHANTABILITY AND FITNESS FOR A PARTICULAR PURPOSE ARE
 * DISCLAIMED. IN NO EVENT SHALL THE COPYRIGHT OWNER OR CONTRIBUTORS BE LIABLE FOR
 * ANY DIRECT, INDIRECT, INCIDENTAL, SPECIAL, EXEMPLARY, OR CONSEQUENTIAL DAMAGES
 * (INCLUDING, BUT NOT LIMITED TO, PROCUREMENT OF SUBSTITUTE GOODS OR SERVICES;
 * LOSS OF USE, DATA, OR PROFITS; OR BUSINESS INTERRUPTION) HOWEVER CAUSED AND
 * ON ANY THEORY OF LIABILITY, WHETHER IN CONTRACT, STRICT LIABILITY, OR TORT
 * (INCLUDING NEGLIGENCE OR OTHERWISE) ARISING IN ANY WAY OUT OF THE USE OF THIS
 * SOFTWARE, EVEN IF ADVISED OF THE POSSIBILITY OF SUCH DAMAGE.
 */

#include <zephyr/kernel.h>
#include <zephyr/drivers/gpio.h>
#include "actuator_controller.hpp"
#include "actuator_service_controller.hpp"
#include "adc_reader.hpp"
#include "board_controller.hpp"
#include "can_controller.hpp"
#include "bmu_controller.hpp"
#include "firmware_updater.hpp"
#include "imu_controller.hpp"
#ifdef ENABLE_LED_STRIP
#include "led_controller.hpp"
#endif
#ifdef ENABLE_PGV
#include "pgv_controller.hpp"
#endif
#ifdef ENABLE_LCS
#include "lcs_controller.hpp"
#endif
#include "zcan_main.hpp"
#include "runaway_detector.hpp"
#include "uss_controller.hpp"
#include "gpio_controller.hpp"
#include "shutter_limit_switch.hpp"
#include "shutter_motor_controller.hpp"
#include "tug_encoder_controller.hpp"
#ifdef ENABLE_TOF_CHAIN
#include <zephyr/dfu/mcuboot.h>
#include "tof_chain_controller.hpp"
#endif
#if defined(ENABLE_TOF_PACKAGE_BENCH) || defined(ENABLE_TOF_PACKAGE_AUTO_DEADMAN)
#include "tof_package_bench_deadman.hpp"
#endif
#ifdef ENABLE_TOF_PACKAGE_AUTO
#include "tof_package_runtime.hpp"
#endif

namespace {

K_THREAD_STACK_DEFINE(actuator_controller_stack, 2048);
K_THREAD_STACK_DEFINE(actuator_service_controller_stack, 2048);
K_THREAD_STACK_DEFINE(adc_reader_stack, 2048);
K_THREAD_STACK_DEFINE(bmu_controller_stack, 2048);
K_THREAD_STACK_DEFINE(board_controller_stack, 2048);
K_THREAD_STACK_DEFINE(can_controller_stack, 2048);
K_THREAD_STACK_DEFINE(firmware_updater_stack, 2048);
K_THREAD_STACK_DEFINE(imu_controller_stack, 2048);
#ifdef ENABLE_LED_STRIP
K_THREAD_STACK_DEFINE(led_controller_stack, 2048);
#endif
#ifdef ENABLE_PGV
K_THREAD_STACK_DEFINE(pgv_controller_stack, 2048);
#endif
#ifdef ENABLE_LCS
K_THREAD_STACK_DEFINE(lcs_controller_stack, 2048);
#endif
K_THREAD_STACK_DEFINE(runaway_detector_stack, 2048);
K_THREAD_STACK_DEFINE(uss_controller_stack, 2048);
K_THREAD_STACK_DEFINE(gpio_controller_stack, 2048);
K_THREAD_STACK_DEFINE(shutter_motor_controller_stack, 2048);
#ifndef ENABLE_TOF_CHAIN
K_THREAD_STACK_DEFINE(tug_encoder_controller_stack, 2048);
#endif
K_THREAD_STACK_DEFINE(zcan_main_stack, 2048);
#ifdef ENABLE_TOF_PACKAGE_AUTO
/* Reserve 4,096 B for the auto thread, using its own ELF call graph.
 * Static frame sums (including manually resolved hook/sink calls): blob
 * verification 928 B, firmware download 636 B, publishing about 208 B.
 * Allow up to 104 B for an FPU exception frame (~1,032 B total on the deepest
 * measured path). Keep margin for missed indirect edges; this is not a
 * measured runtime stack-watermark bound. Recheck after call-graph changes.
 */
K_THREAD_STACK_DEFINE(tof_package_runtime_stack, 4096);
#endif

#define RUN(name, prio) \
    k_thread_create(&lexxhard::name::thread, name##_stack, K_THREAD_STACK_SIZEOF(name##_stack), \
                    lexxhard::name::run, nullptr, nullptr, nullptr, prio, K_FP_REGS, K_MSEC(2000));
}

void init_gpio() {
    gpio_dt_spec gpio_dev;

    // Output
    gpio_dev = GPIO_DT_SPEC_GET(DT_NODELABEL(ps_led_out), gpios);
    if (gpio_is_ready_dt(&gpio_dev))
        gpio_pin_configure_dt(&gpio_dev, GPIO_OUTPUT_LOW | GPIO_ACTIVE_HIGH);
    gpio_dev = GPIO_DT_SPEC_GET(DT_NODELABEL(resume_led_out), gpios);
    if (gpio_is_ready_dt(&gpio_dev))
        gpio_pin_configure_dt(&gpio_dev, GPIO_OUTPUT_LOW | GPIO_ACTIVE_HIGH);
    gpio_dev = GPIO_DT_SPEC_GET(DT_NODELABEL(bp_reset), gpios);
    if (gpio_is_ready_dt(&gpio_dev))
        gpio_pin_configure_dt(&gpio_dev, GPIO_OUTPUT_LOW | GPIO_ACTIVE_HIGH);
    gpio_dev = GPIO_DT_SPEC_GET(DT_NODELABEL(v_autocharge), gpios);
    if (gpio_is_ready_dt(&gpio_dev))
        gpio_pin_configure_dt(&gpio_dev, GPIO_OUTPUT_LOW | GPIO_ACTIVE_HIGH);
    gpio_dev = GPIO_DT_SPEC_GET(DT_NODELABEL(v24), gpios);
    if (gpio_is_ready_dt(&gpio_dev))
        gpio_pin_configure_dt(&gpio_dev, GPIO_OUTPUT_HIGH | GPIO_ACTIVE_HIGH);
    gpio_dev = GPIO_DT_SPEC_GET(DT_NODELABEL(v_wheel), gpios);
    if (gpio_is_ready_dt(&gpio_dev))
        gpio_pin_configure_dt(&gpio_dev, GPIO_OUTPUT_LOW | GPIO_ACTIVE_HIGH);
    gpio_dev = GPIO_DT_SPEC_GET(DT_NODELABEL(v_peripheral), gpios);
    if (gpio_is_ready_dt(&gpio_dev))
        gpio_pin_configure_dt(&gpio_dev, GPIO_OUTPUT_LOW | GPIO_ACTIVE_HIGH);
    gpio_dev = GPIO_DT_SPEC_GET(DT_NODELABEL(wheel_en), gpios);
    if (gpio_is_ready_dt(&gpio_dev))
        gpio_pin_configure_dt(&gpio_dev, GPIO_OUTPUT_LOW | GPIO_ACTIVE_HIGH);
    gpio_dev = GPIO_DT_SPEC_GET(DT_NODELABEL(fan1), gpios);
    if (gpio_is_ready_dt(&gpio_dev))
        gpio_pin_configure_dt(&gpio_dev, GPIO_OUTPUT_LOW | GPIO_ACTIVE_HIGH);
    gpio_dev = GPIO_DT_SPEC_GET(DT_NODELABEL(fan2), gpios);
    if (gpio_is_ready_dt(&gpio_dev))
        gpio_pin_configure_dt(&gpio_dev, GPIO_OUTPUT_LOW | GPIO_ACTIVE_HIGH);
    gpio_dev = GPIO_DT_SPEC_GET(DT_NODELABEL(fan3), gpios);
    if (gpio_is_ready_dt(&gpio_dev))
        gpio_pin_configure_dt(&gpio_dev, GPIO_OUTPUT_LOW | GPIO_ACTIVE_HIGH);
    gpio_dev = GPIO_DT_SPEC_GET(DT_NODELABEL(fan4), gpios);
    if (gpio_is_ready_dt(&gpio_dev))
        gpio_pin_configure_dt(&gpio_dev, GPIO_OUTPUT_LOW | GPIO_ACTIVE_HIGH);
    gpio_dev = GPIO_DT_SPEC_GET(DT_NODELABEL(ps_lift_actuator), gpios);
    if (gpio_is_ready_dt(&gpio_dev))
        gpio_pin_configure_dt(&gpio_dev, GPIO_OUTPUT_LOW | GPIO_ACTIVE_HIGH);
    gpio_dev = GPIO_DT_SPEC_GET(DT_NODELABEL(ipc_power_sw_fp), gpios);
    if (gpio_is_ready_dt(&gpio_dev))
        gpio_pin_configure_dt(&gpio_dev, GPIO_OUTPUT_LOW | GPIO_ACTIVE_HIGH);
    gpio_dev = GPIO_DT_SPEC_GET(DT_NODELABEL(spare_gpio_6), gpios);
    if (gpio_is_ready_dt(&gpio_dev))
        gpio_pin_configure_dt(&gpio_dev, GPIO_OUTPUT_LOW | GPIO_ACTIVE_HIGH);
    gpio_dev = GPIO_DT_SPEC_GET(DT_NODELABEL(spare_gpio_7), gpios);
    if (gpio_is_ready_dt(&gpio_dev))
        gpio_pin_configure_dt(&gpio_dev, GPIO_OUTPUT_LOW | GPIO_ACTIVE_HIGH);
    gpio_dev = GPIO_DT_SPEC_GET(DT_NODELABEL(spare_gpio_8), gpios);
    if (gpio_is_ready_dt(&gpio_dev))
        gpio_pin_configure_dt(&gpio_dev, GPIO_OUTPUT_LOW | GPIO_ACTIVE_HIGH);
    gpio_dev = GPIO_DT_SPEC_GET(DT_NODELABEL(spare_gpio_9), gpios);
    if (gpio_is_ready_dt(&gpio_dev))
        gpio_pin_configure_dt(&gpio_dev, GPIO_OUTPUT_LOW | GPIO_ACTIVE_HIGH);
    gpio_dev = GPIO_DT_SPEC_GET(DT_NODELABEL(d_enc_ena), gpios);
    if (gpio_is_ready_dt(&gpio_dev))
        gpio_pin_configure_dt(&gpio_dev, GPIO_OUTPUT_LOW | GPIO_ACTIVE_HIGH);
    gpio_dev = GPIO_DT_SPEC_GET(DT_NODELABEL(eo_option_1), gpios);
    if (gpio_is_ready_dt(&gpio_dev))
        gpio_pin_configure_dt(&gpio_dev, GPIO_OUTPUT_LOW | GPIO_ACTIVE_HIGH);
    gpio_dev = GPIO_DT_SPEC_GET(DT_NODELABEL(eo_option_2), gpios);
    if (gpio_is_ready_dt(&gpio_dev))
        gpio_pin_configure_dt(&gpio_dev, GPIO_OUTPUT_LOW | GPIO_ACTIVE_HIGH);
    gpio_dev = GPIO_DT_SPEC_GET(DT_NODELABEL(comm_mode), gpios);
    if (gpio_is_ready_dt(&gpio_dev))
        gpio_pin_configure_dt(&gpio_dev, GPIO_OUTPUT_LOW | GPIO_ACTIVE_HIGH);
    // uss4 trig (PB5), unpopulated on Dasher: drive low, feeds level-shifter U8
    gpio_dev = GPIO_DT_SPEC_GET(DT_NODELABEL(uss4_trig_unused), gpios);
    if (gpio_is_ready_dt(&gpio_dev))
        gpio_pin_configure_dt(&gpio_dev, GPIO_OUTPUT_LOW | GPIO_ACTIVE_HIGH);

    // Input
    gpio_dev = GPIO_DT_SPEC_GET(DT_NODELABEL(ps_sw_in), gpios);
    if (gpio_is_ready_dt(&gpio_dev))
        gpio_pin_configure_dt(&gpio_dev, GPIO_INPUT | GPIO_ACTIVE_HIGH);
    gpio_dev = GPIO_DT_SPEC_GET(DT_NODELABEL(resume_sw_in), gpios);
    if (gpio_is_ready_dt(&gpio_dev))
        gpio_pin_configure_dt(&gpio_dev, GPIO_INPUT | GPIO_ACTIVE_HIGH);
    gpio_dev = GPIO_DT_SPEC_GET(DT_NODELABEL(bp_left), gpios);
    if (gpio_is_ready_dt(&gpio_dev))
        gpio_pin_configure_dt(&gpio_dev, GPIO_INPUT | GPIO_ACTIVE_HIGH);
    gpio_dev = GPIO_DT_SPEC_GET(DT_NODELABEL(es_left), gpios);
    if (gpio_is_ready_dt(&gpio_dev))
        gpio_pin_configure_dt(&gpio_dev, GPIO_INPUT | GPIO_ACTIVE_LOW);
    gpio_dev = GPIO_DT_SPEC_GET(DT_NODELABEL(es_right), gpios);
    if (gpio_is_ready_dt(&gpio_dev))
        gpio_pin_configure_dt(&gpio_dev, GPIO_INPUT | GPIO_ACTIVE_LOW);
    gpio_dev = GPIO_DT_SPEC_GET(DT_NODELABEL(es_option_1), gpios);
    if (gpio_is_ready_dt(&gpio_dev))
        gpio_pin_configure_dt(&gpio_dev, GPIO_INPUT | GPIO_ACTIVE_LOW);
    gpio_dev = GPIO_DT_SPEC_GET(DT_NODELABEL(es_option_2), gpios);
    if (gpio_is_ready_dt(&gpio_dev))
        gpio_pin_configure_dt(&gpio_dev, GPIO_INPUT | GPIO_ACTIVE_LOW);
    gpio_dev = GPIO_DT_SPEC_GET(DT_NODELABEL(mc_din), gpios);
    if (gpio_is_ready_dt(&gpio_dev))
        gpio_pin_configure_dt(&gpio_dev, GPIO_INPUT | GPIO_ACTIVE_HIGH);
    gpio_dev = GPIO_DT_SPEC_GET(DT_NODELABEL(bmu_c_fet), gpios);
    if (gpio_is_ready_dt(&gpio_dev))
        gpio_pin_configure_dt(&gpio_dev, GPIO_INPUT | GPIO_ACTIVE_HIGH);
    gpio_dev = GPIO_DT_SPEC_GET(DT_NODELABEL(bmu_d_fet), gpios);
    if (gpio_is_ready_dt(&gpio_dev))
        gpio_pin_configure_dt(&gpio_dev, GPIO_INPUT | GPIO_ACTIVE_HIGH);
    gpio_dev = GPIO_DT_SPEC_GET(DT_NODELABEL(bmu_p_dsg), gpios);
    if (gpio_is_ready_dt(&gpio_dev))
        gpio_pin_configure_dt(&gpio_dev, GPIO_INPUT | GPIO_ACTIVE_HIGH);
    gpio_dev = GPIO_DT_SPEC_GET(DT_NODELABEL(pgood_24v), gpios);
    if (gpio_is_ready_dt(&gpio_dev))
        gpio_pin_configure_dt(&gpio_dev, GPIO_INPUT | GPIO_PULL_UP | GPIO_ACTIVE_HIGH);
    gpio_dev = GPIO_DT_SPEC_GET(DT_NODELABEL(pgood_peripheral), gpios);
    if (gpio_is_ready_dt(&gpio_dev))
        gpio_pin_configure_dt(&gpio_dev, GPIO_INPUT | GPIO_PULL_UP | GPIO_ACTIVE_HIGH);
    gpio_dev = GPIO_DT_SPEC_GET(DT_NODELABEL(pgood_wheel_motor_left), gpios);
    if (gpio_is_ready_dt(&gpio_dev))
        gpio_pin_configure_dt(&gpio_dev, GPIO_INPUT | GPIO_PULL_UP | GPIO_ACTIVE_HIGH);
    gpio_dev = GPIO_DT_SPEC_GET(DT_NODELABEL(pgood_wheel_motor_right), gpios);
    if (gpio_is_ready_dt(&gpio_dev))
        gpio_pin_configure_dt(&gpio_dev, GPIO_INPUT | GPIO_PULL_UP | GPIO_ACTIVE_HIGH);
    gpio_dev = GPIO_DT_SPEC_GET(DT_NODELABEL(spare_gpio_12), gpios);
    if (gpio_is_ready_dt(&gpio_dev))
        gpio_pin_configure_dt(&gpio_dev, GPIO_INPUT | GPIO_PULL_UP | GPIO_ACTIVE_HIGH);
    gpio_dev = GPIO_DT_SPEC_GET(DT_NODELABEL(spare_gpio_13), gpios);
    if (gpio_is_ready_dt(&gpio_dev))
        gpio_pin_configure_dt(&gpio_dev, GPIO_INPUT | GPIO_PULL_UP | GPIO_ACTIVE_HIGH);
    gpio_dev = GPIO_DT_SPEC_GET(DT_NODELABEL(safety_lidar_ossd1), gpios);
    if (gpio_is_ready_dt(&gpio_dev))
        gpio_pin_configure_dt(&gpio_dev, GPIO_INPUT | GPIO_ACTIVE_HIGH);
    gpio_dev = GPIO_DT_SPEC_GET(DT_NODELABEL(safety_lidar_ossd2), gpios);
    if (gpio_is_ready_dt(&gpio_dev))
        gpio_pin_configure_dt(&gpio_dev, GPIO_INPUT | GPIO_ACTIVE_HIGH);
    gpio_dev = GPIO_DT_SPEC_GET(DT_NODELABEL(safety_lidar_ossd3), gpios);
    if (gpio_is_ready_dt(&gpio_dev))
        gpio_pin_configure_dt(&gpio_dev, GPIO_INPUT | GPIO_ACTIVE_HIGH);
    gpio_dev = GPIO_DT_SPEC_GET(DT_NODELABEL(safety_lidar_ossd4), gpios);
    if (gpio_is_ready_dt(&gpio_dev))
        gpio_pin_configure_dt(&gpio_dev, GPIO_INPUT | GPIO_ACTIVE_HIGH);
    gpio_dev = GPIO_DT_SPEC_GET(DT_NODELABEL(safety_lidar_res_req1), gpios);
    if (gpio_is_ready_dt(&gpio_dev))
        gpio_pin_configure_dt(&gpio_dev, GPIO_INPUT | GPIO_ACTIVE_HIGH);
    gpio_dev = GPIO_DT_SPEC_GET(DT_NODELABEL(safety_lidar_res_req2), gpios);
    if (gpio_is_ready_dt(&gpio_dev))
        gpio_pin_configure_dt(&gpio_dev, GPIO_INPUT | GPIO_ACTIVE_HIGH);
    // uss4 echo (PC0), unpopulated on Dasher: no internal pull, R12 already provides an external pull-down
    gpio_dev = GPIO_DT_SPEC_GET(DT_NODELABEL(uss4_echo_unused), gpios);
    if (gpio_is_ready_dt(&gpio_dev))
        gpio_pin_configure_dt(&gpio_dev, GPIO_INPUT | GPIO_ACTIVE_HIGH);

    // LED
    gpio_dev = GPIO_DT_SPEC_GET(DT_NODELABEL(dbg_led1), gpios);
    if (gpio_is_ready_dt(&gpio_dev))
        gpio_pin_configure_dt(&gpio_dev, GPIO_OUTPUT_INACTIVE);
    gpio_dev = GPIO_DT_SPEC_GET(DT_NODELABEL(dbg_led2), gpios);
    if (gpio_is_ready_dt(&gpio_dev))
        gpio_pin_configure_dt(&gpio_dev, GPIO_OUTPUT_INACTIVE);
    gpio_dev = GPIO_DT_SPEC_GET(DT_NODELABEL(dbg_led3), gpios);
    if (gpio_is_ready_dt(&gpio_dev))
        gpio_pin_configure_dt(&gpio_dev, GPIO_OUTPUT_INACTIVE);
    gpio_dev = GPIO_DT_SPEC_GET(DT_NODELABEL(dbg_led4), gpios);
    if (gpio_is_ready_dt(&gpio_dev))
        gpio_pin_configure_dt(&gpio_dev, GPIO_OUTPUT_INACTIVE);

    return;
}

void fan_on() {
    gpio_dt_spec gpio_fan1, gpio_fan2, gpio_fan3, gpio_fan4;

    gpio_fan1 = GPIO_DT_SPEC_GET(DT_NODELABEL(fan1), gpios);
    gpio_fan2 = GPIO_DT_SPEC_GET(DT_NODELABEL(fan2), gpios);
    gpio_fan3 = GPIO_DT_SPEC_GET(DT_NODELABEL(fan3), gpios);
    gpio_fan4 = GPIO_DT_SPEC_GET(DT_NODELABEL(fan4), gpios);

    // Fan1 and Fan2 ON
    if (gpio_is_ready_dt(&gpio_fan1))
        gpio_pin_configure_dt(&gpio_fan1, GPIO_OUTPUT_HIGH | GPIO_ACTIVE_HIGH);
    if (gpio_is_ready_dt(&gpio_fan2))
        gpio_pin_configure_dt(&gpio_fan2, GPIO_OUTPUT_HIGH | GPIO_ACTIVE_HIGH);

    // Fan3 and Fan4 ON
    if (gpio_is_ready_dt(&gpio_fan3))
        gpio_pin_configure_dt(&gpio_fan3, GPIO_OUTPUT_HIGH | GPIO_ACTIVE_HIGH);
    if (gpio_is_ready_dt(&gpio_fan4))
        gpio_pin_configure_dt(&gpio_fan4, GPIO_OUTPUT_HIGH | GPIO_ACTIVE_HIGH);
}

void power_on() {
    gpio_dt_spec gpio_v24, gpio_wheel, gpio_peripheral;
    gpio_dt_spec gpio_wheel_en;

    gpio_v24 = GPIO_DT_SPEC_GET(DT_NODELABEL(v24), gpios);
    gpio_wheel = GPIO_DT_SPEC_GET(DT_NODELABEL(v_wheel), gpios);
    gpio_peripheral = GPIO_DT_SPEC_GET(DT_NODELABEL(v_peripheral), gpios);
    gpio_wheel_en = GPIO_DT_SPEC_GET(DT_NODELABEL(wheel_en), gpios);

    // Load switch ON
    if (gpio_is_ready_dt(&gpio_wheel)){
        gpio_pin_configure_dt(&gpio_wheel, GPIO_OUTPUT_HIGH | GPIO_ACTIVE_HIGH);
        k_msleep(3000);
    }
        
    if (gpio_is_ready_dt(&gpio_peripheral)){
        gpio_pin_configure_dt(&gpio_peripheral, GPIO_OUTPUT_HIGH | GPIO_ACTIVE_HIGH);
        k_msleep(3000);
    }
    
    if (gpio_is_ready_dt(&gpio_v24)){
        gpio_pin_configure_dt(&gpio_v24, GPIO_OUTPUT_LOW | GPIO_ACTIVE_HIGH);
        k_msleep(3000);
    }

    if (gpio_is_ready_dt(&gpio_wheel_en)){
        gpio_pin_configure_dt(&gpio_wheel_en, GPIO_OUTPUT_HIGH | GPIO_ACTIVE_HIGH);
        k_msleep(3000);
    }
}

int main()
{
    init_gpio();
    k_msleep(3000);

    fan_on();

    lexxhard::actuator_controller::init();
    lexxhard::actuator_service_controller::init();
    lexxhard::adc_reader::init();
    lexxhard::bmu_controller::init();
    lexxhard::board_controller::init();
    lexxhard::can_controller::init();
    lexxhard::firmware_updater::init();
    lexxhard::imu_controller::init();
#ifdef ENABLE_LED_STRIP
    lexxhard::led_controller::init();
#endif
#ifdef ENABLE_PGV
    lexxhard::pgv_controller::init();
#endif
#ifdef ENABLE_LCS
    lexxhard::lcs_controller::init();
#endif
    lexxhard::zcan_main::init();
    lexxhard::runaway_detector::init();
    lexxhard::uss_controller::init();
    lexxhard::shutter_limit_switch::init();
    lexxhard::gpio_controller::init();
    lexxhard::shutter_motor_controller::init();
#ifdef ENABLE_TOF_CHAIN
    // The ToF chain owns i2c2; the tug encoder must resolve to
    // "disconnected" without ever touching the bus, and its polling thread
    // is not started.
    lexxhard::tug_encoder_controller::init_disconnected_for_tof();
    lexxhard::tof_chain_controller::init();
#else
    lexxhard::tug_encoder_controller::init();
#endif

    RUN(actuator_controller, 2);
    RUN(actuator_service_controller, 2);
    RUN(adc_reader, 2);
    RUN(bmu_controller, 4);
    RUN(can_controller, 4);
    RUN(board_controller, 4); // board_controller must be started after bmu_controller (due to the CAN setting)
    RUN(firmware_updater, 7);
    RUN(imu_controller, 2);
#ifdef ENABLE_LED_STRIP
    RUN(led_controller, 1);
#endif
#ifdef ENABLE_PGV
    RUN(pgv_controller, 1);
#endif
#ifdef ENABLE_LCS
    RUN(lcs_controller, 1);
#endif
    RUN(uss_controller, 2);
    RUN(gpio_controller, 2);
    // Priority 1 (same tier as led/pgv): the ~1ms Limit-Switch-to-stop cadence
    // is safety-relevant (no encoder backup for Shutter), so it must not be
    // starved by the 10ms-cadence controllers at priority 2+.
    RUN(shutter_motor_controller, 1);
#ifndef ENABLE_TOF_CHAIN
    RUN(tug_encoder_controller, 2);
#endif
    RUN(runaway_detector, 4);
#ifdef ENABLE_TOF_PACKAGE_AUTO
    /* Priority 7, the lowest tier used here and the same one the firmware updater runs at: this
     * thread spends seconds at a time inside the ULD's blob download and its polling waits, and
     * nothing it does is time-critical to the machine. Started before zcan_main for the same
     * reason every other thread is -- zcan_main goes last -- and its own first act is to listen on
     * the bus for a second before transmitting anything. */
    RUN(tof_package_runtime, 7);
#endif
    RUN(zcan_main, 5); // zcan_main thread must be started at last.

#if defined(ENABLE_TOF_CHAIN) && !defined(ENABLE_TOF_PACKAGE_BENCH) && \
    !defined(ENABLE_TOF_PACKAGE_AUTO_DEADMAN)
    // THE TEST-BOOT DECISION BELONGS TO ONE MECHANISM PER IMAGE, AND THIS GUARD IS
    // WHICH ONE. Confirming here and arming an unattended revert below are two
    // answers to the same question, and until this guard existed both were compiled
    // into the same image whenever the chain was enabled: the confirm ran first, so
    // arm() found a confirmed image and declined, and the revert was absent for a
    // reason no file stated. Ordering is not a policy. An image that carries a
    // deadman now keeps its unconfirmed trailer, which is what gives that timer
    // something to revert to.
    //
    // Commissioning builds are delivered as padded *test* images over the
    // CAN DFU (which writes raw bytes into slot1, so only the embedded
    // trailer can request a swap), and the SCB reset that applies the swap
    // power-cycles the whole machine -- without a runtime confirm the image
    // reverts before anyone can interact with it.
    //
    // LIMITED GUARANTEE, stated precisely: RUN() creates threads with a
    // 2-second start delay, so this confirm executes after thread CREATION
    // but before any subsystem thread has actually run. Automatic rollback
    // therefore covers crashes in main initialisation and thread creation
    // only -- a fault once the threads start is already confirmed and
    // stays. Deliberately kept immediate because of the verified CAN-DFU
    // reboot cascade; do not delay the confirm past the thread start
    // without first proving the cascade leaves it time to execute. A
    // resident image without a deadman still relies on this confirm, and that
    // is the configuration this branch now serves.
    if (int rc = boot_write_img_confirmed(); rc == 0)
        printk("tof_chain: image confirmed\n");
    else
        printk("tof_chain: image confirm failed (%d), will revert on next boot\n", rc);
#endif

#if defined(ENABLE_TOF_PACKAGE_BENCH) || defined(ENABLE_TOF_PACKAGE_AUTO_DEADMAN)
    // Keep Package candidates unconfirmed and arm the reset that applies rollback.
    // Bench may extend its window via hold; auto has no pkg_tof command group.
    // Ordinary Zephyr shell remains. A permanently resident auto build explicitly
    // opts out of the deadman; watchdog coverage does not replace this timer.
    lexxhard::tof_package_bench_deadman::arm();
#endif

    gpio_dt_spec heart_beat_led = GPIO_DT_SPEC_GET(DT_NODELABEL(dbg_led1), gpios);

    // Heartbeat LED
    while (true) {
        if(gpio_is_ready_dt(&heart_beat_led))
            gpio_pin_toggle_dt(&heart_beat_led);
        k_msleep(1000);
    }

    return 0;
}

// vim: set expandtab shiftwidth=4:
```

## src/actuator_controller.hpp
```c
/*
 * Copyright (c) 2022, LexxPluss Inc.
 * All rights reserved.
 *
 * Redistribution and use in source and binary forms, with or without
 * modification, are permitted provided that the following conditions are met:
 *
 * 1. Redistributions of source code must retain the above copyright notice,
 *    this list of conditions and the following disclaimer.
 * 2. Redistributions in binary form must reproduce the above copyright notice,
 *    this list of conditions and the following disclaimer in the documentation
 *    and/or other materials provided with the distribution.
 *
 * THIS SOFTWARE IS PROVIDED BY THE COPYRIGHT HOLDERS AND CONTRIBUTORS "AS IS" AND
 * ANY EXPRESS OR IMPLIED WARRANTIES, INCLUDING, BUT NOT LIMITED TO, THE IMPLIED
 * WARRANTIES OF MERCHANTABILITY AND FITNESS FOR A PARTICULAR PURPOSE ARE
 * DISCLAIMED. IN NO EVENT SHALL THE COPYRIGHT OWNER OR CONTRIBUTORS BE LIABLE FOR
 * ANY DIRECT, INDIRECT, INCIDENTAL, SPECIAL, EXEMPLARY, OR CONSEQUENTIAL DAMAGES
 * (INCLUDING, BUT NOT LIMITED TO, PROCUREMENT OF SUBSTITUTE GOODS OR SERVICES;
 * LOSS OF USE, DATA, OR PROFITS; OR BUSINESS INTERRUPTION) HOWEVER CAUSED AND
 * ON ANY THEORY OF LIABILITY, WHETHER IN CONTRACT, STRICT LIABILITY, OR TORT
 * (INCLUDING NEGLIGENCE OR OTHERWISE) ARISING IN ANY WAY OUT OF THE USE OF THIS
 * SOFTWARE, EVEN IF ADVISED OF THE POSSIBILITY OF SUCH DAMAGE.
 */

#pragma once

#include <zephyr/kernel.h>

namespace lexxhard::actuator_controller {

struct can_format_encoder {
    can_format_encoder(int16_t enc0,int16_t enc1,int16_t enc2) : encoder_count{enc0, enc1, enc2} {} 
    int16_t encoder_count[3]; // Center / Left / Right
    void into(uint8_t data[8]) {
        data[0] = static_cast<uint8_t>((encoder_count[0] >> 8) & 0xff);
        data[1] = static_cast<uint8_t>(encoder_count[0] & 0xff);
        data[2] = static_cast<uint8_t>((encoder_count[1] >> 8) & 0xff);
        data[3] = static_cast<uint8_t>(encoder_count[1] & 0xff);
        data[4] = static_cast<uint8_t>((encoder_count[2] >> 8) & 0xff);
        data[5] = static_cast<uint8_t>(encoder_count[2] & 0xff); 
    }
} __attribute__((aligned(4)));

struct can_format_current {
    can_format_current(int16_t cur0,int16_t cur1,int16_t cur2, int16_t con) : current_mv{cur0, cur1, cur2}, connection_mv(con) {} 
    int16_t current_mv[3]; // Center / Center / Right
    int16_t connection_mv;
    void into(uint8_t data[8]) {
        data[0] = static_cast<uint8_t>((current_mv[0] >> 8) & 0xff);
        data[1] = static_cast<uint8_t>(current_mv[0] & 0xff);
        data[2] = static_cast<uint8_t>((current_mv[1] >> 8) & 0xff);
        data[3] = static_cast<uint8_t>(current_mv[1] & 0xff);
        data[4] = static_cast<uint8_t>((current_mv[2] >> 8) & 0xff);
        data[5] = static_cast<uint8_t>(current_mv[2] & 0xff);
        data[6] = static_cast<uint8_t>((connection_mv >> 8) & 0xff);
        data[7] = static_cast<uint8_t>(connection_mv & 0xff);
    }
} __attribute__((aligned(4)));

struct msg_control {
    struct {
        int8_t direction; // -1:down, 0:stop, 1:up
        uint8_t power;    // 0-100 duty[%]
    } actuators[3]; // Center / Left / Right
    // Origin of this control frame. Only EXTERNAL_CAN_0X208 (host duty control)
    // arms the 0x208 command-timeout watchdog; INTERNAL frames (e.g. init_location
    // homing via control_trampoline) must NOT arm it, or homing would be force-stopped.
    enum class source_type : uint8_t { INTERNAL, EXTERNAL_CAN_0X208 };
    source_type source{source_type::INTERNAL};
    static constexpr int8_t DOWN{-1}, STOP{0}, UP{1};
    static msg_control from(const uint8_t data[8]) {
        return {
            .actuators{
                {static_cast<int8_t>(data[0]), data[3]},
                {static_cast<int8_t>(data[1]), data[4]},
                {static_cast<int8_t>(data[2]), data[5]}
            },
            .source = source_type::EXTERNAL_CAN_0X208
        };
    }
} __attribute__((aligned(4)));

struct msg {
    int32_t encoder_count[3];
    int32_t current[3];
    int32_t connect;
    bool fail[3];
} __attribute__((aligned(4)));

void init();
void run(void *p1, void *p2, void *p3);
int init_location(const int8_t (&directoins)[3]);
int to_location(const int8_t (&location)[3], const uint8_t (&power)[3], uint8_t (&detail)[3]);
extern k_thread thread;
extern k_msgq msgq, msgq_control;

}

// vim: set expandtab shiftwidth=4:
```

## src/actuator_service_controller.cpp
```c
/*
 * Copyright (c) 2022, LexxPluss Inc.
 * All rights reserved.
 *
 * Redistribution and use in source and binary forms, with or without
 * modification, are permitted provided that the following conditions are met:
 *
 * 1. Redistributions of source code must retain the above copyright notice,
 *    this list of conditions and the following disclaimer.
 * 2. Redistributions in binary form must reproduce the above copyright notice,
 *    this list of conditions and the following disclaimer in the documentation
 *    and/or other materials provided with the distribution.
 *
 * THIS SOFTWARE IS PROVIDED BY THE COPYRIGHT HOLDERS AND CONTRIBUTORS "AS IS" AND
 * ANY EXPRESS OR IMPLIED WARRANTIES, INCLUDING, BUT NOT LIMITED TO, THE IMPLIED
 * WARRANTIES OF MERCHANTABILITY AND FITNESS FOR A PARTICULAR PURPOSE ARE
 * DISCLAIMED. IN NO EVENT SHALL THE COPYRIGHT OWNER OR CONTRIBUTORS BE LIABLE FOR
 * ANY DIRECT, INDIRECT, INCIDENTAL, SPECIAL, EXEMPLARY, OR CONSEQUENTIAL DAMAGES
 * (INCLUDING, BUT NOT LIMITED TO, PROCUREMENT OF SUBSTITUTE GOODS OR SERVICES;
 * LOSS OF USE, DATA, OR PROFITS; OR BUSINESS INTERRUPTION) HOWEVER CAUSED AND
 * ON ANY THEORY OF LIABILITY, WHETHER IN CONTRACT, STRICT LIABILITY, OR TORT
 * (INCLUDING NEGLIGENCE OR OTHERWISE) ARISING IN ANY WAY OUT OF THE USE OF THIS
 * SOFTWARE, EVEN IF ADVISED OF THE POSSIBILITY OF SUCH DAMAGE.
 */

#include <optional>

#include <zephyr/kernel.h>
#include <zephyr/logging/log.h>
#include "actuator_controller.hpp"
#include "actuator_service_controller.hpp"

namespace lexxhard::actuator_service_controller {

LOG_MODULE_REGISTER(actuator_service);

char __aligned(4) msgq_request_buffer[8 * sizeof (msg_request)];
char __aligned(4) msgq_response_buffer[8 * sizeof (msg_response)];

class actuators_service_controller_impl {
public:
    int init() {
        k_msgq_init(&msgq_request, msgq_request_buffer, sizeof (msg_request), 8);
        k_msgq_init(&msgq_response, msgq_response_buffer, sizeof (msg_response), 8);

        return 0;
    }

    void run() {
        while (true) {
            struct msg_request msg_req;
            if (k_msgq_get(&msgq_request, &msg_req, K_NO_WAIT) == 0) {
                if(auto const ret(handle_request(msg_req)); ret.has_value()) {
                    struct msg_response msg_resp{*ret};
                    while(k_msgq_put(&msgq_response, &msg_resp, K_NO_WAIT) != 0)  {
                        k_msgq_purge(&msgq_response);
                    }
                }
            }
            k_msleep(10);
        }
    }

private:
    // Center is not an encoder-controlled actuator (Shutter has no encoder),
    // so init/location requests for it never apply
    // (actuator_controller::init_location()/to_location() ignore index 0).
    // This only logs -- it doesn't change wire format or reject the request.
    // Always logs at DBG (so real-hardware verification can confirm this
    // code path is actually being exercised even when center is the
    // all-zero default); escalates to WRN only for a non-degenerate request,
    // since that indicates something upstream actually tried to move Center.
    static void warn_if_center_requested(int8_t location, uint8_t power)
    {
        LOG_DBG("Center init/location request received (location:%d power:%u) -- ignored.", location, power);
        if (location != 0 || power != 0) {
            LOG_WRN("ignoring non-degenerate init/location request for Center (location:%d power:%u): "
                     "Shutter is not an encoder-controlled actuator.", location, power);
        }
    }

    std::optional<struct msg_response> handle_request(struct  msg_request const& msg_req)
    {
        if(msg_req.mode == service_mode::INIT) {
            return do_init_service(msg_req);
        } else if(msg_req.mode == service_mode::LOCATION) {
            return do_location_service(msg_req);
        }

        LOG_ERR("Invalid service mode: %d", static_cast<int8_t>(msg_req.mode));
        return std::nullopt;
    };

    struct msg_response do_init_service(struct msg_request const& msg_req)
    {
        warn_if_center_requested(msg_req.center.location, msg_req.center.power);
        int8_t const directions[3]{
            msg_req.center.location,
            msg_req.left.location,
            msg_req.right.location
        };
        bool const ret{actuator_controller::init_location(directions) == 0};
        return {
            .mode = msg_req.mode,
            .success = ret,
            .center = {.detail = 0},
            .left = {.detail = 0},
            .right = {.detail = 0},
            .counter = msg_req.counter
        };
    }

    struct msg_response do_location_service(struct msg_request const& msg_req)
    {
        warn_if_center_requested(msg_req.center.location, msg_req.center.power);
        int8_t const location[3]{
            msg_req.center.location,
            msg_req.left.location,
            msg_req.right.location
        };
        uint8_t const power[3]{
            msg_req.center.power,
            msg_req.left.power,
            msg_req.right.power
        };
        uint8_t detail[3]{0, 0, 0};
        bool const ret{actuator_controller::to_location(location, power, detail) == 0};

        return {
            .mode = msg_req.mode,
            .success = ret,
            .center = {.detail = detail[0]},
            .left = {.detail = detail[1]},
            .right = {.detail = detail[2]},
            .counter = msg_req.counter
        };
    }
} impl;

void init()
{
    impl.init();
}

void run(void *p1, void *p2, void *p3)
{
    impl.run();
}

k_thread thread;
k_msgq msgq_request, msgq_response;
}
```

## src/actuator_service_controller.hpp
```c
/*
 * Copyright (c) 2022, LexxPluss Inc.
 * All rights reserved.
 *
 * Redistribution and use in source and binary forms, with or without
 * modification, are permitted provided that the following conditions are met:
 *
 * 1. Redistributions of source code must retain the above copyright notice,
 *    this list of conditions and the following disclaimer.
 * 2. Redistributions in binary form must reproduce the above copyright notice,
 *    this list of conditions and the following disclaimer in the documentation
 *    and/or other materials provided with the distribution.
 *
 * THIS SOFTWARE IS PROVIDED BY THE COPYRIGHT HOLDERS AND CONTRIBUTORS "AS IS" AND
 * ANY EXPRESS OR IMPLIED WARRANTIES, INCLUDING, BUT NOT LIMITED TO, THE IMPLIED
 * WARRANTIES OF MERCHANTABILITY AND FITNESS FOR A PARTICULAR PURPOSE ARE
 * DISCLAIMED. IN NO EVENT SHALL THE COPYRIGHT OWNER OR CONTRIBUTORS BE LIABLE FOR
 * ANY DIRECT, INDIRECT, INCIDENTAL, SPECIAL, EXEMPLARY, OR CONSEQUENTIAL DAMAGES
 * (INCLUDING, BUT NOT LIMITED TO, PROCUREMENT OF SUBSTITUTE GOODS OR SERVICES;
 * LOSS OF USE, DATA, OR PROFITS; OR BUSINESS INTERRUPTION) HOWEVER CAUSED AND
 * ON ANY THEORY OF LIABILITY, WHETHER IN CONTRACT, STRICT LIABILITY, OR TORT
 * (INCLUDING NEGLIGENCE OR OTHERWISE) ARISING IN ANY WAY OUT OF THE USE OF THIS
 * SOFTWARE, EVEN IF ADVISED OF THE POSSIBILITY OF SUCH DAMAGE.
 */

#pragma once

#include <zephyr/kernel.h>

namespace lexxhard::actuator_service_controller {

enum class service_mode: uint8_t {
    LOCATION = 0,
    INIT = 1,
};

struct msg_request {
    service_mode mode;
    struct {
        int8_t location;
        uint8_t power;
    } center, left, right;
    uint8_t counter;

    static msg_request from(uint8_t data[8]) {
        return {
            .mode = static_cast<service_mode>(data[0]),
            .center = {static_cast<int8_t>(data[1]), data[4]},
            .left = {static_cast<int8_t>(data[2]), data[5]},
            .right = {static_cast<int8_t>(data[3]), data[6]},
            .counter = data[7]
        };
    }
} __attribute__((aligned(4)));

struct msg_response {
    service_mode mode;
    bool success;
    struct {
        uint8_t detail;
    } center, left, right;
    uint8_t counter;

    void into(uint8_t data[8]) {
        data[0] = static_cast<int8_t>(mode);
        data[1] = static_cast<uint8_t>(success);
        data[2] = center.detail;
        data[3] = left.detail;
        data[4] = right.detail;
        data[5] = 0;
        data[6] = 0;
        data[7] = counter;
    }
} __attribute__((aligned(4)));

void init();
void run(void *p1, void *p2, void *p3);
extern k_thread thread;
extern k_msgq msgq_request, msgq_response;
}
```

## src/adc_reader.cpp
```c
/*
 * Copyright (c) 2022, LexxPluss Inc.
 * All rights reserved.
 *
 * Redistribution and use in source and binary forms, with or without
 * modification, are permitted provided that the following conditions are met:
 *
 * 1. Redistributions of source code must retain the above copyright notice,
 *    this list of conditions and the following disclaimer.
 * 2. Redistributions in binary form must reproduce the above copyright notice,
 *    this list of conditions and the following disclaimer in the documentation
 *    and/or other materials provided with the distribution.
 *
 * THIS SOFTWARE IS PROVIDED BY THE COPYRIGHT HOLDERS AND CONTRIBUTORS "AS IS" AND
 * ANY EXPRESS OR IMPLIED WARRANTIES, INCLUDING, BUT NOT LIMITED TO, THE IMPLIED
 * WARRANTIES OF MERCHANTABILITY AND FITNESS FOR A PARTICULAR PURPOSE ARE
 * DISCLAIMED. IN NO EVENT SHALL THE COPYRIGHT OWNER OR CONTRIBUTORS BE LIABLE FOR
 * ANY DIRECT, INDIRECT, INCIDENTAL, SPECIAL, EXEMPLARY, OR CONSEQUENTIAL DAMAGES
 * (INCLUDING, BUT NOT LIMITED TO, PROCUREMENT OF SUBSTITUTE GOODS OR SERVICES;
 * LOSS OF USE, DATA, OR PROFITS; OR BUSINESS INTERRUPTION) HOWEVER CAUSED AND
 * ON ANY THEORY OF LIABILITY, WHETHER IN CONTRACT, STRICT LIABILITY, OR TORT
 * (INCLUDING NEGLIGENCE OR OTHERWISE) ARISING IN ANY WAY OUT OF THE USE OF THIS
 * SOFTWARE, EVEN IF ADVISED OF THE POSSIBILITY OF SUCH DAMAGE.
 */

#include <zephyr/device.h>
#include <zephyr/drivers/adc.h>
#include <zephyr/logging/log.h>
#include "adc_reader.hpp"

namespace lexxhard::adc_reader {

LOG_MODULE_REGISTER(adc);

class {
public:
    int init() {
        dev = DEVICE_DT_GET(DT_NODELABEL(adc1));
        dev_adc3 = DEVICE_DT_GET(DT_NODELABEL(adc3));
        return (device_is_ready(dev) && device_is_ready(dev_adc3)) ? 0 : -1;
    }
    void run() {
        if (!device_is_ready(dev) && !device_is_ready(dev_adc3))
            return;
        while (true) {
            read_all_channels();
            k_msleep(20);
        }
    }
    int32_t get(int index) const {
        int32_t value{buffer[index]};
        if (int32_t ref{adc_ref_internal(dev)}; ref > 0)
            adc_raw_to_millivolts(ref, ADC_GAIN_1, 12, &value);
        return value;
    }

    int32_t get_adc3(int index) const {
        int32_t value_adc3{buffer_adc3[index]};
        if (int32_t ref_adc3{adc_ref_internal(dev_adc3)}; ref_adc3 > 0)
            adc_raw_to_millivolts(ref_adc3, ADC_GAIN_1, 12, &value_adc3);
        return value_adc3;
    }
private:
    void read_all_channels() {
        /*  ADC1 */
        static constexpr uint8_t ch[NUM_CHANNELS]{8, 9, 11, 12, 13, 14, 15};
        for (int i{0}; i < NUM_CHANNELS; ++i) {
            // Only single channel supported
            adc_channel_cfg channel_cfg{
                .gain{ADC_GAIN_1},
                .reference{ADC_REF_INTERNAL},
                .acquisition_time{ADC_ACQ_TIME_DEFAULT},
                .channel_id{ch[i]},
                .differential{0}
            };
            adc_channel_setup(dev, &channel_cfg);
            adc_sequence sequence{
                .options{nullptr},
                .channels{BIT(ch[i])},
                .buffer{&buffer[i]},
                .buffer_size{sizeof buffer[i]},
                .resolution{12},
                .oversampling{0},
                .calibrate{0}
            };
            adc_read(dev, &sequence);
        }
        /* ADC3 */
        static constexpr uint8_t ch_adc3[NUM_CHANNELS_ADC3]{8};
        for (int i{0}; i < NUM_CHANNELS_ADC3; ++i) {
            // Only single channel supported
            adc_channel_cfg channel_cfg_adc3{
                .gain{ADC_GAIN_1},
                .reference{ADC_REF_INTERNAL},
                .acquisition_time{ADC_ACQ_TIME_DEFAULT},
                .channel_id{ch_adc3[i]},
                .differential{0}
            };
            adc_channel_setup(dev_adc3, &channel_cfg_adc3);
            adc_sequence sequence_adc3{
                .options{nullptr},
                .channels{BIT(ch_adc3[i])},
                .buffer{&buffer_adc3[i]},
                .buffer_size{sizeof buffer_adc3[i]},
                .resolution{12},
                .oversampling{0},
                .calibrate{0}
            };
            adc_read(dev_adc3, &sequence_adc3);
        }
    }
    const device *dev{nullptr}, *dev_adc3{nullptr};
    uint16_t buffer[NUM_CHANNELS], buffer_adc3[NUM_CHANNELS_ADC3];
} impl;

void init()
{
    impl.init();
}

void run(void *p1, void *p2, void *p3)
{
    impl.run();
}

int32_t get(int index)
{
    return impl.get(index);
}

int32_t get_adc3(int index)
{
    return impl.get_adc3(index);
}

k_thread thread;

}

// vim: set expandtab shiftwidth=4:
```

## src/adc_reader.hpp
```c
/*
 * Copyright (c) 2022, LexxPluss Inc.
 * All rights reserved.
 *
 * Redistribution and use in source and binary forms, with or without
 * modification, are permitted provided that the following conditions are met:
 *
 * 1. Redistributions of source code must retain the above copyright notice,
 *    this list of conditions and the following disclaimer.
 * 2. Redistributions in binary form must reproduce the above copyright notice,
 *    this list of conditions and the following disclaimer in the documentation
 *    and/or other materials provided with the distribution.
 *
 * THIS SOFTWARE IS PROVIDED BY THE COPYRIGHT HOLDERS AND CONTRIBUTORS "AS IS" AND
 * ANY EXPRESS OR IMPLIED WARRANTIES, INCLUDING, BUT NOT LIMITED TO, THE IMPLIED
 * WARRANTIES OF MERCHANTABILITY AND FITNESS FOR A PARTICULAR PURPOSE ARE
 * DISCLAIMED. IN NO EVENT SHALL THE COPYRIGHT OWNER OR CONTRIBUTORS BE LIABLE FOR
 * ANY DIRECT, INDIRECT, INCIDENTAL, SPECIAL, EXEMPLARY, OR CONSEQUENTIAL DAMAGES
 * (INCLUDING, BUT NOT LIMITED TO, PROCUREMENT OF SUBSTITUTE GOODS OR SERVICES;
 * LOSS OF USE, DATA, OR PROFITS; OR BUSINESS INTERRUPTION) HOWEVER CAUSED AND
 * ON ANY THEORY OF LIABILITY, WHETHER IN CONTRACT, STRICT LIABILITY, OR TORT
 * (INCLUDING NEGLIGENCE OR OTHERWISE) ARISING IN ANY WAY OUT OF THE USE OF THIS
 * SOFTWARE, EVEN IF ADVISED OF THE POSSIBILITY OF SUCH DAMAGE.
 */

#pragma once

#include <zephyr/kernel.h>

namespace lexxhard::adc_reader {

void init();
void run(void *p1, void *p2, void *p3);
int32_t get(int index);
int32_t get_adc3(int index);
extern k_thread thread;

enum {
    DOWNWARD_L = 0,
    DOWNWARD_R,
    ACTUATOR_L,
    ACTUATOR_C,
    ACTUATOR_R,
    THERMISTOR_P,
    THERMISTOR_N,
    NUM_CHANNELS
};

enum {
    CHARGING_VOLTAGE = 0,
    NUM_CHANNELS_ADC3
};

}

// vim: set expandtab shiftwidth=4:
```

## src/auto_charge_transitions.cpp
```c
// Copyright (c) 2026, LexxPluss Inc.
// All rights reserved.
//
// Redistribution and use in source and binary forms, with or without
// modification, are permitted provided that the following conditions are met:
//
// 1. Redistributions of source code must retain the above copyright notice,
//    this list of conditions and the following disclaimer.
// 2. Redistributions in binary form must reproduce the above copyright notice,
//    this list of conditions and the following disclaimer in the documentation
//    and/or other materials provided with the distribution.
//
// THIS SOFTWARE IS PROVIDED BY THE COPYRIGHT HOLDERS AND CONTRIBUTORS "AS IS" AND
// ANY EXPRESS OR IMPLIED WARRANTIES, INCLUDING, BUT NOT LIMITED TO, THE IMPLIED
// WARRANTIES OF MERCHANTABILITY AND FITNESS FOR A PARTICULAR PURPOSE ARE
// DISCLAIMED. IN NO EVENT SHALL THE COPYRIGHT OWNER OR CONTRIBUTORS BE LIABLE FOR
// ANY DIRECT, INDIRECT, INCIDENTAL, SPECIAL, EXEMPLARY, OR CONSEQUENTIAL DAMAGES
// (INCLUDING, BUT NOT LIMITED TO, PROCUREMENT OF SUBSTITUTE GOODS OR SERVICES;
// LOSS OF USE, DATA, OR PROFITS; OR BUSINESS INTERRUPTION) HOWEVER CAUSED AND
// ON ANY THEORY OF LIABILITY, WHETHER IN CONTRACT, STRICT LIABILITY, OR TORT
// (INCLUDING NEGLIGENCE OR OTHERWISE) ARISING IN ANY WAY OUT OF THE USE OF THIS
// SOFTWARE, EVEN IF ADVISED OF THE POSSIBILITY OF SUCH DAMAGE.

#include "auto_charge_transitions.hpp"

namespace lexxhard::board_controller {

namespace {

using reason = auto_charge_exit_reason;

auto_charge_decision makeDecision(const POWER_STATE next, const reason why, const bool can_skip_wait_sw = false,
                                  const bool use_software_brake = false) {
    return auto_charge_decision{next, can_skip_wait_sw, use_software_brake, why};
}

}  // namespace

auto_charge_decision eval_auto_charge_transitions(const auto_charge_inputs& in) {
    if (in.should_turn_off) {
        return makeDecision(POWER_STATE::OFF_WAIT, reason::TURN_OFF);
    }
    if (in.ksw_transition_to_running) {
        return makeDecision(POWER_STATE::OFF_WAIT, reason::KSW_TO_RUNNING, true);
    }
    if (in.psw_pushed) {
        return makeDecision(POWER_STATE::STANDBY, reason::PSW);
    }
    if (in.power_off_from_ros) {
        return makeDecision(POWER_STATE::STANDBY, reason::POWER_OFF_FROM_ROS);
    }
    if (!in.bmu_ok) {
        return makeDecision(POWER_STATE::STANDBY, reason::BMU_FAILURE);
    }
    if (!in.dcdc_ok) {
        return makeDecision(POWER_STATE::STANDBY, reason::DCDC_FAILURE);
    }
    if (in.esw_asserted) {
        return makeDecision(POWER_STATE::SUSPEND, reason::ESW, false, true);
    }
    if (in.sl_asserted) {
        return makeDecision(POWER_STATE::SUSPEND, reason::SAFETY_LIDAR);
    }
    if (in.emergency_stop_from_ros) {
        return makeDecision(POWER_STATE::SUSPEND, reason::EMERGENCY_STOP_FROM_ROS, false, true);
    }
    if (in.is_dead) {
        return makeDecision(POWER_STATE::SUSPEND, reason::DEAD);
    }
    if (in.bmu_full_charge) {
        return makeDecision(POWER_STATE::NORMAL, reason::FULL_CHARGE);
    }
    if (!in.ac_docked) {
        return makeDecision(POWER_STATE::NORMAL, reason::UNDOCKED);
    }
    if (in.mc_plugged) {
        return makeDecision(POWER_STATE::NORMAL, reason::MANUAL_CHARGER);
    }
    if (in.current_check_enable && !in.bmu_charging) {
        return makeDecision(POWER_STATE::NORMAL, reason::NOT_CHARGING);
    }
    return auto_charge_decision{};
}

leave_auto_charge_plan plan_leave_auto_charge(const bool use_software_brake) {
#ifdef ENABLE_PUSH_MODE
    static_cast<void>(use_software_brake);
    return leave_auto_charge_plan{true, true, wheel_en_action::NONE};
#else
    return leave_auto_charge_plan{
        true, true, use_software_brake ? wheel_en_action::DISABLE_DELAYED : wheel_en_action::DISABLE_IMMEDIATE};
#endif
}

wheel_en_action plan_enter_wheel_en(const POWER_STATE s, const bool ksw_maintenance) {
    switch (s) {
    case POWER_STATE::AUTO_CHARGE:
    case POWER_STATE::NORMAL:
        return ksw_maintenance ? wheel_en_action::DISABLE_IMMEDIATE : wheel_en_action::ENABLE;
    case POWER_STATE::STANDBY:
        return wheel_en_action::DISABLE_IMMEDIATE;
    default:
        return wheel_en_action::NONE;
    }
}

wheel_en_action plan_shutdown_wheel_en(const POWER_STATE entering, const bool use_software_brake) {
#ifdef ENABLE_PUSH_MODE
    switch (entering) {
    case POWER_STATE::OFF_WAIT:
        return use_software_brake ? wheel_en_action::DISABLE_DELAYED : wheel_en_action::DISABLE_IMMEDIATE;
    case POWER_STATE::OFF:
        return wheel_en_action::DISABLE_IMMEDIATE;
    default:
        return wheel_en_action::NONE;
    }
#else
    static_cast<void>(entering);
    static_cast<void>(use_software_brake);
    return wheel_en_action::NONE;
#endif
}

}  // namespace lexxhard::board_controller
```
