## CMakeLists.txt
```
# Copyright (c) 2026, LexxPluss Inc.
# All rights reserved.
#
# Redistribution and use in source and binary forms, with or without
# modification, are permitted provided that the following conditions are met:
#
# 1. Redistributions of source code must retain the above copyright notice,
#    this list of conditions and the following disclaimer.
# 2. Redistributions in binary form must reproduce the above copyright notice,
#    this list of conditions and the following disclaimer in the documentation
#    and/or other materials provided with the distribution.
#
# THIS SOFTWARE IS PROVIDED BY THE COPYRIGHT HOLDERS AND CONTRIBUTORS "AS IS" AND
# ANY EXPRESS OR IMPLIED WARRANTIES, INCLUDING, BUT NOT LIMITED TO, THE IMPLIED
# WARRANTIES OF MERCHANTABILITY AND FITNESS FOR A PARTICULAR PURPOSE ARE
# DISCLAIMED. IN NO EVENT SHALL THE COPYRIGHT OWNER OR CONTRIBUTORS BE LIABLE FOR
# ANY DIRECT, INDIRECT, INCIDENTAL, SPECIAL, EXEMPLARY, OR CONSEQUENTIAL DAMAGES
# (INCLUDING, BUT NOT LIMITED TO, PROCUREMENT OF SUBSTITUTE GOODS OR SERVICES;
# LOSS OF USE, DATA, OR PROFITS; OR BUSINESS INTERRUPTION) HOWEVER CAUSED AND
# ON ANY THEORY OF LIABILITY, WHETHER IN CONTRACT, STRICT LIABILITY, OR TORT
# (INCLUDING NEGLIGENCE OR OTHERWISE) ARISING IN ANY WAY OUT OF THE USE OF THIS
# SOFTWARE, EVEN IF ADVISED OF THE POSSIBILITY OF SUCH DAMAGE.


cmake_minimum_required(VERSION 3.20.0)

find_package(Zephyr REQUIRED HINTS $ENV{ZEPHYR_BASE})
project(tof_commissioning_test)

set(APP_SRC_DIR ${CMAKE_CURRENT_SOURCE_DIR}/../../src)

# The whole transaction, with a REAL k_mutex for the chain and the real authority, proof, enumerator
# and isolation behind it. Only the bus and the quiesce hook are faked, because everything this
# commit is about -- lock ordering, recursion, which exit paths release, what stays open on failure --
# is a property of the real components' interaction and a fake of any of them would assume the
# answer.
# tof_acquisition.cpp is linked because the quiesce is now the real one: the step before the session
# takes the chain used to block on it, and only the real acquisition layer can show that it no longer
# does. Its dependency on the vendor sensor entry points is stubbed in the test rather than satisfied
# by linking the ULD, which belongs to the sensor suite.
# Two suites in one binary, sharing the chain fake: the commissioning transaction and the runtime
# bootstrap. They share it because a second copy of a fake that models the flip-flop chain, the L4/L7
# reset-class asymmetry and the tail-races-ahead defect would drift, and the verdicts depend on
# exactly those details. The runtime suite also links the publisher and packer, because the bootstrap
# it tests is the production one -- wiring the modules up in the test would be a third wiring.
target_sources(app PRIVATE
    src/test_main.cpp
    src/test_runtime.cpp
    src/test_wiring.cpp
    ${APP_SRC_DIR}/tof_acquisition.cpp
    # The watchdog heartbeats live in the hooked sources, so any suite that links them links this.
    ${APP_SRC_DIR}/runtime_progress.cpp
    ${APP_SRC_DIR}/tof_cliff_packer.cpp
    ${APP_SRC_DIR}/tof_cliff_publisher.cpp
    ${APP_SRC_DIR}/tof_cliff_runtime.cpp
    ${APP_SRC_DIR}/tof_commission_wiring.cpp
    ${APP_SRC_DIR}/tof_commissioning.cpp
    ${APP_SRC_DIR}/tof_mapping_authority.cpp
    ${APP_SRC_DIR}/tof_mapping_proof.cpp
    ${APP_SRC_DIR}/tof_tail_isolation.cpp
    ${APP_SRC_DIR}/tof_enumerator.cpp
)
target_compile_definitions(app PRIVATE ENABLE_TOF_CHAIN ENABLE_TOF_CLIFF_ULD)

# GRID_L7 tests real grid keying and publisher wiring; the default tests unassigned stubs.
# Vendor/blob stubs satisfy linking without simulating sensor measurements.
if(GRID_L7)
    target_compile_definitions(app PRIVATE ENABLE_TOF_L7_ULD)
    target_sources(app PRIVATE
        src/l7_link_stubs.cpp
        ${APP_SRC_DIR}/tof_grid_packer.cpp
        ${APP_SRC_DIR}/tof_grid_publisher.cpp
        ${APP_SRC_DIR}/tof_l7_sensor.cpp
    )
    set(L7_DIR ${CMAKE_CURRENT_SOURCE_DIR}/../../third_party/st/vl53l7cx_uld)
    target_include_directories(app PRIVATE
        ${L7_DIR}/zephyr
        ${L7_DIR}/upstream/modules
    )
endif()

set(ULD_DIR ${CMAKE_CURRENT_SOURCE_DIR}/../../third_party/st/vl53l4cx_uld)
set(CONTRACT_DIR ${CMAKE_CURRENT_SOURCE_DIR}/../../../docs/can)
target_include_directories(app PRIVATE
    ${APP_SRC_DIR}
    ${CONTRACT_DIR}
    ${ULD_DIR}/zephyr
    ${ULD_DIR}/upstream
    ${ULD_DIR}/upstream/modules
    ${ULD_DIR}/upstream/porting
)
```

## prj.conf
```kconfig
CONFIG_ZTEST=y
CONFIG_CPP=y
CONFIG_STD_CPP20=y
CONFIG_GLIBCXX_LIBCPP=y

# The GRID_L7=1 variant compiles the L7 port object, which resolves DT_NODELABEL(i2c2) at compile
# time. app.overlay supplies that node; the emul driver is what turns it into an actual device,
# without which the link fails on the node's device ordinal.
CONFIG_I2C=y
CONFIG_I2C_EMUL=y
```

## app.overlay
```dts
/*
 * Copyright (c) 2026, LexxPluss Inc.
 * All rights reserved.
 *
 * SPDX-License-Identifier: BSD-2-Clause
 *
 * The GRID_L7=1 variant compiles tof_cliff_runtime.cpp with ENABLE_TOF_L7_ULD, and the L7 port
 * object it then defines resolves its bus at COMPILE TIME with DT_NODELABEL(i2c2). Without a node
 * carrying that label the build fails on a missing device ordinal, not at run time -- so this
 * overlay is a build prerequisite of that variant, not a fixture.
 *
 * The label has to match the production one exactly: a test that renamed the node would stop
 * covering the production lookup. Same reasoning and same node as tests/tof_cliff_sensor.
 *
 * It applies to the GRID_L7=0 variant as well, which does not reference the bus. An emulated
 * controller nothing opens costs that build nothing.
 */

/ {
	i2c2: i2c@11112222 {
		#address-cells = <1>;
		#size-cells = <0>;
		compatible = "zephyr,i2c-emul-controller";
		reg = <0x11112222 0x1000>;
		status = "okay";
		clock-frequency = <400000>;
	};
};
```

## src/fake_chain.hpp
```c
/*
 * Copyright (c) 2026, LexxPluss Inc.
 * All rights reserved.
 *
 * SPDX-License-Identifier: BSD-2-Clause
 *
 * The chain as the hardware behaves, shared by every suite in this test application.
 *
 * Extracted rather than copied. Two suites now need a chain that can be enumerated -- the
 * commissioning transaction and the runtime bootstrap -- and a second copy of a fake this detailed
 * would drift: the L4/L7 reset-class asymmetry and the tail-races-ahead defect are the parts the
 * verdicts depend on, so two versions of them would mean two different definitions of what the
 * hardware does.
 *
 * Each translation unit that includes this gets its OWN instance, which is what keeps the suites
 * isolated; only the model is shared.
 */

#pragma once

#include <errno.h>

#include <zephyr/kernel.h>

#include "tof_chain_spec.hpp"
#include "tof_enumerator.hpp"

namespace fake {

namespace enm = lexxhard::tof_enum;

constexpr enm::id_bytes kL4Id{0xeb, 0xaa};
constexpr enm::id_bytes kL7Id{0xf0, 0x02};

struct fake_chain final : enm::chain_ops {
    static constexpr size_t kStages{6};

    bool present[kStages]{true, true, true, true, true, true};
    bool enabled[kStages]{false, false, false, false, false, false};
    uint8_t addr[kStages]{0x29, 0x29, 0x29, 0x29, 0x29, 0x29};
    bool l7[kStages]{true, true, false, false, false, false};
    bool data{false};

    /* L7 keeps its address across an enable-low while powered; L4's enable is reset-class. Modelling
     * both is what makes walk 2 report `retained` for the grid sensors and `enumerated` for the
     * cliff ones -- the exact asymmetry the fingerprint has to normalise. */
    bool reset_class(size_t i) const { return !l7[i]; }

    int set_data_rc{0};
    int pulse_rc{0};
    int fail_pulse_at{-1};
    int pulses_seen{0};
    /* One clock pulse enables TWO stages at the last hop -- the DS20001 defect, 4/4 reproducible
     * before the 50 ohm series resistor. Modelled in the shift rather than in readdress(), because
     * that is where it happens: the data edge beat the clock edge into the last flip-flop. */
    bool tail_races_ahead{false};
    /* Probes fail only while exactly this many pulses have been issued. An exact count rather than
     * "from here on", because the isolation and walk 2 share this probe: a fault that persisted would
     * break walk 2 as well, and the evaluator checks walk 2 BEFORE the isolation -- so the test would
     * pass on the wrong refusal and prove nothing about the isolation. */
    int error_probes_at_pulse_count{-1};

    int set_data(bool level) override
    {
        if (set_data_rc != 0)
            return set_data_rc;
        data = level;
        apply(0, level);
        return 0;
    }

    void apply(size_t i, bool level)
    {
        const bool was{enabled[i]};
        enabled[i] = level;
        if (was && !level && reset_class(i))
            addr[i] = enm::kDefaultAddr;
    }

    int pulse_clock() override
    {
        if (fail_pulse_at >= 0 && pulses_seen == fail_pulse_at) {
            ++pulses_seen;
            return -EIO;
        }
        ++pulses_seen;
        if (pulse_rc != 0)
            return pulse_rc;
        for (size_t i{kStages - 1}; i > 0; --i)
            apply(i, enabled[i - 1]);
        apply(0, data);
        if (tail_races_ahead)
            apply(kStages - 1, enabled[kStages - 2]);
        return 0;
    }

    /* A TRACE, BECAUSE THE DUAL-RATE TRANSACTION IS ABOUT ORDER. Call counts cannot tell a correct
     * sequence from a reversed one: 100 kHz must come before the walks, 400 kHz after them and
     * before the identity re-check, and nothing may re-address the chain once the re-check has
     * begun. Consecutive repeats are collapsed, so a walk's hundreds of probes read as one `p` and
     * the whole run fits in a string a failure message can print.
     *
     *   1  set 100 kHz      4  set 400 kHz
     *   p  probe            r  read_id            d  readdress            e  enable pulse */
    char trace[64]{};
    size_t trace_len{0};

    /* THE IDENTITY RE-CHECK'S FOUR FAULTS, injected by the retime rather than by a call count. The
     * re-check is the only thing that touches the chain after the bus moves to 400 kHz, so arming
     * these at the retime arms exactly it -- and that is also what they are modelling: a chain that
     * worked at 100 kHz and then, at the product speed, fails in one of the four ways the re-check
     * has to keep apart.
     *
     *   silence_after_retime      a clean NACK: nothing answers at that address any more
     *   probe_error_after_retime  the probe does not complete: the bus itself stopped working, and
     *                             nothing is known about whether a part is there
     *   read_error_after_retime   it ACKs and the id read then fails: something IS there and the
     *                             transport to it did not survive the retime -- NOT a wrong part
     *   wrong_id_after_retime     it answers, completely, as something else
     *
     * The last one is the only fault that means the part is wrong, which is why the fixture can
     * arm the other three separately: a model that could only produce silence and a wrong id could
     * not tell a transport fault reported as itself from one reported as a wrong part. */
    bool silence_after_retime{false};
    bool wrong_id_after_retime{false};
    bool probe_error_after_retime{false};
    bool read_error_after_retime{false};
    /* WHICH POSITION, 1-based, or 0 for "the first one reached". A fault that always lands on
     * position 1 cannot tell a loop that checks every position from one that checks only the
     * first. */
    uint8_t fault_position{0};
    bool retimed{false};

    /* What the re-check looked at, in order. The whole claim is PER POSITION, and a test that only
     * counts reads cannot tell six checks from one. */
    uint8_t rechecked_addr[kStages]{};
    size_t rechecked_count{0};

    void note_recheck(uint8_t addr7)
    {
        if (rechecked_count < kStages)
            rechecked_addr[rechecked_count++] = addr7;
    }

    /* 1-based index of the position this address occupies, for the fault selector. */
    bool is_fault_position(uint8_t addr7) const
    {
        if (fault_position == 0)
            return true;
        const int i{answerer(addr7)};
        return i >= 0 && static_cast<uint8_t>(i + 1) == fault_position;
    }

    void note(char c)
    {
        if (trace_len > 0 && trace[trace_len - 1] == c)
            return;
        if (trace_len + 1 >= sizeof trace)
            return;
        trace[trace_len++] = c;
        trace[trace_len] = '\0';
    }

    int answerer(uint8_t addr7) const
    {
        for (size_t i{0}; i < kStages; ++i) {
            if (present[i] && enabled[i] && addr[i] == addr7)
                return static_cast<int>(i);
        }
        return -1;
    }

    enm::probe_result probe(uint8_t addr7) override
    {
        note('p');
        if (retimed) {
            note_recheck(addr7);
            if (is_fault_position(addr7)) {
                if (probe_error_after_retime)
                    return {enm::probe_state::transport_error, -ETIMEDOUT};
                if (silence_after_retime)
                    return {enm::probe_state::nack, 0};
            }
        }
        if (error_probes_at_pulse_count >= 0 && pulses_seen == error_probes_at_pulse_count)
            return {enm::probe_state::transport_error, -EIO};
        return answerer(addr7) >= 0 ? enm::probe_result{enm::probe_state::ack, 0}
                                    : enm::probe_result{enm::probe_state::nack, 0};
    }

    int read_id(enm::model, uint8_t addr7, enm::id_bytes &out) override
    {
        note('r');
        const int i{answerer(addr7)};
        if (i < 0)
            return -ENXIO;
        /* IT ANSWERED AND THEN THE READ FAILED. Something is there; the transport to it did not
         * survive the retime. Not a wrong part. */
        if (retimed && read_error_after_retime && is_fault_position(addr7))
            return -EIO;

        /* Answered, as the wrong thing. The read SUCCEEDS -- that is what separates this from a
         * transport failure, and what makes it an identity disagreement rather than silence. */
        if (retimed && wrong_id_after_retime && is_fault_position(addr7)) {
            out = l7[i] ? kL4Id : kL7Id;
            return 0;
        }
        out = l7[i] ? kL7Id : kL4Id;
        return 0;
    }

    enm::readdress_result readdress(enm::model, uint8_t old7, uint8_t new7) override
    {
        note('d');
        const int i{answerer(old7)};
        if (i < 0)
            return {-ENXIO, enm::readdress_stage::collision};
        /* Every device currently answering the old address moves. That is what the bus does, and it
         * is how a merge becomes one address with two devices behind it. */
        for (size_t k{0}; k < kStages; ++k) {
            if (present[k] && enabled[k] && addr[k] == old7)
                addr[k] = new7;
        }
        (void)i;
        return {};
    }

    /* Called from inside the transaction, on the thread running it, while that thread holds
     * whatever locks the transaction took. The enumerator waits for sensor boot at a point where
     * every stage of the walk is under way, which makes this the one hook a test can use to
     * observe the chain's state MID-transaction rather than before or after it. Left null by
     * every case that does not need it. */
    void (*on_wait)(){nullptr};

    void wait(wait_reason) override
    {
        if (on_wait != nullptr)
            on_wait();
    }
};

inline enm::chain_spec provable_spec()
{
    enm::chain_spec s{lexxhard::tof_chain::dasher_spec()};
    s.at[2].role = enm::l4_role::front_left;
    s.at[3].role = enm::l4_role::rear_left;
    s.at[4].role = enm::l4_role::rear_right;
    s.at[5].role = enm::l4_role::front_right;
    return s;
}

}  // namespace fake
```

## src/l7_link_stubs.cpp
```c
/*
 * Copyright (c) 2026, LexxPluss Inc.
 * All rights reserved.
 *
 * SPDX-License-Identifier: BSD-2-Clause
 *
 * Link stubs for mapping-to-publisher tests, which inject samples directly.
 * No blob is available and vendor operations fail; this does not simulate ranging.
 */

#include <stddef.h>
#include <stdint.h>

extern "C" {
#include "vl53l7cx_api.h"
}

namespace lexxhard::tof_l7_runtime {

const uint8_t *firmware_data()
{
    return nullptr;   // no verified payload here, so open() refuses at the firmware stage
}

size_t firmware_size()
{
    return 0;
}

}  // namespace lexxhard::tof_l7_runtime

extern "C" {

void vl53l7cx_port_clear_error(void) {}

int vl53l7cx_port_error(void)
{
    return 0;
}

/* Latched by the real port when VL53L7CX_SwapBuffer() is handed a bad buffer. This suite links no
 * ULD, so nothing can trip it and "no fault" is the only honest answer. */
int vl53l7cx_port_argument_fault(void)
{
    return 0;
}

uint8_t vl53l7cx_init(VL53L7CX_Configuration *)
{
    return VL53L7CX_STATUS_ERROR;
}

uint8_t vl53l7cx_set_resolution(VL53L7CX_Configuration *, uint8_t)
{
    return VL53L7CX_STATUS_ERROR;
}

uint8_t vl53l7cx_set_ranging_frequency_hz(VL53L7CX_Configuration *, uint8_t)
{
    return VL53L7CX_STATUS_ERROR;
}

uint8_t vl53l7cx_start_ranging(VL53L7CX_Configuration *)
{
    return VL53L7CX_STATUS_ERROR;
}

uint8_t vl53l7cx_stop_ranging(VL53L7CX_Configuration *)
{
    return VL53L7CX_STATUS_ERROR;
}

uint8_t vl53l7cx_check_data_ready(VL53L7CX_Configuration *, uint8_t *is_ready)
{
    if (is_ready != nullptr)
        *is_ready = 0;
    return VL53L7CX_STATUS_ERROR;
}

uint8_t vl53l7cx_get_ranging_data(VL53L7CX_Configuration *, VL53L7CX_ResultsData *)
{
    return VL53L7CX_STATUS_ERROR;
}

}  // extern "C"
```

## src/test_wiring.cpp
```c
/*
 * Copyright (c) 2026, LexxPluss Inc.
 * All rights reserved.
 *
 * SPDX-License-Identifier: BSD-2-Clause
 *
 * THE BOOT SEQUENCE, AND THE DEFECT IT WAS WRITTEN FOR.
 *
 * The commissioning transaction used to be configured inside the `tof cliff prove` shell command,
 * so it was ready only on the path that goes through a keyboard. The downlink worker calls
 * tof_commissioning::prove() directly, so on a board nobody had typed at, every request was answered
 * `misconfigured` -- observed on dasher2 on 2026-09-21, three frames, neither I2C nor the enable
 * chain touched. Two suites covered the protocol across that seam and neither could see it, because
 * both replaced the real prove() with a fake that succeeds.
 *
 * So the case that matters here is the one that proves A BOOT ALONE IS ENOUGH: prove() has to work
 * without any prior call that a shell command would have made.
 */

#include <errno.h>

#include <zephyr/kernel.h>
#include <zephyr/ztest.h>

#include "fake_chain.hpp"
#include "tof_chain_controller.hpp"
#include "tof_cliff_runtime.hpp"
#include "tof_commission_wiring.hpp"
#include "tof_commissioning.hpp"
#include "tof_mapping_authority.hpp"

namespace au = lexxhard::tof_authority;
namespace acq = lexxhard::tof_acq;
namespace cm = lexxhard::tof_commissioning;
namespace rt = lexxhard::tof_cliff_runtime;
namespace wiring = lexxhard::tof_commission_wiring;

namespace {

constexpr rt::config kBootTiming{50, 20, 400, K_PRIO_PREEMPT(5), 21000, 3, 7};

K_THREAD_STACK_DEFINE(wiring_acq_stack, 2048);

fake::fake_chain wiring_chain{};

int wiring_set_bus_speed(cm::bus_speed)
{
    return 0;
}

int wiring_quiesce()
{
    return acq::try_stop();
}

int downlink_calls{0};
int downlink_result{0};

int fake_start_downlink(void *)
{
    ++downlink_calls;
    return downlink_result;
}

wiring::inputs complete_inputs()
{
    wiring::inputs in{};

    in.chain = &lexxhard::tof_chain_controller::chain_lock();
    in.ops = &wiring_chain;
    in.set_bus_speed = wiring_set_bus_speed;
    in.quiesce = wiring_quiesce;
    in.start_downlink = fake_start_downlink;
    return in;
}

void before_wiring(void *)
{
    rt::reset_for_test();
    rt::set_thread_stack_for_test(wiring_acq_stack, K_THREAD_STACK_SIZEOF(wiring_acq_stack));
    au::reset_epoch_history_for_test();
    wiring::reset_for_test();
    /* The configuration is a static that outlives a case, and another suite in this binary
     * configures it directly. Without this the headline case below would be reading what a
     * neighbour left behind -- which is the shape of the defect it exists to catch. */
    cm::reset_for_test();
    wiring_chain = fake::fake_chain{};
    downlink_calls = 0;
    downlink_result = 0;
}

}  // namespace

ZTEST_SUITE(tof_commission_wiring, NULL, NULL, before_wiring, NULL, NULL);

/* THE ONE THAT WOULD HAVE CAUGHT IT. Nothing here calls cm::init(): the boot sequence is the only
 * thing that has run, and a proof must already be possible. Before this wiring existed the proof
 * below returned `not_configured` on every board nobody had typed at. */
ZTEST(tof_commission_wiring, test_a_boot_alone_configures_the_transaction)
{
    const wiring::report r{wiring::boot(kBootTiming, complete_inputs())};

    zassert_equal(r.bootstrap_rc, 0, "");
    zassert_equal(r.configure_rc, 0, "the boot did not configure the commissioning transaction");
    zassert_equal(wiring::configure_status(), 0, "");

    /* And the proof really runs, rather than refusing for want of a configuration. Its verdict is
     * not the point -- what is checked is that it got past the configuration gate at all, with no
     * shell command anywhere in this test. */
    const cm::outcome o{cm::prove(7)};
    zassert_not_equal(o.failed_at, cm::stage::not_configured,
                      "prove() refused as unconfigured after a complete boot: the transaction is "
                      "still being set up by the shell command and not by the boot");
}

/* A FAILED BOOTSTRAP MUST NOT LEAVE A TRANSACTION THAT LOOKS READY. The runtime spec has static
 * storage and already holds the six product positions before bootstrap, so cm::init() against a
 * partial runtime would succeed -- and the first request would be the first anyone heard of it. */
ZTEST(tof_commission_wiring, test_a_failed_bootstrap_does_not_configure_the_transaction)
{
    rt::config bad{kBootTiming};
    bad.cliff_timing_budget_us = 0; /* refused by bootstrap, which names the property */

    const wiring::report r{wiring::boot(bad, complete_inputs())};

    zassert_not_equal(r.bootstrap_rc, 0, "");
    zassert_equal(r.configure_rc, r.bootstrap_rc,
                  "a failed bootstrap configured the transaction anyway");
    zassert_equal(cm::prove(7).failed_at, cm::stage::not_configured,
                  "the transaction was configured against a runtime that did not come up");
}

/* AND IT STILL STARTS THE DOWNLINK. This is the rule that looks wrong and is not: a board whose
 * bootstrap failed still has to ANSWER, or a host holding a durable pending request from a previous
 * boot retransmits into silence for ever. `misconfigured` is terminal and true. */
ZTEST(tof_commission_wiring, test_a_failed_bootstrap_does_not_silence_the_downlink)
{
    rt::config bad{kBootTiming};
    bad.cliff_timing_budget_us = 0;

    const wiring::report r{wiring::boot(bad, complete_inputs())};

    zassert_true(r.downlink_attempted,
                 "a failed bootstrap left the board unable to answer a commissioning request, "
                 "which is the worse failure");
    zassert_equal(downlink_calls, 1, "");
}

/* A missing piece is refused HERE, by name, rather than handed to init() as a config full of null
 * pointers -- which would also be refused, with one -EINVAL for any of five reasons. */
ZTEST(tof_commission_wiring, test_an_incomplete_wiring_is_refused_before_the_transaction)
{
    wiring::inputs in{complete_inputs()};
    in.set_bus_speed = nullptr;

    const wiring::report r{wiring::boot(kBootTiming, in)};

    zassert_equal(r.bootstrap_rc, 0, "the bootstrap is not what failed");
    zassert_equal(r.configure_rc, -EINVAL, "");
    zassert_equal(cm::prove(7).failed_at, cm::stage::not_configured, "");
    /* Still answering, for the same reason as above. */
    zassert_equal(downlink_calls, 1, "");
}

/* ONCE PER BOOT, and the second call must run NOTHING. What this holds is a bus resource: a second
 * can_add_rx_filter() on the request identifier does not fail, it delivers every request twice and
 * the board answers twice -- invisible inside the runtime and silent on the wire. */
ZTEST(tof_commission_wiring, test_a_second_boot_runs_nothing_and_says_so)
{
    zassert_false(wiring::boot(kBootTiming, complete_inputs()).already_run, "");
    zassert_equal(downlink_calls, 1, "");

    const wiring::report second{wiring::boot(kBootTiming, complete_inputs())};

    zassert_true(second.already_run, "a second boot was not refused");
    zassert_equal(downlink_calls, 1,
                  "a second boot started the downlink again: the receive filter would be installed "
                  "twice and every request answered twice");
    zassert_false(second.downlink_attempted, "");
    /* The status the first boot established is what a reader still gets. */
    zassert_equal(second.configure_rc, 0, "");
    zassert_equal(wiring::configure_status(), 0, "");
}

/* An image with no downlink leaves that step null and the sequence runs the half it has. The
 * preprocessor decides what exists; it does not decide the order. */
ZTEST(tof_commission_wiring, test_an_image_without_a_downlink_still_configures_the_transaction)
{
    wiring::inputs in{complete_inputs()};
    in.start_downlink = nullptr;

    const wiring::report r{wiring::boot(kBootTiming, in)};

    zassert_equal(r.configure_rc, 0, "");
    zassert_false(r.downlink_attempted, "");
    zassert_equal(downlink_calls, 0, "");
    zassert_equal(r.downlink_rc, 0, "an unattempted step reports no outcome");
}

/* The downlink's outcome is carried through unexamined. Deciding what the binding's three outcomes
 * mean is the caller's business, not an ordering question -- and a module that interpreted one here
 * would be the second opinion this project keeps having to delete. */
ZTEST(tof_commission_wiring, test_the_downlink_outcome_is_reported_not_interpreted)
{
    downlink_result = 1; /* answering_only */

    const wiring::report r{wiring::boot(kBootTiming, complete_inputs())};

    zassert_equal(r.downlink_rc, 1, "");
    zassert_true(r.downlink_attempted, "");
    /* And it did not change the transaction's verdict. */
    zassert_equal(r.configure_rc, 0, "");
}

/* tof_cliff_runtime.cpp marks the watchdog's baseline from inside the keying commit, so linking it
 * needs this symbol. Stubbed rather than satisfied by linking the real feeder, which would pull the
 * task watchdog, the tombstone and its DTCM reservation into a suite about commissioning. What the
 * feeder does with the flag is tests/tof_watchdog_feeder's business; that it is set at the commit
 * is a property of the call site, which is one line in a file this suite already links. */
namespace lexxhard::tof_watchdog_feeder {

bool baseline_point_set{false};

void set_baseline_point(bool ready)
{
    baseline_point_set = ready;
}

/* Recorded rather than ignored, because the sequence is the claim: the quiesce says stopped and a
 * successful start says expected again, and a suite that only counted the calls could not tell
 * those two apart. Starts at `true` because the feeder's own default is expected. */
bool acquisition_expected{true};

void set_acquisition_expected(bool expected)
{
    acquisition_expected = expected;
}

}  // namespace lexxhard::tof_watchdog_feeder
```
