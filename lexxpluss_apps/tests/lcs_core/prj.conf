## CMakeLists.txt
```
# Copyright (c) 2026, LexxPluss Inc.
# All rights reserved.
#
# Redistribution and use in source and binary forms, with or without
# modification, are permitted provided that the following conditions are met:
#
# 1. Redistributions of source code must retain the above copyright notice,
#    this list of conditions and the following disclaimer.
# 2. Redistributions in binary form must reproduce the above copyright notice,
#    this list of conditions and the following disclaimer in the documentation
#    and/or other materials provided with the distribution.
#
# THIS SOFTWARE IS PROVIDED BY THE COPYRIGHT HOLDERS AND CONTRIBUTORS "AS IS" AND
# ANY EXPRESS OR IMPLIED WARRANTIES, INCLUDING, BUT NOT LIMITED TO, THE IMPLIED
# WARRANTIES OF MERCHANTABILITY AND FITNESS FOR A PARTICULAR PURPOSE ARE
# DISCLAIMED. IN NO EVENT SHALL THE COPYRIGHT OWNER OR CONTRIBUTORS BE LIABLE FOR
# ANY DIRECT, INDIRECT, INCIDENTAL, SPECIAL, EXEMPLARY, OR CONSEQUENTIAL DAMAGES
# (INCLUDING, BUT NOT LIMITED TO, PROCUREMENT OF SUBSTITUTE GOODS OR SERVICES;
# LOSS OF USE, DATA, OR PROFITS; OR BUSINESS INTERRUPTION) HOWEVER CAUSED AND
# ON ANY THEORY OF LIABILITY, WHETHER IN CONTRACT, STRICT LIABILITY, OR TORT
# (INCLUDING NEGLIGENCE OR OTHERWISE) ARISING IN ANY WAY OUT OF THE USE OF THIS
# SOFTWARE, EVEN IF ADVISED OF THE POSSIBILITY OF SUCH DAMAGE.

cmake_minimum_required(VERSION 3.20.0)

find_package(Zephyr REQUIRED HINTS $ENV{ZEPHYR_BASE})
project(lcs_core_test)

set(APP_SRC_DIR ${CMAKE_CURRENT_SOURCE_DIR}/../../src)

target_sources(app PRIVATE
    src/test_action_downlink.cpp
    src/test_crc16.cpp
    src/test_forward_queue.cpp
    src/test_frame.cpp
    src/test_rx.cpp
    src/test_rx_action_shaped.cpp
    src/test_rx_model.cpp
    src/test_rx_nested.cpp
    src/test_rx_stream.cpp
)
target_include_directories(app PRIVATE ${APP_SRC_DIR})
```

## prj.conf
```kconfig
CONFIG_ZTEST=y
CONFIG_CPP=y
CONFIG_STD_CPP20=y
CONFIG_REQUIRES_FULL_LIBCPP=y
CONFIG_ZTEST_STACK_SIZE=8192
CONFIG_MAIN_STACK_SIZE=8192
```

## src/lcs_core_test_support.hpp
```c
/*
 * Copyright (c) 2026, LexxPluss Inc.
 * All rights reserved.
 *
 * Redistribution and use in source and binary forms, with or without
 * modification, are permitted provided that the following conditions are met:
 *
 * 1. Redistributions of source code must retain the above copyright notice,
 *    this list of conditions and the following disclaimer.
 * 2. Redistributions in binary form must reproduce the above copyright notice,
 *    this list of conditions and the following disclaimer in the documentation
 *    and/or other materials provided with the distribution.
 *
 * THIS SOFTWARE IS PROVIDED BY THE COPYRIGHT HOLDERS AND CONTRIBUTORS "AS IS" AND
 * ANY EXPRESS OR IMPLIED WARRANTIES, INCLUDING, BUT NOT LIMITED TO, THE IMPLIED
 * WARRANTIES OF MERCHANTABILITY AND FITNESS FOR A PARTICULAR PURPOSE ARE
 * DISCLAIMED. IN NO EVENT SHALL THE COPYRIGHT OWNER OR CONTRIBUTORS BE LIABLE FOR
 * ANY DIRECT, INDIRECT, INCIDENTAL, SPECIAL, EXEMPLARY, OR CONSEQUENTIAL DAMAGES
 * (INCLUDING, BUT NOT LIMITED TO, PROCUREMENT OF SUBSTITUTE GOODS OR SERVICES;
 * LOSS OF USE, DATA, OR PROFITS; OR BUSINESS INTERRUPTION) HOWEVER CAUSED AND
 * ON ANY THEORY OF LIABILITY, WHETHER IN CONTRACT, STRICT LIABILITY, OR TORT
 * (INCLUDING NEGLIGENCE OR OTHERWISE) ARISING IN ANY WAY OUT OF THE USE OF THIS
 * SOFTWARE, EVEN IF ADVISED OF THE POSSIBILITY OF SUCH DAMAGE.
 */

#pragma once

#include <algorithm>
#include <array>
#include <cstddef>
#include <cstdint>
#include <initializer_list>
#include <optional>

#include <zephyr/ztest.h>

#include "lcs_frame.hpp"
#include "lcs_rx.hpp"

namespace lcs_test {

using lexxhard::lcs::RxStats;
using lexxhard::lcs::Uplink;
using lexxhard::lcs::UplinkReceiver;

/*
 * The expected values of the tests do not come from the code under test: the CRC is a table-driven version
 * (the code under test is bitwise), the frames are built with explicit indices, and the deadline is computed in
 * microseconds with literals (500000 bps: 10 bits per byte is 20 us; the margin is 100 %; the drain latency is
 * 500 us; one tick is 100 us).
 */

struct Bytes {
    std::array<uint8_t, 64> data{};
    size_t size{0};

    void push(const uint8_t byte)
    {
        zassert_true(size < data.size(), "test frame too long");
        data[size++] = byte;
    }

    void append(const Bytes &other, const size_t from, const size_t to)
    {
        for (size_t i{from}; i < to; ++i) {
            push(other.data[i]);
        }
    }
};

inline uint16_t ref_crc16(const Bytes &bytes, const size_t count)
{
    static const std::array<uint16_t, 256> table = [] {
        std::array<uint16_t, 256> t{};
        for (uint32_t i{0}; i < 256U; ++i) {
            uint32_t r{i << 8};
            for (int bit{0}; bit < 8; ++bit) {
                r = (r & 0x8000U) != 0U ? ((r << 1) ^ 0x1021U) & 0xFFFFU : (r << 1) & 0xFFFFU;
            }
            t[i] = static_cast<uint16_t>(r);
        }
        return t;
    }();
    uint32_t crc{0xFFFFU};
    for (size_t i{0}; i < count; ++i) {
        crc = ((crc << 8) & 0xFFFFU) ^ table[((crc >> 8) ^ bytes.data[i]) & 0xFFU];
    }
    return static_cast<uint16_t>(crc);
}

/* True when the last two bytes of the first len bytes are the CRC of the bytes before them. */
inline bool ref_window_valid(const Bytes &bytes, const size_t len)
{
    const uint16_t stored{static_cast<uint16_t>((bytes.data[len - 2] << 8) | bytes.data[len - 1])};
    return ref_crc16(bytes, len - 2) == stored;
}

inline Bytes with_crc(Bytes body)
{
    const uint16_t crc{ref_crc16(body, body.size)};
    body.push(static_cast<uint8_t>(crc >> 8));
    body.push(static_cast<uint8_t>(crc & 0xFFU));
    return body;
}

inline Bytes uplink_frame(const uint8_t sender, const uint8_t status, const uint32_t ch1, const uint32_t ch2)
{
    Bytes body;
    body.push(0x4B);
    body.push(12);
    body.push(sender);
    body.push(status);
    body.push(static_cast<uint8_t>(ch1 >> 16));
    body.push(static_cast<uint8_t>(ch1 >> 8));
    body.push(static_cast<uint8_t>(ch1));
    body.push(static_cast<uint8_t>(ch2 >> 16));
    body.push(static_cast<uint8_t>(ch2 >> 8));
    body.push(static_cast<uint8_t>(ch2));
    return with_crc(body);
}

inline Bytes downlink_frame(const uint8_t target, const uint8_t cmd, const uint16_t param)
{
    Bytes body;
    body.push(0x4B);
    body.push(8);
    body.push(target);
    body.push(cmd);
    body.push(static_cast<uint8_t>(param >> 8));
    body.push(static_cast<uint8_t>(param & 0xFFU));
    return with_crc(body);
}

/* Frame of total_len bytes with an arbitrary LEN byte and a valid CRC; the filler never equals the SOF. */
inline Bytes raw_frame(const size_t total_len, const uint8_t len_byte, const uint8_t id, const uint8_t byte3)
{
    Bytes body;
    body.push(0x4B);
    body.push(len_byte);
    body.push(id);
    body.push(byte3);
    for (size_t i{4}; i < total_len - 2; ++i) {
        body.push(static_cast<uint8_t>(0x20 + i));
    }
    return with_crc(body);
}

/* The two reference uplinks (ID0 and ID1) and a downlink to ID1 (a POLL-shaped command). */
inline Bytes frame_id0()
{
    return uplink_frame(0, 0xC0, 0x123456, 0x654321);
}

inline Bytes frame_id1()
{
    return uplink_frame(1, 0xC0, 0x0ABCDE, 0xFEDCBA);
}

inline Bytes frame_downlink()
{
    return downlink_frame(1, 0x10, 0x0000);
}

inline Uplink uplink_of(const uint8_t sender, const uint8_t status, const uint32_t ch1, const uint32_t ch2)
{
    return Uplink{sender, status,
                  {static_cast<uint8_t>(ch1 >> 16), static_cast<uint8_t>(ch1 >> 8), static_cast<uint8_t>(ch1)},
                  {static_cast<uint8_t>(ch2 >> 16), static_cast<uint8_t>(ch2 >> 8), static_cast<uint8_t>(ch2)}};
}

inline Uplink uplink_id0()
{
    return uplink_of(0, 0xC0, 0x123456, 0x654321);
}

inline Uplink uplink_id1()
{
    return uplink_of(1, 0xC0, 0x0ABCDE, 0xFEDCBA);
}

inline bool same_uplink(const Uplink &a, const Uplink &b)
{
    return a.sender_id == b.sender_id && a.status == b.status && a.ch1 == b.ch1 && a.ch2 == b.ch2;
}

/* Deadline of a frame of len bytes in ticks, from the formula in microseconds (see the comment above). */
inline uint32_t oracle_deadline_ticks(const uint32_t len)
{
    const uint32_t frame_us{len * 20U};
    const uint32_t scaled_us100{(frame_us + 20U) * 200U + 100U * 500U};
    return (scaled_us100 + 9999U) / 10000U;
}

struct Expect {
    uint32_t delivered{0};
    uint32_t crc_error{0};
    uint32_t sof_mismatch{0};
    uint32_t timeout{0};
    uint32_t uart_error{0};
    uint32_t foreign_downlink{0};
    uint32_t unknown_sender{0};
};

inline void check_stats(const RxStats &s, const Expect &e)
{
    zassert_equal(s.delivered, e.delivered, "delivered");
    zassert_equal(s.crc_error, e.crc_error, "crc_error");
    zassert_equal(s.sof_mismatch, e.sof_mismatch, "sof_mismatch");
    zassert_equal(s.timeout, e.timeout, "timeout");
    zassert_equal(s.uart_error, e.uart_error, "uart_error");
    zassert_equal(s.foreign_downlink, e.foreign_downlink, "foreign_downlink");
    zassert_equal(s.unknown_sender, e.unknown_sender, "unknown_sender");
}

/* Every counter other than sof_mismatch; the stray bytes after a dropped LEN are counted there (see lcs_rx.hpp). */
inline void check_stats_except_sof(const RxStats &s, Expect e)
{
    e.sof_mismatch = s.sof_mismatch;
    check_stats(s, e);
}

/* Xorshift generator for the seeded stream tests; the sequence is part of the test and must not change. */
struct Prng {
    uint32_t state;

    uint32_t next()
    {
        state ^= state << 13;
        state ^= state >> 17;
        state ^= state << 5;
        return state;
    }

    uint32_t below(const uint32_t limit)
    {
        return next() % limit;
    }
};

/*
 * Reference model of the candidate set, written independently of UplinkReceiver: it keeps the whole byte history
 * by absolute index (not a ring and a seen counter) and the start index of every candidate. kS21 selects the rule:
 * false is the rule before the nested candidate (every CRC mismatch and every deadline counts), true is the rule of
 * the nested candidate implemented literally:
 *  - a candidate that starts while ANY older candidate in progress (nested or not) has a known LEN and its span
 *    min(LEN, 12) covers the new SOF index is flagged; the LEN byte of the older candidate is applied first;
 *  - a flagged candidate never counts crc_error or timeout (mismatch, deadline, eviction), a match delivers;
 *  - the flag stays when the older candidate leaves; on_uart_error() and reset() clear every candidate.
 */
template <bool kS21>
class RefReceiver {
public:
    std::optional<Uplink> on_byte(const uint8_t byte, const uint32_t tick)
    {
        expire(tick);
        const bool idle{count_ == 0};
        const size_t index{next_index_++};
        history_[index % history_.size()] = byte;
        apply_len_byte(index, byte);
        if (byte == kSofByte) {
            start(index, tick);
        } else if (idle) {
            ++stats_.sof_mismatch;
        }
        return evaluate(index);
    }

    void expire(const uint32_t tick)
    {
        size_t kept{0};
        for (size_t i{0}; i < count_; ++i) {
            if (tick - cands_[i].tick > deadline(cands_[i])) {
                give_up(cands_[i]);
            } else {
                cands_[kept++] = cands_[i];
            }
        }
        count_ = kept;
    }

    void on_uart_error(const uint32_t /* tick */)
    {
        count_ = 0;
        ++stats_.uart_error;
    }

    void reset()
    {
        count_ = 0;
    }

    const RxStats &stats() const
    {
        return stats_;
    }

private:
    static constexpr uint8_t kSofByte{0x4B};
    static constexpr size_t kMinLen{4};
    static constexpr size_t kMaxLenValue{12};
    static constexpr size_t kOversize{13};
    static constexpr size_t kTableSize{12};
    static constexpr size_t kLenUnknown{0};

    struct Cand {
        size_t start;
        uint32_t tick;
        size_t len;
        bool flagged;
    };

    static uint32_t deadline(const Cand &cand)
    {
        const size_t bytes{cand.len == kLenUnknown ? size_t{2} : std::min(cand.len, kMaxLenValue)};
        return oracle_deadline_ticks(static_cast<uint32_t>(bytes));
    }

    /* A flagged candidate is dropped without a counter; the older candidate counts the fault. */
    void give_up(const Cand &cand)
    {
        if (!cand.flagged) {
            ++stats_.timeout;
        }
    }

    void erase(const size_t index)
    {
        for (size_t i{index + 1}; i < count_; ++i) {
            cands_[i - 1] = cands_[i];
        }
        --count_;
    }

    void apply_len_byte(const size_t index, const uint8_t byte)
    {
        size_t kept{0};
        for (size_t i{0}; i < count_; ++i) {
            Cand cand{cands_[i]};
            if (index == cand.start + 1) {
                if (byte < kMinLen) {
                    continue;
                }
                cand.len = byte > kMaxLenValue ? kOversize : byte;
            }
            cands_[kept++] = cand;
        }
        count_ = kept;
    }

    void start(const size_t index, const uint32_t tick)
    {
        if (count_ == cands_.size()) {
            give_up(cands_[0]);
            erase(0);
        }
        bool flagged{false};
        if constexpr (kS21) {
            for (size_t i{0}; i < count_; ++i) {
                const Cand &older{cands_[i]};
                if (older.len != kLenUnknown && index - older.start < std::min(older.len, kMaxLenValue)) {
                    flagged = true;
                }
            }
        }
        cands_[count_++] = Cand{index, tick, kLenUnknown, flagged};
    }

    std::optional<Uplink> evaluate(const size_t index)
    {
        size_t i{0};
        while (i < count_) {
            const Cand cand{cands_[i]};
            if (cand.len < kMinLen || cand.len > kMaxLenValue || index + 1 - cand.start != cand.len) {
                ++i;
                continue;
            }
            Bytes window;
            for (size_t k{0}; k < cand.len; ++k) {
                window.push(history_[(cand.start + k) % history_.size()]);
            }
            if (!ref_window_valid(window, cand.len)) {
                if (!cand.flagged) {
                    ++stats_.crc_error;
                }
                erase(i);
                continue;
            }
            count_ = i;
            return classify(window, cand.len);
        }
        return std::nullopt;
    }

    std::optional<Uplink> classify(const Bytes &window, const size_t len)
    {
        const bool uplink_direction{(window.data[3] & 0x80U) != 0U};
        if (len == 8 && !uplink_direction) {
            ++stats_.foreign_downlink;
        } else if (len == 12 && uplink_direction) {
            if (window.data[2] >= 2) {
                ++stats_.unknown_sender;
                return std::nullopt;
            }
            ++stats_.delivered;
            return Uplink{window.data[2],
                          window.data[3],
                          {window.data[4], window.data[5], window.data[6]},
                          {window.data[7], window.data[8], window.data[9]}};
        }
        return std::nullopt;
    }

    RxStats stats_{};
    std::array<Cand, kTableSize> cands_{};
    size_t count_{0};
    std::array<uint8_t, 64> history_{};
    size_t next_index_{0};
};

/* A receiver (the code under test or a reference model) with a record of every uplink it returned. */
template <typename Receiver>
struct BasicRig {
    Receiver rx{};
    std::array<Uplink, 256> out{};
    size_t out_count{0};

    void feed_byte(const uint8_t byte, const uint32_t tick)
    {
        const auto result{rx.on_byte(byte, tick)};
        if (result.has_value()) {
            zassert_true(out_count < out.size(), "too many uplinks");
            out[out_count++] = *result;
        }
    }

    /* The bytes in [from, to) of a frame, all drained at one tick. */
    void feed(const Bytes &bytes, const uint32_t tick, const size_t from, const size_t to)
    {
        for (size_t i{from}; i < to; ++i) {
            feed_byte(bytes.data[i], tick);
        }
    }

    void feed(const Bytes &bytes, const uint32_t tick)
    {
        feed(bytes, tick, 0, bytes.size);
    }

    void expect_last(const Uplink &uplink, const size_t count) const
    {
        zassert_equal(out_count, count, "returned uplinks");
        zassert_true(same_uplink(out[count - 1], uplink), "returned uplink fields");
    }
};

using Rig = BasicRig<UplinkReceiver>;

template <bool kS21>
using ModelRig = BasicRig<RefReceiver<kS21>>;

/* The uplink that a CRC-valid 12 B uplink frame carries. */
inline Uplink uplink_of_frame(const Bytes &frame)
{
    return Uplink{frame.data[2],
                  frame.data[3],
                  {frame.data[4], frame.data[5], frame.data[6]},
                  {frame.data[7], frame.data[8], frame.data[9]}};
}

/* One byte of a planned stream to be changed: the stream is built by pattern() and then adjusted. */
struct Override {
    size_t index;
    uint8_t value;
};

/*
 * Stream of total bytes. Index 0 is the SOF of the older candidate and index 1 its LEN byte (len_byte); the other
 * bytes are fillers that never equal the SOF, except those set by overrides.
 */
inline Bytes pattern(const size_t total, const uint8_t len_byte, const std::initializer_list<Override> overrides = {})
{
    Bytes bytes;
    for (size_t i{0}; i < total; ++i) {
        bytes.push(i == 0 ? uint8_t{0x4B} : (i == 1 ? len_byte : static_cast<uint8_t>(0x50 + i)));
    }
    for (const Override &o : overrides) {
        zassert_true(o.index < total, "override inside the stream");
        bytes.data[o.index] = o.value;
    }
    return bytes;
}

/* Copies a whole frame into a planned stream at index at. */
inline void overlay(Bytes &stream, const size_t at, const Bytes &frame)
{
    zassert_true(at + frame.size <= stream.size, "overlay inside the stream");
    for (size_t k{0}; k < frame.size; ++k) {
        stream.data[at + k] = frame.data[k];
    }
}

/* The window of len bytes that starts at index start of a planned stream has (or has not) a matching CRC. */
inline void assert_window(const Bytes &stream, const size_t start, const size_t len, const bool valid)
{
    zassert_true(start + len <= stream.size, "window inside the stream");
    Bytes window;
    window.append(stream, start, start + len);
    zassert_equal(ref_window_valid(window, len), valid, "CRC of the window at %u, len %u",
                  static_cast<unsigned>(start), static_cast<unsigned>(len));
}

/*
 * A planned stream and a receiver that is fed from it in steps; every step names the tick at which its bytes are
 * drained.
 */
template <typename RigT>
struct Tape {
    Bytes planned;
    size_t cursor{0};
    RigT rig{};

    explicit Tape(const Bytes &stream) : planned{stream}
    {
    }

    /* Drains the planned bytes up to, excluding, index end at one tick. */
    void feed_until(const size_t end, const uint32_t tick)
    {
        zassert_true(end >= cursor && end <= planned.size, "tape step");
        while (cursor < end) {
            rig.feed_byte(planned.data[cursor++], tick);
        }
    }

    void feed_all(const uint32_t tick)
    {
        feed_until(planned.size, tick);
    }

    void expire(const uint32_t tick)
    {
        rig.rx.expire(tick);
    }

    void expect(const Expect &e) const
    {
        check_stats(rig.rx.stats(), e);
    }
};

}
```

## src/test_action_downlink.cpp
```c
/*
 * Copyright (c) 2026, LexxPluss Inc.
 * All rights reserved.
 *
 * Redistribution and use in source and binary forms, with or without
 * modification, are permitted provided that the following conditions are met:
 *
 * 1. Redistributions of source code must retain the above copyright notice,
 *    this list of conditions and the following disclaimer.
 * 2. Redistributions in binary form must reproduce the above copyright notice,
 *    this list of conditions and the following disclaimer in the documentation
 *    and/or other materials provided with the distribution.
 *
 * THIS SOFTWARE IS PROVIDED BY THE COPYRIGHT HOLDERS AND CONTRIBUTORS "AS IS" AND
 * ANY EXPRESS OR IMPLIED WARRANTIES, INCLUDING, BUT NOT LIMITED TO, THE IMPLIED
 * WARRANTIES OF MERCHANTABILITY AND FITNESS FOR A PARTICULAR PURPOSE ARE
 * DISCLAIMED. IN NO EVENT SHALL THE COPYRIGHT OWNER OR CONTRIBUTORS BE LIABLE FOR
 * ANY DIRECT, INDIRECT, INCIDENTAL, SPECIAL, EXEMPLARY, OR CONSEQUENTIAL DAMAGES
 * (INCLUDING, BUT NOT LIMITED TO, PROCUREMENT OF SUBSTITUTE GOODS OR SERVICES;
 * LOSS OF USE, DATA, OR PROFITS; OR BUSINESS INTERRUPTION) HOWEVER CAUSED AND
 * ON ANY THEORY OF LIABILITY, WHETHER IN CONTRACT, STRICT LIABILITY, OR TORT
 * (INCLUDING NEGLIGENCE OR OTHERWISE) ARISING IN ANY WAY OUT OF THE USE OF THIS
 * SOFTWARE, EVEN IF ADVISED OF THE POSSIBILITY OF SUCH DAMAGE.
 */

#include <array>
#include <cstddef>
#include <cstdint>

#include <zephyr/ztest.h>

#include "lcs_core_test_support.hpp"
#include "lcs_crc16.hpp"
#include "lcs_frame.hpp"

using namespace lcs_test;
namespace lcs = lexxhard::lcs;

ZTEST_SUITE(lcs_action_downlink, NULL, NULL, NULL, NULL, NULL);

using Frame8 = std::array<uint8_t, 8>;

struct Golden {
    uint8_t target;
    uint8_t cmd;
    uint16_t param;
    Frame8 frame;
};

/* Fixed vectors: every other implementation of the ACTION downlink must reproduce these bytes. */
static constexpr std::array<Golden, 9> kTargetCmdGoldens{{
    {0x00, 0x48, 0x0000, {0x4B, 0x08, 0x00, 0x48, 0x00, 0x00, 0x11, 0x83}},
    {0x01, 0x48, 0x0000, {0x4B, 0x08, 0x01, 0x48, 0x00, 0x00, 0x67, 0x37}},
    {0xFF, 0x48, 0x0000, {0x4B, 0x08, 0xFF, 0x48, 0x00, 0x00, 0x5A, 0x20}},
    {0x00, 0x50, 0x0000, {0x4B, 0x08, 0x00, 0x50, 0x00, 0x00, 0xFB, 0x41}},
    {0x01, 0x50, 0x0000, {0x4B, 0x08, 0x01, 0x50, 0x00, 0x00, 0x8D, 0xF5}},
    {0xFF, 0x50, 0x0000, {0x4B, 0x08, 0xFF, 0x50, 0x00, 0x00, 0xB0, 0xE2}},
    {0x00, 0x68, 0x0000, {0x4B, 0x08, 0x00, 0x68, 0x00, 0x00, 0x97, 0x45}},
    {0x01, 0x68, 0x0000, {0x4B, 0x08, 0x01, 0x68, 0x00, 0x00, 0xE1, 0xF1}},
    {0xFF, 0x68, 0x0000, {0x4B, 0x08, 0xFF, 0x68, 0x00, 0x00, 0xDC, 0xE6}},
}};

static constexpr std::array<Golden, 5> kParamGoldens{{
    {0x00, 0x48, 0x0000, {0x4B, 0x08, 0x00, 0x48, 0x00, 0x00, 0x11, 0x83}},
    {0x00, 0x48, 0x00FF, {0x4B, 0x08, 0x00, 0x48, 0x00, 0xFF, 0x0F, 0x73}},
    {0x00, 0x48, 0xFF00, {0x4B, 0x08, 0x00, 0x48, 0xFF, 0x00, 0x12, 0x7C}},
    {0x00, 0x48, 0xFFFF, {0x4B, 0x08, 0x00, 0x48, 0xFF, 0xFF, 0x0C, 0x8C}},
    {0x00, 0x48, 0x1234, {0x4B, 0x08, 0x00, 0x48, 0x12, 0x34, 0x02, 0x45}},
}};

static constexpr Frame8 kCrcFrame{0x4B, 0x08, 0x00, 0x48, 0x12, 0x34, 0x02, 0x45};

static Bytes to_bytes(const Frame8 &array)
{
    Bytes bytes;
    for (const uint8_t byte : array) {
        bytes.push(byte);
    }
    return bytes;
}

static void check_golden(const Golden &golden)
{
    const Frame8 actual{lcs::encode_downlink(golden.target, golden.cmd, golden.param)};
    zassert_equal(actual, golden.frame);
    zassert_equal(actual[4], static_cast<uint8_t>(golden.param >> 8));
    zassert_equal(actual[5], static_cast<uint8_t>(golden.param & 0xFFU));
    const uint16_t stored{static_cast<uint16_t>((actual[6] << 8) | actual[7])};
    zassert_equal(stored, ref_crc16(to_bytes(actual), 6));
}

static_assert(lcs::encode_downlink(0x00, 0x48, 0x0000) ==
                  std::array<uint8_t, 8>{0x4B, 0x08, 0x00, 0x48, 0x00, 0x00, 0x11, 0x83},
              "the encoder must stay a constant expression with the golden bytes");

ZTEST(lcs_action_downlink, test_sc04_01_golden_target_cmd)
{
    for (const Golden &golden : kTargetCmdGoldens) {
        check_golden(golden);
    }
}

ZTEST(lcs_action_downlink, test_sc04_02_param_big_endian)
{
    for (const Golden &golden : kParamGoldens) {
        check_golden(golden);
    }
}

/* The CRC bytes of the encoded frame must change when any single bit of target, cmd or param changes. */
static void expect_crc_changes(const uint8_t target, const uint8_t cmd, const uint16_t param, const unsigned bit)
{
    const Frame8 frame{lcs::encode_downlink(target, cmd, param)};
    zassert_equal(frame[2], target, "target reaches byte 2");
    zassert_equal(frame[3], cmd, "cmd reaches byte 3");
    zassert_equal(frame[4], static_cast<uint8_t>(param >> 8), "param high reaches byte 4");
    zassert_equal(frame[5], static_cast<uint8_t>(param & 0xFFU), "param low reaches byte 5");
    const uint16_t stored{static_cast<uint16_t>((frame[6] << 8) | frame[7])};
    zassert_not_equal(stored, 0x0245, "a flip of input bit %u went unnoticed by the CRC", bit);
}

ZTEST(lcs_action_downlink, test_sc04_03_crc_covers_target_cmd_and_param)
{
    zassert_equal(lcs::encode_downlink(0x00, 0x48, 0x1234), kCrcFrame);
    for (unsigned bit{0}; bit < 8; ++bit) {
        expect_crc_changes(static_cast<uint8_t>(0x00U ^ (1U << bit)), 0x48, 0x1234, bit);
        expect_crc_changes(0x00, static_cast<uint8_t>(0x48U ^ (1U << bit)), 0x1234, bit);
    }
    for (unsigned bit{0}; bit < 16; ++bit) {
        expect_crc_changes(0x00, 0x48, static_cast<uint16_t>(0x1234U ^ (1U << bit)), bit);
    }
}

ZTEST(lcs_action_downlink, test_sc04_04_stateless_constexpr)
{
    const Frame8 first{lcs::encode_downlink(0x00, 0x48, 0x0000)};
    const Frame8 second{lcs::encode_downlink(0x00, 0x48, 0x0000)};
    zassert_equal(first, second);
    zassert_equal(first, kTargetCmdGoldens[0].frame);
}
```

## src/test_crc16.cpp
```c
/*
 * Copyright (c) 2026, LexxPluss Inc.
 * All rights reserved.
 *
 * Redistribution and use in source and binary forms, with or without
 * modification, are permitted provided that the following conditions are met:
 *
 * 1. Redistributions of source code must retain the above copyright notice,
 *    this list of conditions and the following disclaimer.
 * 2. Redistributions in binary form must reproduce the above copyright notice,
 *    this list of conditions and the following disclaimer in the documentation
 *    and/or other materials provided with the distribution.
 *
 * THIS SOFTWARE IS PROVIDED BY THE COPYRIGHT HOLDERS AND CONTRIBUTORS "AS IS" AND
 * ANY EXPRESS OR IMPLIED WARRANTIES, INCLUDING, BUT NOT LIMITED TO, THE IMPLIED
 * WARRANTIES OF MERCHANTABILITY AND FITNESS FOR A PARTICULAR PURPOSE ARE
 * DISCLAIMED. IN NO EVENT SHALL THE COPYRIGHT OWNER OR CONTRIBUTORS BE LIABLE FOR
 * ANY DIRECT, INDIRECT, INCIDENTAL, SPECIAL, EXEMPLARY, OR CONSEQUENTIAL DAMAGES
 * (INCLUDING, BUT NOT LIMITED TO, PROCUREMENT OF SUBSTITUTE GOODS OR SERVICES;
 * LOSS OF USE, DATA, OR PROFITS; OR BUSINESS INTERRUPTION) HOWEVER CAUSED AND
 * ON ANY THEORY OF LIABILITY, WHETHER IN CONTRACT, STRICT LIABILITY, OR TORT
 * (INCLUDING NEGLIGENCE OR OTHERWISE) ARISING IN ANY WAY OUT OF THE USE OF THIS
 * SOFTWARE, EVEN IF ADVISED OF THE POSSIBILITY OF SUCH DAMAGE.
 */

#include <array>
#include <cstddef>
#include <cstdint>

#include <zephyr/ztest.h>

#include "lcs_core_test_support.hpp"
#include "lcs_crc16.hpp"

using namespace lcs_test;
namespace lcs = lexxhard::lcs;

ZTEST_SUITE(lcs_core_crc16, NULL, NULL, NULL, NULL, NULL);

/* Bit-wise reference step: polynomial 0x1021, no reflection. */
static uint16_t ref_step_bitwise(const uint16_t reg, const uint8_t byte, const uint32_t poly = 0x1021U)
{
    uint32_t r{static_cast<uint32_t>(reg) ^ (static_cast<uint32_t>(byte) << 8)};
    for (int bit{0}; bit < 8; ++bit) {
        r = (r & 0x8000U) != 0U ? ((r << 1) ^ poly) & 0xFFFFU : (r << 1) & 0xFFFFU;
    }
    return static_cast<uint16_t>(r);
}

/* Deliberately wrong step (polynomial 0x1022): the negative control of the exhaustive comparison. */
static uint16_t wrong_step(const uint16_t reg, const uint8_t byte)
{
    return ref_step_bitwise(reg, byte, 0x1022U);
}

struct StepComparison {
    uint32_t compared{0};
    bool mismatch{false};
    uint32_t first_reg{0};
    uint32_t first_byte{0};
};

/* Compares the step under test with the bit-wise step for every (register, byte); stops at the first mismatch. */
template <typename Step>
static StepComparison compare_all(const Step &step)
{
    StepComparison result{};
    for (uint32_t reg{0}; reg < 0x10000U; ++reg) {
        for (uint32_t byte{0}; byte < 0x100U; ++byte) {
            const auto r{static_cast<uint16_t>(reg)};
            const auto b{static_cast<uint8_t>(byte)};
            ++result.compared;
            if (step(r, b) != ref_step_bitwise(r, b)) {
                result.mismatch = true;
                result.first_reg = reg;
                result.first_byte = byte;
                return result;
            }
        }
    }
    return result;
}

ZTEST(lcs_core_crc16, test_lcs_core_crc2_step_matches_bitwise_exhaustive)
{
    const auto step_under_test = [](const uint16_t reg, const uint8_t byte) { return lcs::crc16_step(reg, byte); };
    const StepComparison result{compare_all(step_under_test)};
    zassert_false(result.mismatch, "step differs from bit-wise at register 0x%04x byte 0x%02x", result.first_reg,
                  result.first_byte);
    zassert_equal(result.compared, 0x1000000U, "compared %u pairs", result.compared);

    /* Negative control: the comparison must detect a wrong step. */
    const StepComparison control{compare_all(wrong_step)};
    zassert_true(control.mismatch, "the comparison did not detect a wrong step");
}

ZTEST(lcs_core_crc16, test_lcs_core_crc3_fold_matches_reference)
{
    for (size_t len{0}; len <= 12; ++len) {
        Bytes bytes{};
        for (size_t i{0}; i < len; ++i) {
            /* Deterministic bytes; 0x00, 0xFF and 0x4B appear at fixed positions. */
            static constexpr std::array<uint8_t, 12> kPattern{0x4B, 0x00, 0xFF, 0x12, 0x80, 0x4B,
                                                              0xFF, 0x00, 0xA5, 0x5A, 0x01, 0x7F};
            bytes.push(kPattern[i]);
        }
        uint16_t folded{0xFFFF};
        for (size_t i{0}; i < len; ++i) {
            folded = ref_step_bitwise(folded, bytes.data[i]);
        }
        zassert_equal(lcs::crc16(bytes.data.data(), len), folded, "bit-wise fold, length %u",
                      static_cast<unsigned>(len));
        zassert_equal(lcs::crc16(bytes.data.data(), len), ref_crc16(bytes, len), "table reference, length %u",
                      static_cast<unsigned>(len));
    }
}
```

## src/test_forward_queue.cpp
```c
/*
 * Copyright (c) 2026, LexxPluss Inc.
 * All rights reserved.
 *
 * Redistribution and use in source and binary forms, with or without
 * modification, are permitted provided that the following conditions are met:
 *
 * 1. Redistributions of source code must retain the above copyright notice,
 *    this list of conditions and the following disclaimer.
 * 2. Redistributions in binary form must reproduce the above copyright notice,
 *    this list of conditions and the following disclaimer in the documentation
 *    and/or other materials provided with the distribution.
 *
 * THIS SOFTWARE IS PROVIDED BY THE COPYRIGHT HOLDERS AND CONTRIBUTORS "AS IS" AND
 * ANY EXPRESS OR IMPLIED WARRANTIES, INCLUDING, BUT NOT LIMITED TO, THE IMPLIED
 * WARRANTIES OF MERCHANTABILITY AND FITNESS FOR A PARTICULAR PURPOSE ARE
 * DISCLAIMED. IN NO EVENT SHALL THE COPYRIGHT OWNER OR CONTRIBUTORS BE LIABLE FOR
 * ANY DIRECT, INDIRECT, INCIDENTAL, SPECIAL, EXEMPLARY, OR CONSEQUENTIAL DAMAGES
 * (INCLUDING, BUT NOT LIMITED TO, PROCUREMENT OF SUBSTITUTE GOODS OR SERVICES;
 * LOSS OF USE, DATA, OR PROFITS; OR BUSINESS INTERRUPTION) HOWEVER CAUSED AND
 * ON ANY THEORY OF LIABILITY, WHETHER IN CONTRACT, STRICT LIABILITY, OR TORT
 * (INCLUDING NEGLIGENCE OR OTHERWISE) ARISING IN ANY WAY OUT OF THE USE OF THIS
 * SOFTWARE, EVEN IF ADVISED OF THE POSSIBILITY OF SUCH DAMAGE.
 */

#include <array>
#include <cstddef>
#include <cstdint>

#include <zephyr/ztest.h>

#include "lcs_can_packer.hpp"
#include "lcs_forward_queue.hpp"

namespace lcs = lexxhard::lcs;

namespace {

/* Bounded FIFO fake. The first `fail_first` try_put calls fail regardless of room. */
template <std::size_t N>
class FakeQueue {
public:
    explicit FakeQueue(std::size_t fail_first = 0) : fail_first_{fail_first} {}

    bool try_put(const lcs::msg &frame)
    {
        ++try_put_calls;
        if (try_put_calls <= fail_first_ || count_ == N)
            return false;
        frames_[count_++] = frame;
        return true;
    }

    void purge()
    {
        ++purge_calls;
        count_ = 0;
    }

    std::size_t size() const { return count_; }
    const lcs::msg &at(std::size_t index) const { return frames_[index]; }

    std::size_t try_put_calls{0};
    std::size_t purge_calls{0};

private:
    std::array<lcs::msg, N> frames_{};
    std::size_t count_{0};
    std::size_t fail_first_;
};

lcs::msg make_frame(uint8_t board, uint8_t first)
{
    lcs::msg frame{};
    frame.board = board;
    frame.data[0] = first;
    return frame;
}

}

ZTEST_SUITE(lcs_forward_queue, NULL, NULL, NULL, NULL, NULL);

ZTEST(lcs_forward_queue, test_not_full_keeps_all)
{
    FakeQueue<3> queue;
    queue.try_put(make_frame(0, 0x11));
    queue.try_put(make_frame(1, 0x22));
    queue.try_put_calls = 0;

    lcs::put_purging(queue, make_frame(0, 0x33));

    zassert_equal(queue.size(), 3);
    zassert_equal(queue.at(0).data[0], 0x11);
    zassert_equal(queue.at(1).data[0], 0x22);
    zassert_equal(queue.at(2).data[0], 0x33);
    zassert_equal(queue.purge_calls, 0);
    zassert_equal(queue.try_put_calls, 1);
}

ZTEST(lcs_forward_queue, test_full_purges_then_stores_new)
{
    FakeQueue<3> queue;
    queue.try_put(make_frame(0, 0x11));
    queue.try_put(make_frame(1, 0x22));
    queue.try_put(make_frame(0, 0x33));
    queue.try_put_calls = 0;

    lcs::put_purging(queue, make_frame(0, 0x44));

    zassert_equal(queue.size(), 1);
    zassert_equal(queue.at(0).data[0], 0x44);
    zassert_equal(queue.purge_calls, 1);
    zassert_equal(queue.try_put_calls, 2);
}

ZTEST(lcs_forward_queue, test_repeated_overflow_sequence)
{
    FakeQueue<2> queue;

    lcs::put_purging(queue, make_frame(0, 0x01));
    lcs::put_purging(queue, make_frame(0, 0x02));
    zassert_equal(queue.size(), 2);
    zassert_equal(queue.at(0).data[0], 0x01);
    zassert_equal(queue.at(1).data[0], 0x02);

    lcs::put_purging(queue, make_frame(0, 0x03));
    zassert_equal(queue.size(), 1);
    zassert_equal(queue.at(0).data[0], 0x03);

    lcs::put_purging(queue, make_frame(0, 0x04));
    zassert_equal(queue.size(), 2);
    zassert_equal(queue.at(0).data[0], 0x03);
    zassert_equal(queue.at(1).data[0], 0x04);

    lcs::put_purging(queue, make_frame(0, 0x05));
    zassert_equal(queue.size(), 1);
    zassert_equal(queue.at(0).data[0], 0x05);

    zassert_equal(queue.purge_calls, 2);
}

ZTEST(lcs_forward_queue, test_retry_until_success)
{
    {
        FakeQueue<4> queue{0};
        lcs::put_purging(queue, make_frame(0, 0x77));
        zassert_equal(queue.purge_calls, 0);
        zassert_equal(queue.try_put_calls, 1);
        zassert_equal(queue.at(queue.size() - 1).data[0], 0x77);
    }
    {
        FakeQueue<4> queue{1};
        lcs::put_purging(queue, make_frame(0, 0x77));
        zassert_equal(queue.purge_calls, 1);
        zassert_equal(queue.try_put_calls, 2);
        zassert_equal(queue.at(queue.size() - 1).data[0], 0x77);
    }
    {
        FakeQueue<4> queue{2};
        lcs::put_purging(queue, make_frame(0, 0x77));
        zassert_equal(queue.purge_calls, 2);
        zassert_equal(queue.try_put_calls, 3);
        zassert_equal(queue.at(queue.size() - 1).data[0], 0x77);
    }
}

ZTEST(lcs_forward_queue, test_frame_content_unchanged)
{
    lcs::msg frame{};
    frame.board = 1;
    frame.data = {1, 2, 3, 4, 5, 6, 7, 8};
    FakeQueue<1> queue;

    lcs::put_purging(queue, frame);

    zassert_equal(queue.size(), 1);
    zassert_equal(queue.at(0).board, 1);
    for (std::size_t i = 0; i < 8; ++i)
        zassert_equal(queue.at(0).data[i], static_cast<uint8_t>(i + 1));
}
```

## src/test_frame.cpp
```c
/*
 * Copyright (c) 2026, LexxPluss Inc.
 * All rights reserved.
 *
 * Redistribution and use in source and binary forms, with or without
 * modification, are permitted provided that the following conditions are met:
 *
 * 1. Redistributions of source code must retain the above copyright notice,
 *    this list of conditions and the following disclaimer.
 * 2. Redistributions in binary form must reproduce the above copyright notice,
 *    this list of conditions and the following disclaimer in the documentation
 *    and/or other materials provided with the distribution.
 *
 * THIS SOFTWARE IS PROVIDED BY THE COPYRIGHT HOLDERS AND CONTRIBUTORS "AS IS" AND
 * ANY EXPRESS OR IMPLIED WARRANTIES, INCLUDING, BUT NOT LIMITED TO, THE IMPLIED
 * WARRANTIES OF MERCHANTABILITY AND FITNESS FOR A PARTICULAR PURPOSE ARE
 * DISCLAIMED. IN NO EVENT SHALL THE COPYRIGHT OWNER OR CONTRIBUTORS BE LIABLE FOR
 * ANY DIRECT, INDIRECT, INCIDENTAL, SPECIAL, EXEMPLARY, OR CONSEQUENTIAL DAMAGES
 * (INCLUDING, BUT NOT LIMITED TO, PROCUREMENT OF SUBSTITUTE GOODS OR SERVICES;
 * LOSS OF USE, DATA, OR PROFITS; OR BUSINESS INTERRUPTION) HOWEVER CAUSED AND
 * ON ANY THEORY OF LIABILITY, WHETHER IN CONTRACT, STRICT LIABILITY, OR TORT
 * (INCLUDING NEGLIGENCE OR OTHERWISE) ARISING IN ANY WAY OUT OF THE USE OF THIS
 * SOFTWARE, EVEN IF ADVISED OF THE POSSIBILITY OF SUCH DAMAGE.
 */

#include <array>
#include <cstddef>
#include <cstdint>

#include <zephyr/ztest.h>

#include "lcs_core_test_support.hpp"
#include "lcs_crc16.hpp"
#include "lcs_frame.hpp"
#include "lcs_safe_state.hpp"
#include "lcs_timing.hpp"

using namespace lcs_test;
namespace lcs = lexxhard::lcs;

ZTEST_SUITE(lcs_core_frame, NULL, NULL, NULL, NULL, NULL);

/* Golden frames computed once by an independent script. */
static constexpr std::array<uint8_t, 12> kGoldenUplink0{0x4B, 0x0C, 0x00, 0xC0, 0x01, 0x02,
                                                        0x03, 0xFF, 0xFE, 0xFD, 0xF0, 0x42};
static constexpr std::array<uint8_t, 12> kGoldenUplink1{0x4B, 0x0C, 0x01, 0x82, 0x7F, 0xFF,
                                                        0xFF, 0x80, 0x00, 0x00, 0xFB, 0xB7};
static constexpr std::array<uint8_t, 8> kGoldenDownlink0{0x4B, 0x08, 0xFF, 0x08, 0x12, 0x34, 0x54, 0x4B};
static constexpr std::array<uint8_t, 8> kGoldenDownlink1{0x4B, 0x08, 0x01, 0x10, 0x00, 0x00, 0x90, 0x58};

template <size_t N>
static Bytes to_bytes(const std::array<uint8_t, N> &array)
{
    Bytes bytes;
    for (const uint8_t byte : array) {
        bytes.push(byte);
    }
    return bytes;
}

ZTEST(lcs_core_frame, test_lcs_core_c1_crc_check_value)
{
    const std::array<uint8_t, 9> text{'1', '2', '3', '4', '5', '6', '7', '8', '9'};
    zassert_equal(lcs::crc16(text.data(), text.size()), 0x29B1);
    zassert_equal(ref_crc16(to_bytes(text), text.size()), 0x29B1, "the test CRC must agree with the check value");
}

ZTEST(lcs_core_frame, test_lcs_core_c2_crc_empty)
{
    const std::array<uint8_t, 1> none{0};
    zassert_equal(lcs::crc16(none.data(), 0), 0xFFFF);
}

ZTEST(lcs_core_frame, test_lcs_core_c3_golden_uplink)
{
    zassert_equal(lcs::encode_uplink(uplink_of(0, 0xC0, 0x010203, 0xFFFEFD)), kGoldenUplink0);
    zassert_equal(lcs::encode_uplink(uplink_of(1, 0x82, 0x7FFFFF, 0x800000)), kGoldenUplink1);

    Rig rig;
    rig.feed(to_bytes(kGoldenUplink0), 0);
    rig.expect_last(uplink_of(0, 0xC0, 0x010203, 0xFFFEFD), 1);
    rig.feed(to_bytes(kGoldenUplink1), 0);
    rig.expect_last(uplink_of(1, 0x82, 0x7FFFFF, 0x800000), 2);
    check_stats(rig.rx.stats(), Expect{.delivered = 2});
}

ZTEST(lcs_core_frame, test_lcs_core_c3_golden_downlink)
{
    zassert_equal(lcs::encode_downlink(0xFF, 0x08, 0x1234), kGoldenDownlink0);
    zassert_equal(lcs::encode_downlink(0x01, 0x10, 0x0000), kGoldenDownlink1);

    Rig rig;
    rig.feed(to_bytes(kGoldenDownlink0), 0);
    rig.feed(to_bytes(kGoldenDownlink1), 0);
    zassert_equal(rig.out_count, 0U, "a downlink is never returned");
    check_stats(rig.rx.stats(), Expect{.foreign_downlink = 2});
}

ZTEST(lcs_core_frame, test_lcs_core_c4_crc_big_endian)
{
    zassert_equal(kGoldenUplink0[10], 0xF0);
    zassert_equal(kGoldenUplink0[11], 0x42);
    zassert_equal(lcs::crc16(kGoldenUplink0.data(), 10), 0xF042);
    zassert_equal(kGoldenDownlink1[6], 0x90);
    zassert_equal(kGoldenDownlink1[7], 0x58);
    zassert_equal(lcs::crc16(kGoldenDownlink1.data(), 6), 0x9058);
}

ZTEST(lcs_core_frame, test_lcs_core_c5_len_flip_breaks_crc)
{
    for (int bit{0}; bit < 8; ++bit) {
        std::array<uint8_t, 12> frame{kGoldenUplink0};
        frame[1] = static_cast<uint8_t>(frame[1] ^ (1U << bit));
        zassert_not_equal(lcs::crc16(frame.data(), 10), 0xF042, "LEN is inside the CRC range, bit %d", bit);
    }
}

ZTEST(lcs_core_frame, test_lcs_core_c6_bit_flip_every_position)
{
    for (size_t position{0}; position < kGoldenUplink0.size(); ++position) {
        for (int bit{0}; bit < 8; ++bit) {
            std::array<uint8_t, 12> frame{kGoldenUplink0};
            frame[position] = static_cast<uint8_t>(frame[position] ^ (1U << bit));
            const uint16_t stored{static_cast<uint16_t>((frame[10] << 8) | frame[11])};
            zassert_not_equal(lcs::crc16(frame.data(), 10), stored, "position %u bit %d",
                              static_cast<unsigned>(position), bit);
        }
    }
}

ZTEST(lcs_core_frame, test_lcs_core_c7_channel_raw_24bit)
{
    static constexpr std::array<uint32_t, 4> kValues{0x000000, 0x7FFFFF, 0x800000, 0xFFFFFF};
    for (const uint32_t ch1 : kValues) {
        for (const uint32_t ch2 : kValues) {
            Rig rig;
            rig.feed(uplink_frame(0, 0xC0, ch1, ch2), 0);
            zassert_equal(rig.out_count, 1U);
            const Uplink &got{rig.out[0]};
            const uint32_t got1{(static_cast<uint32_t>(got.ch1[0]) << 16) |
                                (static_cast<uint32_t>(got.ch1[1]) << 8) | got.ch1[2]};
            const uint32_t got2{(static_cast<uint32_t>(got.ch2[0]) << 16) |
                                (static_cast<uint32_t>(got.ch2[1]) << 8) | got.ch2[2]};
            zassert_equal(got1, ch1, "ch1 raw 24 bits");
            zassert_equal(got2, ch2, "ch2 raw 24 bits");
        }
    }
}

ZTEST(lcs_core_frame, test_lcs_core_deadline_matches_oracle)
{
    zassert_equal(oracle_deadline_ticks(2), 7U);
    zassert_equal(oracle_deadline_ticks(8), 9U);
    zassert_equal(oracle_deadline_ticks(12), 11U);
    for (uint32_t len{2}; len <= 12; ++len) {
        zassert_equal(lcs::deadline_ticks(len), oracle_deadline_ticks(len), "len %u", static_cast<unsigned>(len));
    }
    zassert_equal(lcs::len_deadline_ticks(13), oracle_deadline_ticks(12), "a LEN above kMaxLen is capped");
    zassert_equal(lcs::len_deadline_ticks(255), oracle_deadline_ticks(12), "a LEN above kMaxLen is capped");
}

ZTEST(lcs_core_frame, test_lcs_core_deadline_table_matches_oracle)
{
    zassert_equal(lcs::kDeadlineTicks.size(), lcs::kMaxLen + 1);
    for (uint32_t len{2}; len <= lcs::kMaxLen; ++len) {
        zassert_equal(lcs::kDeadlineTicks[len], oracle_deadline_ticks(len), "len %u", static_cast<unsigned>(len));
    }
}

ZTEST(lcs_core_frame, test_lcs_core_bsrr_reset_word)
{
    for (uint32_t pin{0}; pin <= 15; ++pin) {
        zassert_equal(lcs::bsrr_reset_word(pin), (1U << (16U + pin)), "pin %u", static_cast<unsigned>(pin));
    }
    zassert_equal(lcs::bsrr_reset_word(2), 0x00040000U);
    zassert_equal(lcs::kGpioBsrrOffset, 0x18U);
}
```

## src/test_rx_action_shaped.cpp
```c
/*
 * Copyright (c) 2026, LexxPluss Inc.
 * All rights reserved.
 *
 * Redistribution and use in source and binary forms, with or without
 * modification, are permitted provided that the following conditions are met:
 *
 * 1. Redistributions of source code must retain the above copyright notice,
 *    this list of conditions and the following disclaimer.
 * 2. Redistributions in binary form must reproduce the above copyright notice,
 *    this list of conditions and the following disclaimer in the documentation
 *    and/or other materials provided with the distribution.
 *
 * THIS SOFTWARE IS PROVIDED BY THE COPYRIGHT HOLDERS AND CONTRIBUTORS "AS IS" AND
 * ANY EXPRESS OR IMPLIED WARRANTIES, INCLUDING, BUT NOT LIMITED TO, THE IMPLIED
 * WARRANTIES OF MERCHANTABILITY AND FITNESS FOR A PARTICULAR PURPOSE ARE
 * DISCLAIMED. IN NO EVENT SHALL THE COPYRIGHT OWNER OR CONTRIBUTORS BE LIABLE FOR
 * ANY DIRECT, INDIRECT, INCIDENTAL, SPECIAL, EXEMPLARY, OR CONSEQUENTIAL DAMAGES
 * (INCLUDING, BUT NOT LIMITED TO, PROCUREMENT OF SUBSTITUTE GOODS OR SERVICES;
 * LOSS OF USE, DATA, OR PROFITS; OR BUSINESS INTERRUPTION) HOWEVER CAUSED AND
 * ON ANY THEORY OF LIABILITY, WHETHER IN CONTRACT, STRICT LIABILITY, OR TORT
 * (INCLUDING NEGLIGENCE OR OTHERWISE) ARISING IN ANY WAY OUT OF THE USE OF THIS
 * SOFTWARE, EVEN IF ADVISED OF THE POSSIBILITY OF SUCH DAMAGE.
 */

#include <array>
#include <cstddef>
#include <cstdint>

#include <zephyr/ztest.h>

#include "lcs_core_test_support.hpp"

using namespace lcs_test;

ZTEST_SUITE(lcs_rx_action_shaped, NULL, NULL, NULL, NULL, NULL);

namespace {

constexpr std::array<uint8_t, 3> kActionCmds{0x48, 0x50, 0x68};
constexpr std::array<uint8_t, 3> kActionTargets{0, 1, 0xFF};

uint32_t d12()
{
    return oracle_deadline_ticks(12);
}

/* The valid uplink that follows an ACTION-shaped frame. */
void expect_aftermath(Rig &rig, const uint32_t tick, const Expect &before, const size_t out_before)
{
    rig.feed(frame_id1(), tick);
    Expect after{before};
    ++after.delivered;
    check_stats(rig.rx.stats(), after);
    rig.expect_last(uplink_id1(), out_before + 1);
}

}  // namespace

/* The own ACTION frame (direction bit 0) looks like a foreign downlink to the receiver. */
ZTEST(lcs_rx_action_shaped, test_sc03_01_action_frame_counts_foreign_downlink)
{
    for (const uint8_t cmd : kActionCmds) {
        for (const uint8_t target : kActionTargets) {
            for (const uint16_t param : {uint16_t{0x0000}, uint16_t{0xFFFF}}) {
                if (param == 0xFFFF && target != 0xFF) {
                    continue;
                }
                Rig rig;
                rig.feed(downlink_frame(target, cmd, param), 100);
                zassert_equal(rig.out_count, 0U);
                check_stats(rig.rx.stats(), Expect{.foreign_downlink = 1});
            }
        }
    }
}

ZTEST(lcs_rx_action_shaped, test_sc03_02_direction_bit_set_is_dropped_silently)
{
    for (const uint8_t cmd : {uint8_t{0xC8}, uint8_t{0xD0}, uint8_t{0xE8}}) {
        for (const uint8_t target : kActionTargets) {
            for (const uint16_t param : {uint16_t{0x0000}, uint16_t{0xFFFF}}) {
                if (param == 0xFFFF && target != 0xFF) {
                    continue;
                }
                Rig rig;
                rig.feed(downlink_frame(target, cmd, param), 100);
                zassert_equal(rig.out_count, 0U);
                check_stats(rig.rx.stats(), Expect{});
            }
        }
    }
}

ZTEST(lcs_rx_action_shaped, test_sc03_03_uplink_after_action_frame_is_delivered)
{
    for (const uint32_t gap : {uint32_t{0}, d12() - 1, d12(), d12() + 1}) {
        Rig rig;
        rig.feed(downlink_frame(0, 0x48, 0x0000), 100);
        expect_aftermath(rig, 100 + gap, Expect{.foreign_downlink = 1}, 0);
    }
}

ZTEST(lcs_rx_action_shaped, test_sc03_05_action_frame_with_bad_crc_counts_crc_error)
{
    Bytes bad{downlink_frame(1, 0x48, 0x0000)};
    bad.data[bad.size - 1] ^= 0x01U;
    Rig rig;
    rig.feed(bad, 100);
    zassert_equal(rig.out_count, 0U);
    check_stats(rig.rx.stats(), Expect{.crc_error = 1});
    rig.feed(frame_id0(), 100);
    rig.expect_last(uplink_id0(), 1);
    check_stats(rig.rx.stats(), Expect{.delivered = 1, .crc_error = 1});
}

/*
 * PINS THE CURRENT LOSS: an uplink whose SOF and LEN are the last two (CRC) bytes of an ACTION frame is
 * lost, because the valid ACTION frame discards the nested candidate. This case documents today's behaviour
 * of lcs_rx; it is to be changed together with lcs_rx if the loss proves harmful.
 */
ZTEST(lcs_rx_action_shaped, test_sc03_04_uplink_sof_inside_action_span_is_lost)
{
    Bytes action;
    bool found{false};
    for (const uint8_t target : kActionTargets) {
        for (const uint8_t cmd : kActionCmds) {
            for (uint32_t param{0}; param <= 0xFFFFU && !found; ++param) {
                Bytes body;
                body.push(0x4B);
                body.push(8);
                body.push(target);
                body.push(cmd);
                body.push(static_cast<uint8_t>(param >> 8));
                body.push(static_cast<uint8_t>(param & 0xFFU));
                if (ref_crc16(body, body.size) == 0x4B0C) {
                    action = body;
                    found = true;
                }
            }
            if (found) {
                break;
            }
        }
        if (found) {
            break;
        }
    }
    zassert_true(found, "no ACTION body with CRC 0x4B0C");

    /* The uplink starts at stream index 6; its bytes at stream indices 8..17 must not contain a SOF. */
    const Bytes uplink{uplink_frame(0, 0xC0, 0x010203, 0x050607)};
    zassert_equal(uplink.size, 12U);
    for (size_t i{2}; i < uplink.size; ++i) {
        zassert_not_equal(uplink.data[i], 0x4B, "SOF byte inside the uplink tail");
    }

    Bytes stream{action};
    stream.append(uplink, 0, uplink.size);
    zassert_equal(stream.size, 18U);
    zassert_equal(stream.data[6], 0x4B);
    zassert_equal(stream.data[7], 0x0C);

    Rig rig;
    rig.feed(stream, 100);
    zassert_equal(rig.out_count, 0U);
    check_stats_except_sof(rig.rx.stats(), Expect{.foreign_downlink = 1});

    rig.feed(frame_id1(), 100 + d12() + 1);
    rig.expect_last(uplink_id1(), 1);
    check_stats_except_sof(rig.rx.stats(), Expect{.delivered = 1, .foreign_downlink = 1});
}
```
