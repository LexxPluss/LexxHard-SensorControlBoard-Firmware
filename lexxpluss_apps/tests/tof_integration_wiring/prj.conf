## CMakeLists.txt
```
# Copyright (c) 2026, LexxPluss Inc.
# All rights reserved.
#
# Redistribution and use in source and binary forms, with or without
# modification, are permitted provided that the following conditions are met:
#
# 1. Redistributions of source code must retain the above copyright notice,
#    this list of conditions and the following disclaimer.
# 2. Redistributions in binary form must reproduce the above copyright notice,
#    this list of conditions and the following disclaimer in the documentation
#    and/or other materials provided with the distribution.
#
# THIS SOFTWARE IS PROVIDED BY THE COPYRIGHT HOLDERS AND CONTRIBUTORS "AS IS" AND
# ANY EXPRESS OR IMPLIED WARRANTIES, INCLUDING, BUT NOT LIMITED TO, THE IMPLIED
# WARRANTIES OF MERCHANTABILITY AND FITNESS FOR A PARTICULAR PURPOSE ARE
# DISCLAIMED. IN NO EVENT SHALL THE COPYRIGHT OWNER OR CONTRIBUTORS BE LIABLE FOR
# ANY DIRECT, INDIRECT, INCIDENTAL, SPECIAL, EXEMPLARY, OR CONSEQUENTIAL DAMAGES
# (INCLUDING, BUT NOT LIMITED TO, PROCUREMENT OF SUBSTITUTE GOODS OR SERVICES;
# LOSS OF USE, DATA, OR PROFITS; OR BUSINESS INTERRUPTION) HOWEVER CAUSED AND
# ON ANY THEORY OF LIABILITY, WHETHER IN CONTRACT, STRICT LIABILITY, OR TORT
# (INCLUDING NEGLIGENCE OR OTHERWISE) ARISING IN ANY WAY OUT OF THE USE OF THIS
# SOFTWARE, EVEN IF ADVISED OF THE POSSIBILITY OF SUCH DAMAGE.


cmake_minimum_required(VERSION 3.20.0)

find_package(Zephyr REQUIRED HINTS $ENV{ZEPHYR_BASE})
project(tof_integration_wiring_test)

set(APP_SRC_DIR ${CMAKE_CURRENT_SOURCE_DIR}/../../src)
set(ULD_DIR ${CMAKE_CURRENT_SOURCE_DIR}/../../third_party/st/vl53l4cx_uld)
set(L7_DIR ${CMAKE_CURRENT_SOURCE_DIR}/../../third_party/st/vl53l7cx_uld)
set(CONTRACT_DIR ${CMAKE_CURRENT_SOURCE_DIR}/../../../docs/can)

# THE WIRING ITSELF, WITH THE GRID FLAG ON. Every other suite that links tof_cliff_runtime.cpp
# builds it WITHOUT ENABLE_TOF_L7_ULD, so the grid publisher's init, the two-publisher fan-out and
# the grid sink are compiled in neither direction there: 20 green cases said nothing about them.
#
# This binary is the flag-on build of the same production sources. Both vendor ULDs are stubbed --
# the L7 one answering, the L4 one refusing -- because what is under test is which modules are
# connected to which, not what ST's drivers do. See the two stub files for why they differ.
target_sources(app PRIVATE
    src/test_main.cpp
    src/l4_silent_stubs.cpp
    src/l7_answering_stubs.cpp
    ${APP_SRC_DIR}/tof_acquisition.cpp
    # The watchdog heartbeats live in the hooked sources, so any suite that links them links this.
    ${APP_SRC_DIR}/runtime_progress.cpp
    ${APP_SRC_DIR}/tof_cliff_packer.cpp
    ${APP_SRC_DIR}/tof_cliff_publisher.cpp
    ${APP_SRC_DIR}/tof_cliff_runtime.cpp
    ${APP_SRC_DIR}/tof_cliff_can.cpp
    # tof_cliff_can sends through the bounded send rather than can_send() directly, so the real one
    # is linked rather than stubbed: a stub here would let the suite pass against a send that does
    # not exist, and the file depends on nothing but atomics and errno.
    ${APP_SRC_DIR}/zcan_bounded_send.cpp
    ${APP_SRC_DIR}/tof_commissioning.cpp
    ${APP_SRC_DIR}/tof_enumerator.cpp
    ${APP_SRC_DIR}/tof_grid_packer.cpp
    ${APP_SRC_DIR}/tof_grid_publisher.cpp
    ${APP_SRC_DIR}/tof_l7_sensor.cpp
    ${APP_SRC_DIR}/tof_mapping_authority.cpp
    ${APP_SRC_DIR}/tof_mapping_proof.cpp
    ${APP_SRC_DIR}/tof_tail_isolation.cpp
)
target_compile_definitions(app PRIVATE ENABLE_TOF_CHAIN ENABLE_TOF_CLIFF_ULD ENABLE_TOF_L7_ULD)
target_include_directories(app PRIVATE
    ${APP_SRC_DIR}
    ${CONTRACT_DIR}
    ${CMAKE_CURRENT_SOURCE_DIR}/../tof_commissioning/src
    ${ULD_DIR}/zephyr
    ${ULD_DIR}/upstream
    ${ULD_DIR}/upstream/modules
    ${ULD_DIR}/upstream/porting
    ${L7_DIR}/zephyr
    ${L7_DIR}/upstream/modules
)
```

## prj.conf
```kconfig
CONFIG_ZTEST=y
CONFIG_CPP=y
CONFIG_STD_CPP20=y
CONFIG_GLIBCXX_LIBCPP=y

# tof_cliff_can.cpp holds DEVICE_DT_GET(DT_NODELABEL(can2)), so the node has to exist for the file
# to compile at all. The loopback controller supplies one; nothing in this suite sends a frame, and
# the gate under test refuses every grid before a send is ever reached.
CONFIG_CAN=y
CONFIG_CAN_LOOPBACK=y
CONFIG_I2C=y
CONFIG_I2C_EMUL=y
```

## native_sim.overlay
```dts
/*
 * Copyright (c) 2026, LexxPluss Inc.
 * All rights reserved.
 *
 * SPDX-License-Identifier: BSD-2-Clause
 *
 * A node called can2, because tof_cliff_can.cpp names it at compile time. The board has a real
 * bxCAN there; here it is the loopback controller, and that difference does not matter to what is
 * under test: the grid authorisation gate refuses every grid before any send is reached, so no
 * frame is produced on either.
 */

/ {
	/* The VL53L4CX port resolves its bus with DT_NODELABEL(i2c2), so the node has to exist.
	 * An emulated controller, with the label matching production exactly -- a test that renamed
	 * it would stop covering the production lookup. */
	i2c2: i2c@11112222 {
		#address-cells = <1>;
		#size-cells = <0>;
		compatible = "zephyr,i2c-emul-controller";
		reg = <0x11112222 0x1000>;
		status = "okay";
		clock-frequency = <400000>;
	};

	can2: can_loopback0 {
		compatible = "zephyr,can-loopback";
		status = "okay";
	};
};
```

## src/l4_silent_stubs.cpp
```c
/*
 * Copyright (c) 2026, LexxPluss Inc.
 * All rights reserved.
 *
 * SPDX-License-Identifier: BSD-2-Clause
 *
 * The cliff sensor's entry points, refusing every call.
 *
 * tof_acquisition.cpp binds l4_cliff_ops() to these, so linking it needs them -- and nothing in
 * this binary may reach them. The question here is whether the GRID half of the wiring is
 * connected: the real adapter in the descriptors, the hook into the grid publisher, the grid mask
 * in the authorisation. The four cliff positions are present only because the deployment spec puts
 * them there, and their bring-up failing is the state these cases run in.
 *
 * That is why the file stubs the C adapter rather than linking the real tof_cliff_sensor.c: the
 * real one pulls the whole VL53L4CX ULD and its bus layer into a suite that never ranges an L4.
 *
 * -ENOSYS is the fail-loud direction. bring_up() treats a source that will not open as one sensor
 * out of six -- it logs it and carries on, which is the documented behaviour -- so a cliff position
 * that silently started working here would change nothing visible, while a grid position that
 * reached this table by mistake would get an error instead of a plausible-looking sample.
 *
 * The contrast with l7_answering_stubs.cpp is the point: that one ANSWERS, because the grid path is
 * what is under test and a disconnected hook would otherwise look exactly like a quiet sensor.
 */

#include <errno.h>

#include "tof_cliff_sensor.h"

extern "C" {

int tof_cliff_sensor_open(VL53L4CX_Object_t *, uint8_t, struct tof_cliff_read_status *)
{
    return -ENOSYS;
}

int tof_cliff_sensor_configure(VL53L4CX_Object_t *, VL53LX_DistanceModes, uint32_t,
                               struct tof_cliff_read_status *)
{
    return -ENOSYS;
}

int tof_cliff_sensor_start(VL53L4CX_Object_t *, struct tof_cliff_stream_state *,
                           struct tof_cliff_read_status *)
{
    return -ENOSYS;
}

int tof_cliff_sensor_stop(VL53L4CX_Object_t *, struct tof_cliff_read_status *)
{
    return -ENOSYS;
}

int tof_cliff_read_once(VL53L4CX_Object_t *, struct tof_cliff_scratch *,
                        struct tof_cliff_stream_state *, struct tof_cliff_sample *,
                        struct tof_cliff_read_status *)
{
    return -ENOSYS;
}

/* Reached for real: acquisition logs the stage name when a source fails to come up, which in this
 * binary is every cliff position on every bring-up. */
const char *tof_cliff_stage_name(enum tof_cliff_stage)
{
    return "stub";
}

}  // extern "C"
```

## src/l7_answering_stubs.cpp
```c
/*
 * Copyright (c) 2026, LexxPluss Inc.
 * All rights reserved.
 *
 * SPDX-License-Identifier: BSD-2-Clause
 *
 * The VL53L7CX's entry points, answering as a healthy sensor would.
 *
 * tof_acquisition.cpp carries the real grid ops table in an ENABLE_TOF_L7_ULD build, and that table
 * names the adapter, which names the vendor. This suite drives the grid path from the far end --
 * acquisition reads, the adapter converts, the hook carries the sample to the publisher -- so the
 * vendor half has to produce a frame. A stub that refused would leave a correctly wired path
 * looking exactly like a disconnected one, which is the thing these cases exist to tell apart.
 *
 * Stubbed rather than real because what is under test is which modules are connected to which, not
 * what ST's driver does. The suite that drives the vendor through its own state machine is
 * tests/tof_commissioning, where the fake is controllable because the question there is what
 * reaches the ULD. The contrast with l4_silent_stubs.cpp alongside is deliberate.
 */

#include <stddef.h>
#include <stdint.h>

extern "C" {
#include "vl53l7cx_api.h"
#include "vl53l7cx_port.h"
}

namespace lexxhard::tof_l7_runtime {

/* A BLOB OF THE RIGHT LENGTH AND NO CONTENT. The adapter checks the size before it touches the
 * sensor -- a short buffer fails at the firmware stage with -EPROTO -- so a grid position cannot
 * open at all without one. Its bytes are never read here, because vl53l7cx_init() below is the stub
 * that would have downloaded them. What the real blob has to satisfy is the record's length and
 * hash, and tests/tof_l7_blob is where that is checked. */
static uint8_t blob_[VL53L7CX_FIRMWARE_DOWNLOAD_SIZE];

const uint8_t *firmware_data()
{
    return blob_;
}

size_t firmware_size()
{
    return sizeof(blob_);
}

}  // namespace lexxhard::tof_l7_runtime

extern "C" {

/* THE PORT, ANSWERING AS A HEALTHY BUS. It takes a context now -- one per device, so two sensors do
 * not share a first-error record -- and the stub ignores it because nothing here fails. The
 * argument fault is separate on purpose: it is the one fault with no device to blame, so it cannot
 * live in a context, and a build that trips it should be caught by a test rather than silently
 * swapping nothing. */
void vl53l7cx_port_clear_error(struct vl53l7cx_port_context *) {}

int vl53l7cx_port_error(const struct vl53l7cx_port_context *)
{
    return 0;
}

uint32_t vl53l7cx_port_completed_transfers(const struct vl53l7cx_port_context *)
{
    return 0;
}

int vl53l7cx_port_argument_fault(void)
{
    return 0;
}

void vl53l7cx_port_clear_argument_fault(void) {}

/* A SENSOR THAT ANSWERS, which the cliff suite's stubs deliberately are not: there, the grid
 * publisher is driven directly and the vendor half only has to link. Here the whole chain is under
 * test -- acquisition reads, the adapter converts, the hook fires -- so the stub has to produce a
 * frame or nothing travels and a disconnected hook would look exactly like a quiet sensor. */
uint8_t vl53l7cx_init(VL53L7CX_Configuration *)
{
    return VL53L7CX_STATUS_OK;
}

uint8_t vl53l7cx_set_resolution(VL53L7CX_Configuration *, uint8_t)
{
    return VL53L7CX_STATUS_OK;
}

uint8_t vl53l7cx_set_ranging_frequency_hz(VL53L7CX_Configuration *, uint8_t)
{
    return VL53L7CX_STATUS_OK;
}

uint8_t vl53l7cx_start_ranging(VL53L7CX_Configuration *)
{
    return VL53L7CX_STATUS_OK;
}

uint8_t vl53l7cx_stop_ranging(VL53L7CX_Configuration *)
{
    return VL53L7CX_STATUS_OK;
}

uint8_t vl53l7cx_check_data_ready(VL53L7CX_Configuration *, uint8_t *is_ready)
{
    if (is_ready != nullptr)
        *is_ready = 1;
    return VL53L7CX_STATUS_OK;
}

uint8_t vl53l7cx_get_ranging_data(VL53L7CX_Configuration *, VL53L7CX_ResultsData *out)
{
    if (out == nullptr)
        return VL53L7CX_STATUS_ERROR;

    memset(out, 0, sizeof(*out));
    for (size_t z = 0; z < VL53L7CX_RESOLUTION_8X8; ++z) {
        out->nb_target_detected[z] = 1;
        /* 5 is the ULD's "valid" verdict; the publisher's low-confidence policy is about 6 and 9,
         * and this suite is not the place to exercise it. */
        out->target_status[z] = 5;
        out->distance_mm[z] = 1234;
    }
    return VL53L7CX_STATUS_OK;
}

}  // extern "C"
```

## src/test_main.cpp
```c
/*
 * Copyright (c) 2026, LexxPluss Inc.
 * All rights reserved.
 *
 * SPDX-License-Identifier: BSD-2-Clause
 *
 * THE WIRING, WITH THE GRID FLAG ON.
 *
 * Every other suite that links tof_cliff_runtime.cpp builds it WITHOUT ENABLE_TOF_L7_ULD, so the
 * grid publisher's init, the two-publisher fan-out and the grid sink are compiled in neither
 * direction there. Twenty green cases next door said nothing about any of them.
 *
 * What is production here: the runtime, both publishers, both packers, the acquisition layer, the
 * authority, and tof_cliff_can.cpp -- including the real grid authorisation conversion. What is
 * faked: the chain's control lines and the vendor ULDs, because what is under test is which
 * modules are connected to which, not what ST's drivers do.
 *
 * No proof commits here, so the authority remains unproven and no frames reach CAN.
 * can2 is a loopback device needed by tof_cliff_can.cpp; frame payloads are tested elsewhere.
 */

#include <errno.h>
#include <string.h>

#include <zephyr/kernel.h>
#include <zephyr/ztest.h>

#include "fake_chain.hpp"
#include "tof_acquisition.hpp"
#include "tof_chain_controller.hpp"
#include "tof_chain_spec.hpp"
#include "tof_cliff_can.hpp"
#include "tof_cliff_publisher.hpp"
#include "tof_cliff_runtime.hpp"
#include "tof_grid_publisher.hpp"
#include "tof_mapping_authority.hpp"

namespace acq = lexxhard::tof_acq;
namespace au = lexxhard::tof_authority;
namespace can = lexxhard::tof_cliff_can;
namespace gpub = lexxhard::tof_grid_pub;
namespace pub = lexxhard::tof_cliff_pub;
namespace rt = lexxhard::tof_cliff_runtime;

namespace {

bool glue_is_ready{true};

K_THREAD_STACK_DEFINE(wiring_acq_stack, 2048);

rt::config timing()
{
    rt::config c{};

    c.cycle_period_ms = 50;
    c.health_period_ms = 20;
    c.stop_join_timeout_ms = 400;
    c.thread_priority = K_PRIO_PREEMPT(5);
    c.cliff_timing_budget_us = 21000;
    c.cliff_distance_mode = 3;
    c.grid_frequency_hz = 7;
    return c;
}

void before(void *)
{
    glue_is_ready = true;
    rt::reset_for_test();
    rt::set_thread_stack_for_test(wiring_acq_stack, K_THREAD_STACK_SIZEOF(wiring_acq_stack));
    au::reset_epoch_history_for_test();
}

} // namespace

/* The chain controller's two symbols, supplied here rather than by linking the file: that one
 * reaches real GPIO and a real bxCAN, and nothing in this suite is about either. The lock is a real
 * k_mutex for the same reason the commissioning suite uses one -- "recursive locking does not
 * deadlock" is not a property a fake can demonstrate. */
namespace lexxhard::tof_chain_controller {

K_MUTEX_DEFINE(wiring_chain_mutex);

bool glue_ready()
{
    return glue_is_ready;
}

k_mutex &chain_lock()
{
    return wiring_chain_mutex;
}

}  // namespace lexxhard::tof_chain_controller

ZTEST_SUITE(tof_integration_wiring, NULL, NULL, before, NULL, NULL);

/* THE GRID DESCRIPTORS CARRY THE REAL TABLE AND THE DEPLOYMENT'S RATE. In a flag-off build they
 * carry the -ENOSYS stub, so this is the binding that build cannot have. */
ZTEST(tof_integration_wiring, test_the_grid_positions_are_bound_to_the_real_adapter)
{
    zassert_equal(rt::bootstrap(timing()), 0, "stage %s", rt::stage_name(rt::current_stage()));

    const acq::source_desc *d{rt::descriptors_for_test()};
    zassert_not_null(d);

    int grid{0};
    for (size_t i = 0; i < lexxhard::tof_chain::dasher_spec().positions; ++i) {
        if (d[i].kind != acq::model::l7_grid)
            continue;
        ++grid;
        zassert_true(d[i].grid_ops == &acq::l7_grid_ops(),
                     "position %zu is not bound to the production adapter", i + 1);
        zassert_equal(d[i].grid_frequency_hz, 7, "position %zu got rate %u", i + 1,
                      d[i].grid_frequency_hz);
        zassert_not_null(d[i].dev, "position %zu has no device object", i + 1);
        zassert_not_null(d[i].scratch, "position %zu has no scratch", i + 1);
        /* AND THE BUS, which is the same object for both positions and the same one the boot
         * recovery probed. Two contexts for one controller would split the first-error and
         * completed-transfer record between the recovery pass and the open that follows it. */
        zassert_true(d[i].grid_port == rt::grid_port(),
                     "position %zu is not on the chain's grid context", i + 1);
        /* And no L4 profile on it -- acquisition refuses a descriptor that carries one. */
        zassert_equal(d[i].cliff_timing_budget_us, 0U, "");
        zassert_equal(d[i].cliff_distance_mode, 0, "");
    }
    zassert_equal(grid, 2, "the spec has two grid positions");
}

/* THE WHOLE PATH, AND THE COUNTER SAYS WHICH LINK HELD. A stubbed sensor answers with a full grid;
 * acquisition reads it, the adapter converts it, the hook carries it to the publisher, and the
 * gate refuses it because nothing in this fixture ever proved the mapping. Three different
 * failures are told apart by WHICH counter moves:
 *
 *   nothing moves                 the hook is not wired, or the publisher was never initialised
 *   suppressed_cycle_not_begun    on_grid_sample arrived but on_cycle_begin did not -- the fan-out
 *                                 has one arm, which is exactly what a flag-off build compiles
 *   suppressed_not_proven         everything is connected and the gate did its job
 *
 * In a build without the grid flag none of this exists, which is why twenty green cases next door
 * said nothing about it. */
ZTEST(tof_integration_wiring, test_a_grid_sample_reaches_the_publisher_and_the_gate_refuses_it)
{
    zassert_equal(rt::bootstrap(timing()), 0, "stage %s", rt::stage_name(rt::current_stage()));
    zassert_equal(acq::bring_up(), 0);

    gpub::counters before{};
    gpub::copy_counters(before);

    acq::run_cycle();

    gpub::counters after{};
    gpub::copy_counters(after);

    zassert_equal(after.suppressed_cycle_not_begun, before.suppressed_cycle_not_begun,
                  "a sample arrived for a cycle the publisher was never told about: the fan-out "
                  "did not reach on_cycle_begin");
    zassert_true(after.suppressed_not_proven > before.suppressed_not_proven,
                 "no grid sample reached the publisher at all (before %u, after %u): the "
                 "on_grid_sample hook is not wired, or the publisher was never initialised",
                 before.suppressed_not_proven, after.suppressed_not_proven);
    zassert_equal(after.grids_sent, before.grids_sent,
                  "a grid was sent from a mapping no proof ever established");

    acq::stop();
}

/* THE GRID PERMISSION COMES FROM THE GRID'S OWN MASK. This is the defect the suite was written
 * for: the conversion read enumerated_mask, which masks_from() builds from the four L4 ROLES, so
 * its bits 0 and 1 are the front_left and rear_left CLIFF sensors. They agree with the grid pair's
 * permission only by coincidence of the current chain profile.
 *
 * It is checked against a hand-built snapshot rather than through the live gate because reaching a
 * snapshot with these two masks disagreeing takes a full proof, which no fixture here performs.
 * The two cases are the two directions of the confusion: cliff bits set with no grid proven must
 * permit nothing, and a grid bit set with no cliff bit must permit that grid. */
ZTEST(tof_integration_wiring, test_the_grid_permission_ignores_the_cliff_mask)
{
    au::snapshot n{};

    n.enumerated_mask = 0x3;   /* front_left and rear_left CLIFF sensors */
    n.model_verified_mask = 0x3;
    n.grid_source_mask = 0x0;  /* no grid source proven */
    n.failing_position = au::kNoFailingPosition;

    const gpub::authorisation deny{can::grid_authorisation_from(n)};
    for (int i = 0; i < gpub::kGridSources; ++i)
        zassert_false(deny.source_allowed[i],
                      "grid source %d was permitted by a CLIFF sensor's bit", i);
}

ZTEST(tof_integration_wiring, test_a_proven_grid_source_is_permitted_by_its_own_bit)
{
    au::snapshot n{};

    n.enumerated_mask = 0x0;   /* no cliff sensor enumerated */
    n.grid_source_mask = 0x2;  /* grid source 1, and only it */
    n.failing_position = au::kNoFailingPosition;

    const gpub::authorisation a{can::grid_authorisation_from(n)};
    zassert_false(a.source_allowed[0], "grid source 0 is not in the mask");
    zassert_true(a.source_allowed[1],
                 "grid source 1 is in grid_source_mask and was refused: the conversion is not "
                 "reading that field");

    /* boards_detected is not in the snapshot, so it is zero and says so rather than carrying a
     * plausible-looking number into a diagnostics field. */
    zassert_equal(a.boards_detected, 0, "");
    /* Bit 2 -- "the binding cannot be trusted" -- is NOT a field here, and asking for it is what
     * kept this suite from compiling at all. authorisation carried a chain-level
     * binding_untrusted until #118 removed it: its only effect was to set bit 2 on every source,
     * which the packer reads as a contradiction against source_allowed and refuses, taking the
     * whole cycle down over one position. source_allowed[] already says this per source, as the
     * enumerator's verdict rather than as a status bit, so there is nothing to assert here --
     * the input a conforming producer must never set no longer exists to be set. */
    /* kNoFailingPosition is 0xFF, not 0: a healthy chain must not report a failure here. */
    zassert_false(a.other_position_enumeration_failed, "");
}

/* Conversion preserves PROVEN, while the live gate remains unproven without a committed proof. */
ZTEST(tof_integration_wiring, test_the_grid_gate_carries_the_authority_state)
{
    au::snapshot n{};

    n.state = acq::mapping_state::proven;
    n.grid_source_mask = 0x3;
    zassert_equal(can::grid_authorisation_from(n).state, acq::mapping_state::proven,
                  "a PROVEN snapshot reached the publisher as something else: the state is being "
                  "rewritten between the authority and the gate");

    zassert_not_equal(can::grid_production_authorisation().state, acq::mapping_state::proven,
                      "the live gate is PROVEN although no proof has committed in this fixture");
}

/* Same reason as the commissioning suite: tof_cliff_runtime.cpp marks the watchdog's baseline from
 * inside the keying commit, and linking the real feeder would pull the task watchdog, the tombstone
 * and its DTCM reservation into a suite about which modules are connected to which. */
namespace lexxhard::tof_watchdog_feeder {

void set_baseline_point(bool)
{
}

void set_acquisition_expected(bool)
{
}

}  // namespace lexxhard::tof_watchdog_feeder
```
