## CMakeLists.txt
```
# Copyright (c) 2026, LexxPluss Inc.
# All rights reserved.
#
# Redistribution and use in source and binary forms, with or without
# modification, are permitted provided that the following conditions are met:
#
# 1. Redistributions of source code must retain the above copyright notice,
#    this list of conditions and the following disclaimer.
# 2. Redistributions in binary form must reproduce the above copyright notice,
#    this list of conditions and the following disclaimer in the documentation
#    and/or other materials provided with the distribution.
#
# THIS SOFTWARE IS PROVIDED BY THE COPYRIGHT HOLDERS AND CONTRIBUTORS "AS IS" AND
# ANY EXPRESS OR IMPLIED WARRANTIES, INCLUDING, BUT NOT LIMITED TO, THE IMPLIED
# WARRANTIES OF MERCHANTABILITY AND FITNESS FOR A PARTICULAR PURPOSE ARE
# DISCLAIMED. IN NO EVENT SHALL THE COPYRIGHT OWNER OR CONTRIBUTORS BE LIABLE FOR
# ANY DIRECT, INDIRECT, INCIDENTAL, SPECIAL, EXEMPLARY, OR CONSEQUENTIAL DAMAGES
# (INCLUDING, BUT NOT LIMITED TO, PROCUREMENT OF SUBSTITUTE GOODS OR SERVICES;
# LOSS OF USE, DATA, OR PROFITS; OR BUSINESS INTERRUPTION) HOWEVER CAUSED AND
# ON ANY THEORY OF LIABILITY, WHETHER IN CONTRACT, STRICT LIABILITY, OR TORT
# (INCLUDING NEGLIGENCE OR OTHERWISE) ARISING IN ANY WAY OUT OF THE USE OF THIS
# SOFTWARE, EVEN IF ADVISED OF THE POSSIBILITY OF SUCH DAMAGE.


# Two layers, deliberately separate binaries' worth of concern in one image:
#
#   test_port_traffic.c   the real Zephyr I2C path, through an emulated controller,
#                         so the 16-bit big-endian index, the two write segments with
#                         no intermediate STOP, the read's repeated start and final
#                         STOP, and the errno mapping are pinned against the API the
#                         production code actually calls.
#
#   test_read_once.c      the adapter, with the ULD's entry points replaced by fakes.
#                         The ULD's .c files are NOT compiled here: emulating the
#                         VL53L4CX register map well enough to drive it would freeze
#                         a vendor-internal register sequence into our tests, which is
#                         precisely the coupling to avoid. The fakes reproduce the
#                         ULD's observable behaviour instead, and pose a transport
#                         failure under a success return so the adapter's defence
#                         against that class is exercised. Patch 0001 fixes the ULD
#                         path that used to produce that shape by itself; the defence
#                         is tested here regardless of the vendor tree's state.
cmake_minimum_required(VERSION 3.20.0)

find_package(Zephyr REQUIRED HINTS $ENV{ZEPHYR_BASE})
project(tof_cliff_sensor_test)

set(APP_SRC_DIR ${CMAKE_CURRENT_SOURCE_DIR}/../../src)
# The generated contract headers the publisher and the packer pin against.
set(CONTRACT_DIR ${CMAKE_CURRENT_SOURCE_DIR}/../../../docs/can)
set(ULD_DIR ${CMAKE_CURRENT_SOURCE_DIR}/../../third_party/st/vl53l4cx_uld)
set(L7_DIR ${CMAKE_CURRENT_SOURCE_DIR}/../../third_party/st/vl53l7cx_uld)

target_sources(app PRIVATE
    src/fake_i2c.c
    src/test_port_traffic.c
    src/test_read_once.c
    src/test_acquisition.cpp
    src/test_publisher.cpp
    #   test_grid_publisher.cpp  the grid path: acquisition -> packer -> a fake CAN sink, with the
    #                            authorisation injected so a case can drive both sides of the gate
    #                            and both sides of each source's permission.
    src/test_grid_publisher.cpp
    ${APP_SRC_DIR}/tof_cliff_sensor.c
    ${APP_SRC_DIR}/tof_acquisition.cpp
    # The watchdog heartbeats live in the hooked sources, so any suite that links them links this.
    ${APP_SRC_DIR}/runtime_progress.cpp
    ${APP_SRC_DIR}/tof_cliff_packer.cpp
    ${APP_SRC_DIR}/tof_cliff_publisher.cpp
    ${APP_SRC_DIR}/tof_grid_packer.cpp
    ${APP_SRC_DIR}/tof_grid_publisher.cpp
    #   The grid publisher consumes tof_l7::sample, which is vendor-free on purpose, so this suite
    #   still compiles without a line of ST's VL53L7CX driver. The adapter that does use it has its
    #   own suite; l7_vendor_stubs.cpp is here only so the binary links.
    src/l7_vendor_stubs.cpp
    ${APP_SRC_DIR}/tof_l7_sensor.cpp
    ${ULD_DIR}/zephyr/vl53lx_platform.c
    ${ULD_DIR}/zephyr/vl53l4cx_bus_io.c
)

# The acquisition layer is compiled only under ENABLE_TOF_CHAIN and ENABLE_TOF_CLIFF_ULD in
# production, so the test defines both. The chain controller itself is NOT linked here: the test
# fakes chain_lock() with a real k_mutex, which keeps the lock assertions honest without dragging
# the bus and the shell into a suite about lifecycle.
# ENABLE_TOF_L7_ULD joins the other two for the grid publisher, which is guarded on all three.
target_compile_definitions(app PRIVATE ENABLE_TOF_CHAIN ENABLE_TOF_CLIFF_ULD ENABLE_TOF_L7_ULD)
target_include_directories(app PRIVATE
    ${APP_SRC_DIR}
    ${CONTRACT_DIR}
    ${ULD_DIR}/zephyr
    ${ULD_DIR}/upstream
    ${ULD_DIR}/upstream/modules
    ${ULD_DIR}/upstream/porting
    # For tof_l7_sensor.cpp's vendor-facing half. The grid publisher itself needs none of it.
    ${L7_DIR}/zephyr
    ${L7_DIR}/upstream/modules
)
target_compile_options(app PRIVATE -Wno-unused-parameter)
```

## prj.conf
```kconfig
CONFIG_ZTEST=y
CONFIG_I2C=y
CONFIG_EMUL=y
CONFIG_I2C_EMUL=y
CONFIG_LOG=y
CONFIG_LOG_MODE_IMMEDIATE=y
CONFIG_CPP=y
CONFIG_STD_CPP20=y
CONFIG_GLIBCXX_LIBCPP=y
```

## app.overlay
```dts
/*
 * Copyright (c) 2026, LexxPluss Inc.
 * All rights reserved.
 *
 * SPDX-License-Identifier: BSD-2-Clause
 *
 * The port resolves its bus with DT_NODELABEL(i2c2), so the test provides an i2c2
 * that is an emulated controller. The label has to match the production one exactly:
 * a test that renamed the node would stop covering the production lookup.
 */

/ {
	i2c2: i2c@11112222 {
		#address-cells = <1>;
		#size-cells = <0>;
		compatible = "zephyr,i2c-emul-controller";
		reg = <0x11112222 0x1000>;
		status = "okay";
		clock-frequency = <400000>;
	};
};
```

## src/fake_i2c.c
```c
/*
 * Copyright (c) 2026, LexxPluss Inc.
 * All rights reserved.
 *
 * SPDX-License-Identifier: BSD-2-Clause
 */

#include <errno.h>
#include <string.h>

#include <zephyr/device.h>
#include <zephyr/drivers/emul.h>
#include <zephyr/drivers/i2c.h>
#include <zephyr/drivers/i2c_emul.h>
#include <zephyr/init.h>

#include "fake_i2c.h"

#define FAKE_I2C_ADDR 0x29

struct fake_i2c_xfer fake_i2c_log[FAKE_I2C_MAX_XFERS];
int fake_i2c_count;

static uint8_t read_data[FAKE_I2C_MAX_BYTES];
static size_t read_len;
static int fail_nth;
static int fail_err;

void fake_i2c_set_read_data(const uint8_t *data, size_t len)
{
	read_len = (len > sizeof(read_data)) ? sizeof(read_data) : len;
	memcpy(read_data, data, read_len);
}

void fake_i2c_fail_on(int nth_xfer, int err)
{
	fail_nth = nth_xfer;
	fail_err = err;
}

void fake_i2c_reset(void)
{
	memset(fake_i2c_log, 0, sizeof(fake_i2c_log));
	fake_i2c_count = 0;
	fail_nth = 0;
	fail_err = 0;
	read_len = 0;
}

bool fake_i2c_all_addressed(uint16_t addr7)
{
	for (int i = 0; i < fake_i2c_count && i < FAKE_I2C_MAX_XFERS; i++) {
		if (fake_i2c_log[i].addr != addr7) {
			return false;
		}
	}
	return fake_i2c_count > 0;
}

static int fake_transfer(const struct emul *target, struct i2c_msg *msgs, int num_msgs, int addr)
{
	int idx = fake_i2c_count++;

	if (idx < FAKE_I2C_MAX_XFERS) {
		struct fake_i2c_xfer *rec = &fake_i2c_log[idx];
		int segs = (num_msgs > FAKE_I2C_MAX_SEGS) ? FAKE_I2C_MAX_SEGS : num_msgs;

		rec->bus = (target != NULL) ? target->dev : NULL;
		rec->addr = (uint16_t)addr;
		rec->num_segs = (uint8_t)num_msgs;
		for (int i = 0; i < segs; i++) {
			rec->segs[i].len = (uint16_t)msgs[i].len;
			rec->segs[i].flags = msgs[i].flags;
			if ((msgs[i].flags & I2C_MSG_READ) == 0U && msgs[i].buf != NULL) {
				size_t n = msgs[i].len;

				if (n > FAKE_I2C_MAX_BYTES) {
					n = FAKE_I2C_MAX_BYTES;
				}
				memcpy(rec->segs[i].data, msgs[i].buf, n);
			}
		}
	}

	if (fail_nth != 0 && fake_i2c_count == fail_nth) {
		return fail_err;
	}

	for (int i = 0; i < num_msgs; i++) {
		if ((msgs[i].flags & I2C_MSG_READ) != 0U && msgs[i].buf != NULL) {
			for (size_t b = 0; b < msgs[i].len; b++) {
				msgs[i].buf[b] = (read_len > 0) ? read_data[b % read_len] : 0U;
			}
		}
	}
	return 0;
}

static const struct i2c_emul_api fake_api = {
	.transfer = fake_transfer,
};

/* i2c_emul_register reads emul->target->dev->name for its log line, so the target has
 * to be a real struct emul with a device. Pointing it at the bus itself is enough:
 * nothing else in the emulated path dereferences it. */
static struct i2c_emul fake_emul;

static const struct emul fake_emul_target = {
	.dev = DEVICE_DT_GET(DT_NODELABEL(i2c2)),
};

/* A SECOND controller, only where the test declares one. Suites whose overlay has no i2c4 node
 * compile this away, so the shared fake stays usable by all of them unchanged. */
#if DT_NODE_EXISTS(DT_NODELABEL(i2c4))
static struct i2c_emul fake_emul_b;

static const struct emul fake_emul_target_b = {
	.dev = DEVICE_DT_GET(DT_NODELABEL(i2c4)),
};
#endif

static int fake_i2c_init(void)
{
	fake_emul.target = &fake_emul_target;
	fake_emul.api = &fake_api;
	fake_emul.addr = FAKE_I2C_ADDR;

	int rc = i2c_emul_register(DEVICE_DT_GET(DT_NODELABEL(i2c2)), &fake_emul);

#if DT_NODE_EXISTS(DT_NODELABEL(i2c4))
	if (rc != 0) {
		return rc;
	}
	fake_emul_b.target = &fake_emul_target_b;
	fake_emul_b.api = &fake_api;
	fake_emul_b.addr = FAKE_I2C_ADDR;
	rc = i2c_emul_register(DEVICE_DT_GET(DT_NODELABEL(i2c4)), &fake_emul_b);
#endif

	return rc;
}

SYS_INIT(fake_i2c_init, APPLICATION, 1);
```

## src/fake_i2c.h
```c
/*
 * Copyright (c) 2026, LexxPluss Inc.
 * All rights reserved.
 *
 * SPDX-License-Identifier: BSD-2-Clause
 *
 * A recording I2C target behind Zephyr's emulated controller. The point of going
 * through i2c_emul rather than replacing the port's calls is that the production code
 * keeps using i2c_transfer and i2c_write_read unchanged, so the recorded messages are
 * the ones the driver really builds - including the flags that i2c_write_read sets on
 * the caller's behalf.
 */

#ifndef FAKE_I2C_H_
#define FAKE_I2C_H_

#include <stdbool.h>
#include <stddef.h>
#include <stdint.h>

#include <zephyr/device.h>

#define FAKE_I2C_MAX_XFERS 16
#define FAKE_I2C_MAX_SEGS  4
#define FAKE_I2C_MAX_BYTES 8

struct fake_i2c_seg {
	uint16_t len;
	uint8_t flags;
	uint8_t data[FAKE_I2C_MAX_BYTES]; /* write payload as sent, truncated */
};

struct fake_i2c_xfer {
	uint16_t addr; /* the 7-bit address the driver passed down */
	uint8_t num_segs;
	/* WHICH CONTROLLER carried it. Needed to tell a port that uses the bus it was given from
	 * one that validates the bus and then drives a compiled-in default anyway: both address
	 * the same target, and only this field separates them. Registered on a second node too
	 * when the test's overlay declares one. */
	const struct device *bus;
	struct fake_i2c_seg segs[FAKE_I2C_MAX_SEGS];
};

/* Recorded traffic since the last reset. */
extern struct fake_i2c_xfer fake_i2c_log[FAKE_I2C_MAX_XFERS];
extern int fake_i2c_count;

/* Bytes handed back for read segments, cycled if the read is longer. */
void fake_i2c_set_read_data(const uint8_t *data, size_t len);

/* Fail the nth transfer since the reset, counting from 1, with this errno. Zero
 * disables injection. Only one injection point at a time, which is enough: each test
 * places it at the first, a middle or the last transfer of an operation. */
void fake_i2c_fail_on(int nth_xfer, int err);

void fake_i2c_reset(void);

/* True when every recorded transfer used the given 7-bit address. */
bool fake_i2c_all_addressed(uint16_t addr7);

#endif /* FAKE_I2C_H_ */
```

## src/l7_vendor_stubs.cpp
```c
/*
 * Copyright (c) 2026, LexxPluss Inc.
 * All rights reserved.
 *
 * SPDX-License-Identifier: BSD-2-Clause
 *
 * The VL53L7CX's entry points, present so that this binary links, and reached by nothing.
 *
 * tof_acquisition.cpp carries the real grid ops table in an ENABLE_TOF_L7_ULD build, and that
 * table names the adapter, which names the vendor. This suite is about the scheduler, the cliff
 * adapter and the two publishers; it drives the grid path through the publisher's own entry points
 * and never through a sensor. The suite that does drive the vendor is tests/tof_commissioning,
 * where the fake is a controllable one because the question there is what reaches the ULD.
 *
 * Every function below returns a failure for that reason: if a test in this binary ever does reach
 * one, it gets an error rather than a plausible-looking sample.
 */

#include <stddef.h>
#include <stdint.h>

extern "C" {
#include "vl53l7cx_api.h"
}

namespace lexxhard::tof_l7_runtime {

const uint8_t *firmware_data()
{
    return nullptr;   // no verified payload here, so open() refuses at the firmware stage
}

size_t firmware_size()
{
    return 0;
}

}  // namespace lexxhard::tof_l7_runtime

extern "C" {

void vl53l7cx_port_clear_error(void) {}

int vl53l7cx_port_error(void)
{
    return 0;
}

uint8_t vl53l7cx_init(VL53L7CX_Configuration *)
{
    return VL53L7CX_STATUS_ERROR;
}

uint8_t vl53l7cx_set_resolution(VL53L7CX_Configuration *, uint8_t)
{
    return VL53L7CX_STATUS_ERROR;
}

uint8_t vl53l7cx_set_ranging_frequency_hz(VL53L7CX_Configuration *, uint8_t)
{
    return VL53L7CX_STATUS_ERROR;
}

uint8_t vl53l7cx_start_ranging(VL53L7CX_Configuration *)
{
    return VL53L7CX_STATUS_ERROR;
}

uint8_t vl53l7cx_stop_ranging(VL53L7CX_Configuration *)
{
    return VL53L7CX_STATUS_ERROR;
}

uint8_t vl53l7cx_check_data_ready(VL53L7CX_Configuration *, uint8_t *is_ready)
{
    if (is_ready != nullptr)
        *is_ready = 0;
    return VL53L7CX_STATUS_ERROR;
}

uint8_t vl53l7cx_get_ranging_data(VL53L7CX_Configuration *, VL53L7CX_ResultsData *)
{
    return VL53L7CX_STATUS_ERROR;
}

}  // extern "C"
```

## src/test_port_traffic.c
```c
/*
 * Copyright (c) 2026, LexxPluss Inc.
 * All rights reserved.
 *
 * SPDX-License-Identifier: BSD-2-Clause
 *
 * Port-level tests: the wire shape and the errno path of zephyr/vl53lx_platform.c.
 *
 * These pin properties the ULD cannot check for us and a device cannot show us cheaply:
 * the register index is 16-bit big-endian, a write is two segments with no STOP between
 * them, a read is an index write followed by a repeated start and one final STOP, and
 * every Zephyr errno both maps into the ULD's error space and survives raw in the
 * sticky record. What is deliberately NOT here is any assertion about a sequence of
 * ULD registers: that would freeze vendor internals into our tests.
 */

#include <errno.h>
#include <string.h>

#include <zephyr/drivers/i2c.h>
#include <zephyr/ztest.h>

#include "fake_i2c.h"
#include "vl53l4cx_bus_io.h"
#include "vl53l4cx_port.h"
#include "vl53lx_platform.h"

#define TEST_ADDR7 0x29

static VL53L4CX_Object_t obj;

static void *setup(void)
{
	return NULL;
}

static void before(void *fixture)
{
	ARG_UNUSED(fixture);
	memset(&obj, 0, sizeof(obj));
	obj.IO.Address = TEST_ADDR7 << 1; /* ST's 8-bit wire convention */
	fake_i2c_reset();
	vl53l4cx_port_sticky_reset();
}

ZTEST_SUITE(tof_cliff_port, NULL, setup, before, NULL, NULL);

ZTEST(tof_cliff_port, test_write_sends_be16_index_then_payload_without_intermediate_stop)
{
	uint8_t payload[3] = {0xDE, 0xAD, 0xBE};

	zassert_equal(VL53LX_WriteMulti(&obj, 0xABCD, payload, sizeof(payload)),
		      VL53LX_ERROR_NONE);
	zassert_equal(fake_i2c_count, 1);

	const struct fake_i2c_xfer *x = &fake_i2c_log[0];

	zassert_equal(x->addr, TEST_ADDR7);
	zassert_equal(x->num_segs, 2, "the index must be its own segment, not a bounce buffer");

	/* Index: big-endian, high byte first. */
	zassert_equal(x->segs[0].len, 2);
	zassert_equal(x->segs[0].data[0], 0xAB);
	zassert_equal(x->segs[0].data[1], 0xCD);

	/* No STOP between index and payload: a STOP here would end the transaction and
	 * the part would treat the payload as a new register index. */
	zassert_equal(x->segs[0].flags & I2C_MSG_STOP, 0U);
	zassert_equal(x->segs[0].flags & I2C_MSG_READ, 0U);

	/* Payload continues the same write and terminates the transaction. */
	zassert_equal(x->segs[1].len, sizeof(payload));
	zassert_equal(x->segs[1].flags & I2C_MSG_READ, 0U);
	zassert_not_equal(x->segs[1].flags & I2C_MSG_STOP, 0U);
	zassert_equal(x->segs[1].flags & I2C_MSG_RESTART, 0U,
		      "a write payload must not begin a new transaction");
	zassert_mem_equal(x->segs[1].data, payload, sizeof(payload));
}

ZTEST(tof_cliff_port, test_zero_length_write_is_one_segment_with_stop)
{
	zassert_equal(VL53LX_WriteMulti(&obj, 0x0102, NULL, 0), VL53LX_ERROR_NONE);
	zassert_equal(fake_i2c_count, 1);
	zassert_equal(fake_i2c_log[0].num_segs, 1);
	zassert_not_equal(fake_i2c_log[0].segs[0].flags & I2C_MSG_STOP, 0U);
}

ZTEST(tof_cliff_port, test_read_uses_repeated_start_and_one_final_stop)
{
	uint8_t buf[2] = {0, 0};
	uint8_t reply[2] = {0xEE, 0xAA};

	fake_i2c_set_read_data(reply, sizeof(reply));
	zassert_equal(VL53LX_ReadMulti(&obj, 0x0102, buf, sizeof(buf)), VL53LX_ERROR_NONE);
	zassert_equal(fake_i2c_count, 1);

	const struct fake_i2c_xfer *x = &fake_i2c_log[0];

	zassert_equal(x->num_segs, 2);
	/* Index write first, no STOP. */
	zassert_equal(x->segs[0].len, 2);
	zassert_equal(x->segs[0].data[0], 0x01);
	zassert_equal(x->segs[0].data[1], 0x02);
	zassert_equal(x->segs[0].flags & I2C_MSG_READ, 0U);
	zassert_equal(x->segs[0].flags & I2C_MSG_STOP, 0U);
	/* Then a repeated start into the read, which is the only STOP. */
	zassert_not_equal(x->segs[1].flags & I2C_MSG_READ, 0U);
	zassert_not_equal(x->segs[1].flags & I2C_MSG_RESTART, 0U);
	zassert_not_equal(x->segs[1].flags & I2C_MSG_STOP, 0U);
	zassert_mem_equal(buf, reply, sizeof(reply));
}

ZTEST(tof_cliff_port, test_multibyte_accessors_are_big_endian_on_the_wire)
{
	uint8_t reply[4] = {0x11, 0x22, 0x33, 0x44};
	uint16_t w = 0;
	uint32_t d = 0;

	zassert_equal(VL53LX_WrWord(&obj, 0x0000, 0x1234), VL53LX_ERROR_NONE);
	zassert_equal(fake_i2c_log[0].segs[1].data[0], 0x12);
	zassert_equal(fake_i2c_log[0].segs[1].data[1], 0x34);

	zassert_equal(VL53LX_WrDWord(&obj, 0x0000, 0x89ABCDEFU), VL53LX_ERROR_NONE);
	zassert_equal(fake_i2c_log[1].segs[1].data[0], 0x89);
	zassert_equal(fake_i2c_log[1].segs[1].data[3], 0xEF);

	fake_i2c_set_read_data(reply, sizeof(reply));
	zassert_equal(VL53LX_RdWord(&obj, 0x0000, &w), VL53LX_ERROR_NONE);
	zassert_equal(w, 0x1122);
	zassert_equal(VL53LX_RdDWord(&obj, 0x0000, &d), VL53LX_ERROR_NONE);
	zassert_equal(d, 0x11223344U);
}

ZTEST(tof_cliff_port, test_st_eight_bit_address_is_halved_for_the_zephyr_api)
{
	uint8_t v = 0;

	/* IO.Address is ST's 8-bit wire address - VL53LX_SetDeviceAddress writes
	 * DeviceAddress / 2 to the part and VL53L4CX_SetAddress copies the 8-bit value
	 * back into this field - so 0x52 must reach Zephyr as 0x29. Getting this wrong
	 * addresses a neighbouring sensor rather than failing. */
	obj.IO.Address = 0x52;
	zassert_equal(VL53LX_WrByte(&obj, 0x0000, 0x00), VL53LX_ERROR_NONE);
	zassert_equal(VL53LX_RdByte(&obj, 0x0000, &v), VL53LX_ERROR_NONE);
	zassert_true(fake_i2c_all_addressed(0x29));
}

ZTEST(tof_cliff_port, test_a_seven_bit_address_left_in_the_field_is_refused_not_guessed)
{
	uint8_t v = 0;

	/* The two conventions overlap in 0x00..0x7F, so no heuristic can separate them.
	 * An odd value is the signature of a 7-bit address stored by mistake, and it must
	 * fail rather than address half the chain one bit off. */
	obj.IO.Address = 0x29;
	zassert_equal(VL53LX_WrByte(&obj, 0x0000, 0x00), VL53LX_ERROR_INVALID_PARAMS);
	zassert_equal(VL53LX_RdByte(&obj, 0x0000, &v), VL53LX_ERROR_INVALID_PARAMS);
	zassert_equal(fake_i2c_count, 0, "a malformed address must not reach the bus");
	zassert_equal(vl53l4cx_port_sticky_errno(), -EINVAL);

	/* Out of range likewise. */
	obj.IO.Address = 0x100;
	zassert_equal(VL53LX_WrByte(&obj, 0x0000, 0x00), VL53LX_ERROR_INVALID_PARAMS);
	zassert_equal(fake_i2c_count, 0);
}

ZTEST(tof_cliff_port, test_every_errno_maps_to_control_interface_and_is_kept_raw)
{
	static const int errnos[] = {-ENXIO, -ENODEV, -EIO, -ETIMEDOUT, -EBUSY, -EPERM};

	for (size_t i = 0; i < ARRAY_SIZE(errnos); i++) {
		fake_i2c_reset();
		vl53l4cx_port_sticky_reset();
		fake_i2c_fail_on(1, errnos[i]);

		zassert_equal(VL53LX_WrByte(&obj, 0x0000, 0x00),
			      VL53LX_ERROR_CONTROL_INTERFACE,
			      "a transport failure must never look like a vacant address");
		/* The mapping is lossy on purpose - the ULD has one code for every
		 * transport problem - so the raw value has to survive somewhere. */
		zassert_equal(vl53l4cx_port_sticky_errno(), errnos[i]);
	}
}

ZTEST(tof_cliff_port, test_sticky_keeps_the_first_errno_across_later_traffic)
{
	uint8_t v = 0;

	/* Middle transaction fails. Two succeed after it. */
	fake_i2c_fail_on(2, -ETIMEDOUT);
	zassert_equal(VL53LX_WrByte(&obj, 0x0000, 0x00), VL53LX_ERROR_NONE);
	zassert_equal(VL53LX_WrByte(&obj, 0x0001, 0x00), VL53LX_ERROR_CONTROL_INTERFACE);
	fake_i2c_fail_on(0, 0);
	zassert_equal(VL53LX_RdByte(&obj, 0x0002, &v), VL53LX_ERROR_NONE);
	zassert_equal(VL53LX_RdByte(&obj, 0x0003, &v), VL53LX_ERROR_NONE);

	/* A later success must not clear the record: this is the whole reason the
	 * adapter can trust the sticky value over a ULD return code. */
	zassert_equal(vl53l4cx_port_sticky_errno(), -ETIMEDOUT);

	vl53l4cx_port_sticky_reset();
	zassert_equal(vl53l4cx_port_sticky_errno(), 0);
}

ZTEST(tof_cliff_port, test_read_leaves_the_buffer_untouched_when_the_transfer_fails)
{
	uint8_t buf[2] = {0x5A, 0x5A};

	fake_i2c_fail_on(1, -EIO);
	zassert_equal(VL53LX_ReadMulti(&obj, 0x0000, buf, sizeof(buf)),
		      VL53LX_ERROR_CONTROL_INTERFACE);
	zassert_equal(buf[0], 0x5A, "a failed read must not fabricate data");
	zassert_equal(buf[1], 0x5A);
}

ZTEST(tof_cliff_port, test_word_accessors_do_not_write_through_on_failure)
{
	uint16_t w = 0xBEEF;
	uint32_t d = 0xDEADBEEFU;

	fake_i2c_fail_on(1, -EIO);
	zassert_equal(VL53LX_RdWord(&obj, 0x0000, &w), VL53LX_ERROR_CONTROL_INTERFACE);
	zassert_equal(w, 0xBEEF);

	fake_i2c_reset();
	fake_i2c_fail_on(1, -EIO);
	zassert_equal(VL53LX_RdDWord(&obj, 0x0000, &d), VL53LX_ERROR_CONTROL_INTERFACE);
	zassert_equal(d, 0xDEADBEEFU);
}

ZTEST(tof_cliff_port, test_gpio_hooks_all_refuse)
{
	uint8_t v = 0;

	/* There is no correct implementation: the enable line is the chain's addressing
	 * mechanism. A successful no-op would let a caller believe it had reset a part. */
	zassert_equal(VL53LX_GpioSetMode(0, 0), VL53LX_ERROR_GPIO_FUNCTIONALITY_NOT_SUPPORTED);
	zassert_equal(VL53LX_GpioSetValue(0, 0), VL53LX_ERROR_GPIO_FUNCTIONALITY_NOT_SUPPORTED);
	zassert_equal(VL53LX_GpioGetValue(0, &v), VL53LX_ERROR_GPIO_FUNCTIONALITY_NOT_SUPPORTED);
	zassert_equal(VL53LX_GpioXshutdown(0), VL53LX_ERROR_GPIO_FUNCTIONALITY_NOT_SUPPORTED);
	zassert_equal(VL53LX_GpioCommsSelect(0), VL53LX_ERROR_GPIO_FUNCTIONALITY_NOT_SUPPORTED);
	zassert_equal(VL53LX_GpioPowerEnable(0), VL53LX_ERROR_GPIO_FUNCTIONALITY_NOT_SUPPORTED);
	zassert_equal(fake_i2c_count, 0, "a refused GPIO hook must not touch the bus");
}

ZTEST(tof_cliff_port, test_bus_io_block_has_real_callbacks_and_failing_placeholders)
{
	VL53L4CX_IO_t io;

	vl53l4cx_bus_io_fill(&io, TEST_ADDR7);

	/* One place converts the 7-bit address a caller thinks in to the 8-bit form the
	 * ULD stores, so no other layer has to know the convention. */
	zassert_equal(io.Address, TEST_ADDR7 << 1);

	/* VL53L4CX_RegisterBusIO fails when Init is null, and VL53L4CX_DeInit calls
	 * DeInit with no null check at all, so neither may be omitted. */
	zassert_not_null(io.Init);
	zassert_not_null(io.DeInit);

	/* Init is a real check, not an unconditional success: RegisterBusIO returns
	 * whatever it returns, so a controller that never initialised must fail at open
	 * with a stage attached rather than at the first transfer of the first read. */
	zassert_true(vl53l4cx_port_bus_ready(), "the emulated controller must be ready");
	zassert_equal(io.Init(), 0);
	zassert_equal(io.DeInit(), 0);

	/* GetTick has to be real: upstream/vl53l4cx.c polls with it directly. */
	zassert_not_null(io.GetTick);
	(void)io.GetTick();

	/* WriteReg and ReadReg are placeholders precisely because there is one real I2C
	 * path. Their only caller anywhere in the snapshot is the upstream example layer,
	 * which is not compiled, so traffic through them means a second transport path
	 * appeared behind the port's back. */
	zassert_not_null(io.WriteReg);
	zassert_not_null(io.ReadReg);
	zassert_equal(vl53l4cx_bus_io_placeholder_calls(), 0);
	zassert_not_equal(io.WriteReg(TEST_ADDR7, NULL, 0), 0);
	zassert_not_equal(io.ReadReg(TEST_ADDR7, NULL, 0), 0);
	zassert_equal(vl53l4cx_bus_io_placeholder_calls(), 2,
		      "the counter is the defence in depth behind the missing enable API");
	vl53l4cx_bus_io_reset_placeholder_calls();
	zassert_equal(vl53l4cx_bus_io_placeholder_calls(), 0);
}
```

## src/test_stream_loop.cpp
```c
/*
 * Copyright (c) 2026, LexxPluss Inc.
 * All rights reserved.
 *
 * Redistribution and use in source and binary forms, with or without
 * modification, are permitted provided that the following conditions are met:
 *
 * 1. Redistributions of source code must retain the above copyright notice,
 *    this list of conditions and the following disclaimer.
 * 2. Redistributions in binary form must reproduce the above copyright notice,
 *    this list of conditions and the following disclaimer in the documentation
 *    and/or other materials provided with the distribution.
 *
 * THIS SOFTWARE IS PROVIDED BY THE COPYRIGHT HOLDERS AND CONTRIBUTORS "AS IS" AND
 * ANY EXPRESS OR IMPLIED WARRANTIES, INCLUDING, BUT NOT LIMITED TO, THE IMPLIED
 * WARRANTIES OF MERCHANTABILITY AND FITNESS FOR A PARTICULAR PURPOSE ARE
 * DISCLAIMED. IN NO EVENT SHALL THE COPYRIGHT OWNER OR CONTRIBUTORS BE LIABLE FOR
 * ANY DIRECT, INDIRECT, INCIDENTAL, SPECIAL, EXEMPLARY, OR CONSEQUENTIAL DAMAGES
 * (INCLUDING, BUT NOT LIMITED TO, PROCUREMENT OF SUBSTITUTE GOODS OR SERVICES;
 * LOSS OF USE, DATA, OR PROFITS; OR BUSINESS INTERRUPTION) HOWEVER CAUSED AND
 * ON ANY THEORY OF LIABILITY, WHETHER IN CONTRACT, STRICT LIABILITY, OR TORT
 * (INCLUDING NEGLIGENCE OR OTHERWISE) ARISING IN ANY WAY OUT OF THE USE OF THIS
 * SOFTWARE, EVEN IF ADVISED OF THE POSSIBILITY OF SUCH DAMAGE.
 */

// The bench multi-frame read loop, driven by a scripted ops table. The loop is the whole point
// of the command -- `tof cliff read` stops at the first fresh frame, so every L4 sample this
// project has recorded is frame one after a restart -- and the ways it can be wrong are all
// silent: a dropped frame, a miscounted attempt, or a session that keeps polling a sensor that
// already failed.

#include <errno.h>
#include <string.h>

#include <zephyr/ztest.h>

#include "tof_cliff_stream_loop.hpp"

namespace
{

namespace st = lexxhard::tof_cliff_stream;
namespace acq = lexxhard::tof_acq;

// One scripted reply per read call.
struct scripted_read {
    int rc{0};
    bool fresh{false};
    bool sample_present{false};
    uint8_t stream_count{0};
};

constexpr size_t kMaxScripted{8};

struct script {
    scripted_read replies[kMaxScripted]{};
    size_t reply_count{0};
    size_t next{0};
    int read_calls{0};
    int sleep_calls{0};
};

script g_script;
uint8_t g_seen_stream_counts[kMaxScripted];
size_t g_seen_count;

int fake_read(void *dev, void *, struct tof_cliff_sample *out, acq::op_status *st_out)
{
    auto &s{*static_cast<script *>(dev)};
    ++s.read_calls;
    memset(out, 0, sizeof(*out));
    memset(st_out, 0, sizeof(*st_out));
    if (s.next >= s.reply_count)
        return -EIO;
    const scripted_read r{s.replies[s.next++]};
    out->fresh = r.fresh;
    out->stream_count = r.stream_count;
    out->target_count = 0;
    out->entry_count = 1;
    st_out->sample_present = r.sample_present;
    return r.rc;
}

void collect(void *, unsigned, const struct tof_cliff_sample &sample)
{
    if (g_seen_count < kMaxScripted)
        g_seen_stream_counts[g_seen_count++] = sample.stream_count;
}

void counting_sleep(unsigned)
{
    ++g_script.sleep_calls;
}

acq::source_ops ops_with_fake_read()
{
    acq::source_ops ops{};
    ops.read_cliff_sample = fake_read;
    return ops;
}

st::progress run(const scripted_read *replies, size_t count, unsigned want, unsigned max_attempts,
                 unsigned gap_ms = 0)
{
    g_script = script{};
    for (size_t i{0}; i < count && i < kMaxScripted; ++i)
        g_script.replies[i] = replies[i];
    g_script.reply_count = count;
    g_seen_count = 0;
    acq::op_status status{};
    const acq::source_ops ops{ops_with_fake_read()};
    const st::params p{want, gap_ms, max_attempts};
    return st::run_loop(ops, &g_script, nullptr, status, p, collect, nullptr, counting_sleep);
}

}  // namespace

// The reason the command exists: several fresh frames come back from ONE session, in order.
ZTEST(tof_cliff_stream_loop, test_collects_every_fresh_frame_in_order)
{
    const scripted_read sc[]{ { 0, true, true, 10 }, { 0, true, true, 11 }, { 0, true, true, 12 } };
    const auto pr{ run(sc, 3, 3, 10) };

    zassert_equal(3, pr.frames_collected);
    zassert_equal(3, g_script.read_calls, "one read per frame, no restart between them");
    zassert_equal(3u, g_seen_count);
    zassert_equal(10, g_seen_stream_counts[0]);
    zassert_equal(11, g_seen_stream_counts[1]);
    zassert_equal(12, g_seen_stream_counts[2]);
}

// A not-ready check spends an attempt but is not a frame. Getting this wrong would report a
// sensor as having produced frames it never produced.
ZTEST(tof_cliff_stream_loop, test_a_not_ready_check_spends_an_attempt_but_is_not_a_frame)
{
    const scripted_read sc[]{ { 0, false, false, 0 }, { 0, false, false, 0 }, { 0, true, true, 7 } };
    const auto pr{ run(sc, 3, 1, 10) };

    zassert_equal(1, pr.frames_collected);
    zassert_equal(3, pr.attempts_used, "the two empty checks count as attempts");
    zassert_equal(1u, g_seen_count);
    zassert_equal(7, g_seen_stream_counts[0]);
}

// The loop stops as soon as it has what was asked for, rather than spending the whole budget.
ZTEST(tof_cliff_stream_loop, test_stops_at_the_requested_frame_count)
{
    const scripted_read sc[]{ { 0, true, true, 1 }, { 0, true, true, 2 }, { 0, true, true, 3 } };
    const auto pr{ run(sc, 3, 2, 10) };

    zassert_equal(2, pr.frames_collected);
    zassert_equal(2, g_script.read_calls, "the third reply was never requested");
}

// A failed read ends the session. Polling a sensor that already failed a fetch produces noise,
// not data.
ZTEST(tof_cliff_stream_loop, test_a_read_error_ends_the_session)
{
    const scripted_read sc[]{ { 0, true, true, 1 }, { -EIO, false, false, 0 }, { 0, true, true, 3 } };
    const auto pr{ run(sc, 3, 5, 10) };

    zassert_equal(1, pr.frames_collected);
    zassert_equal(-EIO, pr.last_read_rc);
    zassert_equal(2, g_script.read_calls, "nothing was read after the failure");
}

// THE ONE THAT MATTERS. read_once reports a failed re-arm as an error while leaving the fetched
// sample intact and sample_present set. Checking the return code before the sample would throw
// away a frame the sensor really produced -- and it is the last frame of the session, the one
// that explains why it ended.
ZTEST(tof_cliff_stream_loop, test_a_sample_that_arrives_with_a_failed_rearm_is_kept)
{
    const scripted_read sc[]{ { 0, true, true, 4 }, { -EIO, true, true, 5 } };
    const auto pr{ run(sc, 2, 5, 10) };

    zassert_equal(2, pr.frames_collected, "the re-arm failure must not discard its own sample");
    zassert_equal(-EIO, pr.last_read_rc);
    zassert_equal(2u, g_seen_count);
    zassert_equal(5, g_seen_stream_counts[1]);
}

// An error with no sample behind it is just an error.
ZTEST(tof_cliff_stream_loop, test_an_error_without_a_sample_yields_no_frame)
{
    const scripted_read sc[]{ { -EIO, false, false, 0 } };
    const auto pr{ run(sc, 1, 5, 10) };

    zassert_equal(0, pr.frames_collected);
    zassert_equal(-EIO, pr.last_read_rc);
}

// fresh without sample_present is not a frame: the guard is the status, not the flag alone.
ZTEST(tof_cliff_stream_loop, test_fresh_without_sample_present_is_not_a_frame)
{
    const scripted_read sc[]{ { 0, true, false, 9 } };
    const auto pr{ run(sc, 1, 5, 10) };

    zassert_equal(0, pr.frames_collected);
    zassert_equal(0u, g_seen_count);
}

// The attempt budget bounds the session even when the sensor never becomes ready. Without it the
// loop would hold the chain lock indefinitely.
ZTEST(tof_cliff_stream_loop, test_the_attempt_budget_bounds_a_sensor_that_never_readies)
{
    const scripted_read sc[]{ { 0, false, false, 0 },
                              { 0, false, false, 0 },
                              { 0, false, false, 0 },
                              { 0, false, false, 0 } };
    const auto pr{ run(sc, 4, 2, 3) };

    zassert_equal(0, pr.frames_collected);
    zassert_equal(3, pr.attempts_used);
    zassert_equal(3, g_script.read_calls);
}

// The gap separates reads; it is never spent after the last one. A pause there is dead time
// holding the chain lock, and on a bus this command shares that is not free.
ZTEST(tof_cliff_stream_loop, test_the_gap_separates_reads_and_is_never_spent_after_the_last)
{
    const scripted_read one[]{ { 0, true, true, 1 } };
    run(one, 1, 1, 5, 20);
    zassert_equal(0, g_script.sleep_calls, "a single requested frame has nothing to wait for");

    const scripted_read two[]{ { 0, true, true, 1 }, { 0, true, true, 2 } };
    run(two, 2, 2, 5, 20);
    zassert_equal(1, g_script.sleep_calls, "one gap BETWEEN the two frames, none after the second");

    const scripted_read retry[]{ { 0, false, false, 0 }, { 0, true, true, 2 } };
    run(retry, 2, 1, 5, 20);
    zassert_equal(1, g_script.sleep_calls, "one pause between the empty check and the retry");

    const scripted_read nogap[]{ { 0, true, true, 1 }, { 0, true, true, 2 } };
    run(nogap, 2, 2, 5, 0);
    zassert_equal(0, g_script.sleep_calls, "gap_ms=0 means no pause at all");
}

ZTEST_SUITE(tof_cliff_stream_loop, NULL, NULL, NULL, NULL, NULL);
```
