## lexxpluss_apps/tests/tof_integration_wiring/testcase.yaml
```yaml
common:
  platform_allow: native_sim
  tags: tof
tests:
  tof.integration_wiring: {}
```

## lexxpluss_apps/tests/tof_l7_blob_provisioner/testcase.yaml
```yaml
tests:
  tof.l7.blob_provisioner:
    platform_allow: native_sim
    tags: tof l7 blob provisioner
```

## lexxpluss_apps/tests/tof_l7_quiesce/testcase.yaml
```yaml
tests:
  tof.l7.quiesce:
    platform_allow: native_sim
    tags: tof l7 quiesce
```

## lexxpluss_apps/tests/tof_l7_recovery/testcase.yaml
```yaml
common:
  platform_allow: native_sim
  tags: tof l7
tests:
  tof.l7.recovery: {}
```

## lexxpluss_apps/tests/tof_l7_uld_boot/testcase.yaml
```yaml
tests:
  tof.l7.uld.boot:
    platform_allow: native_sim
    tags: tof l7 uld boot
```

## lexxpluss_apps/tests/tof_l7_uld_stop/testcase.yaml
```yaml
common:
  platform_allow: native_sim
  tags: tof l7 uld
tests:
  tof.l7.uld.stop: {}
```

## lexxpluss_apps/tests/tof_long_operation/testcase.yaml
```yaml
tests:
  tof.long.operation:
    platform_allow: native_sim
    tags: tof watchdog long_operation
```

## lexxpluss_apps/tests/tof_package_auto/testcase.yaml
```yaml
tests:
  tof.package.auto:
    platform_allow: native_sim
    tags: tof l7 package auto
```

## lexxpluss_apps/tests/tof_package_l7/testcase.yaml
```yaml
tests:
  tof.package.l7:
    platform_allow: native_sim
    tags: tof l7 package
```
