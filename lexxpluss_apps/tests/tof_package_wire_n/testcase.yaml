## lexxpluss_apps/tests/tof_progress/testcase.yaml
```yaml
common:
  platform_allow: native_sim
  tags: tof watchdog
tests:
  tof.progress: {}
```

## lexxpluss_apps/tests/tof_watchdog_tombstone/testcase.yaml
```yaml
common:
  platform_allow: native_sim
  tags: tof watchdog forensics
tests:
  tof.watchdog.tombstone: {}
```

## lexxpluss_apps/tests/wheel_power/testcase.yaml
```yaml
tests:
  wheel_power.output:
    platform_allow: native_sim
    tags: wheel_power
    timeout: 300
```
