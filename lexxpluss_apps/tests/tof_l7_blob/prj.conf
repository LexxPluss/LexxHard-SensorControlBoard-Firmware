## CMakeLists.txt
```
# Copyright (c) 2026, LexxPluss Inc.
# All rights reserved.
#
# SPDX-License-Identifier: BSD-2-Clause

# The stored blob record, with the real SHA-256 and the real CRC. The only thing faked is where the
# bytes come from: on a board it is memory-mapped flash, here it is a RAM buffer a case can damage.
# The record itself is the GENERATOR's output, committed as src/golden_record.h -- a layout written
# once at manufacture and read at every boot needs its two implementations pinned to each other.
cmake_minimum_required(VERSION 3.20.0)

find_package(Zephyr REQUIRED HINTS $ENV{ZEPHYR_BASE})
project(tof_l7_blob_test)

set(APP_SRC_DIR ${CMAKE_CURRENT_SOURCE_DIR}/../../src)

target_sources(app PRIVATE
    src/test_main.cpp
    ${APP_SRC_DIR}/tof_l7_blob_record.cpp
    ${APP_SRC_DIR}/tof_l7_runtime.cpp
    # The provider, for the one thing about it that is testable without a board: what it promises
    # about `out` when the partition will not open at all. Its success path dereferences a
    # memory-mapped flash address and belongs on hardware.
    ${APP_SRC_DIR}/tof_l7_blob_provider.cpp
)
target_compile_definitions(app PRIVATE ENABLE_TOF_CHAIN ENABLE_TOF_L7_ULD)
target_include_directories(app PRIVATE
    ${APP_SRC_DIR}
    ${CMAKE_CURRENT_SOURCE_DIR}/../../third_party/st/vl53l7cx_uld/zephyr
)
```

## prj.conf
```kconfig
CONFIG_ZTEST=y
CONFIG_CPP=y
CONFIG_STD_CPP20=y
CONFIG_GLIBCXX_LIBCPP=y
# SHA-256 for the payload's integrity check. tinycrypt rather than mbedtls: this is one hash over
# 84 KiB at boot, and the smaller implementation is the one that has to fit in a slot whose tail
#tail margin is already the constraint that put the blob in flash to begin with.
# CRC-32 for the header. Not implied by anything else here, and the production image will need the
# same symbol -- an omission that only shows up as a link error, which is the good direction.
CONFIG_CRC=y
CONFIG_TINYCRYPT=y
CONFIG_TINYCRYPT_SHA256=y
```

## src/golden_record.h
```c
/*
 * GENERATED by the L7 blob-record generator's golden mode -- do not edit.
 *
 * A complete, valid record, small enough to sit in a test binary. The suite verifies THESE bytes
 * with the production reader, which is what pins the generator and the reader together: if either
 * side changes its mind about the layout, a host test fails instead of a board.
 *
 * The payload is synthetic so this test stays small. The real vendor array is preserved once in the
 * upstream snapshot and is never duplicated into this test image.
 */

#pragma once

#include <stddef.h>
#include <stdint.h>

namespace lexxhard::tof_l7_blob::golden {

inline constexpr size_t kPayloadLen{1024};
inline constexpr size_t kRecordLen{1092};

inline constexpr uint8_t kPayloadDigest[32]{
    0xc7, 0x36, 0xc6, 0x35, 0xe3, 0x6d, 0xa1, 0x59, 0x85, 0x4b, 0x28, 0x98,
    0xad, 0x93, 0x07, 0xd6, 0x84, 0x3c, 0xfb, 0x07, 0x3e, 0x13, 0x9c, 0xc4,
    0xb9, 0x3b, 0x5c, 0x3b, 0x2c, 0xcf, 0x37, 0x6a,
};

// Header plus payload, exactly as the generator writes it to flash.
inline constexpr uint8_t kRecord[kRecordLen]{
    0x4c, 0x37, 0x42, 0x31, 0x02, 0x00, 0x40, 0x00, 0x00, 0x04, 0x00, 0x00,
    0xc7, 0x36, 0xc6, 0x35, 0xe3, 0x6d, 0xa1, 0x59, 0x85, 0x4b, 0x28, 0x98,
    0xad, 0x93, 0x07, 0xd6, 0x84, 0x3c, 0xfb, 0x07, 0x3e, 0x13, 0x9c, 0xc4,
    0xb9, 0x3b, 0x5c, 0x3b, 0x2c, 0xcf, 0x37, 0x6a, 0x00, 0x00, 0x00, 0x00,
    0x00, 0x00, 0x00, 0x00, 0x00, 0x00, 0x00, 0x00, 0x00, 0x00, 0x00, 0x00,
    0xb3, 0x88, 0x0c, 0x99, 0xa5, 0xba, 0x9b, 0xf8, 0xd9, 0x3e, 0x1f, 0x7c,
    0x5d, 0xb2, 0x93, 0xf0, 0xd1, 0x36, 0x17, 0x74, 0x55, 0xaa, 0x8b, 0xe8,
    0xc9, 0x2e, 0x0f, 0x6c, 0x4d, 0xa2, 0x83, 0xe0, 0xc1, 0x26, 0x07, 0x64,
    0x44, 0x5b, 0xba, 0x99, 0xf8, 0xdf, 0x3e, 0x1d, 0x7c, 0x53, 0xb2, 0x91,
    0xf0, 0xd7, 0x36, 0x15, 0x74, 0x4b, 0xaa, 0x89, 0xe8, 0xcf, 0x2e, 0x0d,
    0x6c, 0x43, 0xa2, 0x81, 0xe0, 0xc7, 0x26, 0x05, 0x67, 0x78, 0x59, 0xba,
    0x9b, 0xfc, 0xdd, 0x3e, 0x1f, 0x70, 0x51, 0xb2, 0x93, 0xf4, 0xd5, 0x36,
    0x17, 0x68, 0x49, 0xaa, 0x8b, 0xec, 0xcd, 0x2e, 0x0f, 0x60, 0x41, 0xa2,
    0x83, 0xe4, 0xc5, 0x26, 0x06, 0x19, 0x78, 0x5b, 0xba, 0x9d, 0xfc, 0xdf,
    0x3e, 0x11, 0x70, 0x53, 0xb2, 0x95, 0xf4, 0xd7, 0x36, 0x09, 0x68, 0x4b,
    0xaa, 0x8d, 0xec, 0xcf, 0x2e, 0x01, 0x60, 0x43, 0xa2, 0x85, 0xe4, 0xc7,
    0x21, 0x3e, 0x1f, 0x7c, 0x5d, 0xba, 0x9b, 0xf8, 0xd9, 0x36, 0x17, 0x74,
    0x55, 0xb2, 0x93, 0xf0, 0xd1, 0x2e, 0x0f, 0x6c, 0x4d, 0xaa, 0x8b, 0xe8,
    0xc9, 0x26, 0x07, 0x64, 0x45, 0xa2, 0x83, 0xe0, 0xc0, 0xdf, 0x3e, 0x1d,
    0x7c, 0x5b, 0xba, 0x99, 0xf8, 0xd7, 0x36, 0x15, 0x74, 0x53, 0xb2, 0x91,
    0xf0, 0xcf, 0x2e, 0x0d, 0x6c, 0x4b, 0xaa, 0x89, 0xe8, 0xc7, 0x26, 0x05,
    0x64, 0x43, 0xa2, 0x81, 0xe3, 0xfc, 0xdd, 0x3e, 0x1f, 0x78, 0x59, 0xba,
    0x9b, 0xf4, 0xd5, 0x36, 0x17, 0x70, 0x51, 0xb2, 0x93, 0xec, 0xcd, 0x2e,
    0x0f, 0x68, 0x49, 0xaa, 0x8b, 0xe4, 0xc5, 0x26, 0x07, 0x60, 0x41, 0xa2,
    0x82, 0x9d, 0xfc, 0xdf, 0x3e, 0x19, 0x78, 0x5b, 0xba, 0x95, 0xf4, 0xd7,
    0x36, 0x11, 0x70, 0x53, 0xb2, 0x8d, 0xec, 0xcf, 0x2e, 0x09, 0x68, 0x4b,
    0xaa, 0x85, 0xe4, 0xc7, 0x26, 0x01, 0x60, 0x43, 0xad, 0xb2, 0x93, 0xf0,
    0xd1, 0x36, 0x17, 0x74, 0x55, 0xba, 0x9b, 0xf8, 0xd9, 0x3e, 0x1f, 0x7c,
    0x5d, 0xa2, 0x83, 0xe0, 0xc1, 0x26, 0x07, 0x64, 0x45, 0xaa, 0x8b, 0xe8,
    0xc9, 0x2e, 0x0f, 0x6c, 0x4c, 0x53, 0xb2, 0x91, 0xf0, 0xd7, 0x36, 0x15,
    0x74, 0x5b, 0xba, 0x99, 0xf8, 0xdf, 0x3e, 0x1d, 0x7c, 0x43, 0xa2, 0x81,
    0xe0, 0xc7, 0x26, 0x05, 0x64, 0x4b, 0xaa, 0x89, 0xe8, 0xcf, 0x2e, 0x0d,
    0x6f, 0x70, 0x51, 0xb2, 0x93, 0xf4, 0xd5, 0x36, 0x17, 0x78, 0x59, 0xba,
    0x9b, 0xfc, 0xdd, 0x3e, 0x1f, 0x60, 0x41, 0xa2, 0x83, 0xe4, 0xc5, 0x26,
    0x07, 0x68, 0x49, 0xaa, 0x8b, 0xec, 0xcd, 0x2e, 0x0e, 0x11, 0x70, 0x53,
    0xb2, 0x95, 0xf4, 0xd7, 0x36, 0x19, 0x78, 0x5b, 0xba, 0x9d, 0xfc, 0xdf,
    0x3e, 0x01, 0x60, 0x43, 0xa2, 0x85, 0xe4, 0xc7, 0x26, 0x09, 0x68, 0x4b,
    0xaa, 0x8d, 0xec, 0xcf, 0x29, 0x36, 0x17, 0x74, 0x55, 0xb2, 0x93, 0xf0,
    0xd1, 0x3e, 0x1f, 0x7c, 0x5d, 0xba, 0x9b, 0xf8, 0xd9, 0x26, 0x07, 0x64,
    0x45, 0xa2, 0x83, 0xe0, 0xc1, 0x2e, 0x0f, 0x6c, 0x4d, 0xaa, 0x8b, 0xe8,
    0xc8, 0xd7, 0x36, 0x15, 0x74, 0x53, 0xb2, 0x91, 0xf0, 0xdf, 0x3e, 0x1d,
    0x7c, 0x5b, 0xba, 0x99, 0xf8, 0xc7, 0x26, 0x05, 0x64, 0x43, 0xa2, 0x81,
    0xe0, 0xcf, 0x2e, 0x0d, 0x6c, 0x4b, 0xaa, 0x89, 0xeb, 0xf4, 0xd5, 0x36,
    0x17, 0x70, 0x51, 0xb2, 0x93, 0xfc, 0xdd, 0x3e, 0x1f, 0x78, 0x59, 0xba,
    0x9b, 0xe4, 0xc5, 0x26, 0x07, 0x60, 0x41, 0xa2, 0x83, 0xec, 0xcd, 0x2e,
    0x0f, 0x68, 0x49, 0xaa, 0x8a, 0x95, 0xf4, 0xd7, 0x36, 0x11, 0x70, 0x53,
    0xb2, 0x9d, 0xfc, 0xdf, 0x3e, 0x19, 0x78, 0x5b, 0xba, 0x85, 0xe4, 0xc7,
    0x26, 0x01, 0x60, 0x43, 0xa2, 0x8d, 0xec, 0xcf, 0x2e, 0x09, 0x68, 0x4b,
    0xb5, 0xaa, 0x8b, 0xe8, 0xc9, 0x2e, 0x0f, 0x6c, 0x4d, 0xa2, 0x83, 0xe0,
    0xc1, 0x26, 0x07, 0x64, 0x45, 0xba, 0x9b, 0xf8, 0xd9, 0x3e, 0x1f, 0x7c,
    0x5d, 0xb2, 0x93, 0xf0, 0xd1, 0x36, 0x17, 0x74, 0x54, 0x4b, 0xaa, 0x89,
    0xe8, 0xcf, 0x2e, 0x0d, 0x6c, 0x43, 0xa2, 0x81, 0xe0, 0xc7, 0x26, 0x05,
    0x64, 0x5b, 0xba, 0x99, 0xf8, 0xdf, 0x3e, 0x1d, 0x7c, 0x53, 0xb2, 0x91,
    0xf0, 0xd7, 0x36, 0x15, 0x77, 0x68, 0x49, 0xaa, 0x8b, 0xec, 0xcd, 0x2e,
    0x0f, 0x60, 0x41, 0xa2, 0x83, 0xe4, 0xc5, 0x26, 0x07, 0x78, 0x59, 0xba,
    0x9b, 0xfc, 0xdd, 0x3e, 0x1f, 0x70, 0x51, 0xb2, 0x93, 0xf4, 0xd5, 0x36,
    0x16, 0x09, 0x68, 0x4b, 0xaa, 0x8d, 0xec, 0xcf, 0x2e, 0x01, 0x60, 0x43,
    0xa2, 0x85, 0xe4, 0xc7, 0x26, 0x19, 0x78, 0x5b, 0xba, 0x9d, 0xfc, 0xdf,
    0x3e, 0x11, 0x70, 0x53, 0xb2, 0x95, 0xf4, 0xd7, 0x31, 0x2e, 0x0f, 0x6c,
    0x4d, 0xaa, 0x8b, 0xe8, 0xc9, 0x26, 0x07, 0x64, 0x45, 0xa2, 0x83, 0xe0,
    0xc1, 0x3e, 0x1f, 0x7c, 0x5d, 0xba, 0x9b, 0xf8, 0xd9, 0x36, 0x17, 0x74,
    0x55, 0xb2, 0x93, 0xf0, 0xd0, 0xcf, 0x2e, 0x0d, 0x6c, 0x4b, 0xaa, 0x89,
    0xe8, 0xc7, 0x26, 0x05, 0x64, 0x43, 0xa2, 0x81, 0xe0, 0xdf, 0x3e, 0x1d,
    0x7c, 0x5b, 0xba, 0x99, 0xf8, 0xd7, 0x36, 0x15, 0x74, 0x53, 0xb2, 0x91,
    0xf3, 0xec, 0xcd, 0x2e, 0x0f, 0x68, 0x49, 0xaa, 0x8b, 0xe4, 0xc5, 0x26,
    0x07, 0x60, 0x41, 0xa2, 0x83, 0xfc, 0xdd, 0x3e, 0x1f, 0x78, 0x59, 0xba,
    0x9b, 0xf4, 0xd5, 0x36, 0x17, 0x70, 0x51, 0xb2, 0x92, 0x8d, 0xec, 0xcf,
    0x2e, 0x09, 0x68, 0x4b, 0xaa, 0x85, 0xe4, 0xc7, 0x26, 0x01, 0x60, 0x43,
    0xa2, 0x9d, 0xfc, 0xdf, 0x3e, 0x19, 0x78, 0x5b, 0xba, 0x95, 0xf4, 0xd7,
    0x36, 0x11, 0x70, 0x53, 0xbd, 0xa2, 0x83, 0xe0, 0xc1, 0x26, 0x07, 0x64,
    0x45, 0xaa, 0x8b, 0xe8, 0xc9, 0x2e, 0x0f, 0x6c, 0x4d, 0xb2, 0x93, 0xf0,
    0xd1, 0x36, 0x17, 0x74, 0x55, 0xba, 0x9b, 0xf8, 0xd9, 0x3e, 0x1f, 0x7c,
    0x5c, 0x43, 0xa2, 0x81, 0xe0, 0xc7, 0x26, 0x05, 0x64, 0x4b, 0xaa, 0x89,
    0xe8, 0xcf, 0x2e, 0x0d, 0x6c, 0x53, 0xb2, 0x91, 0xf0, 0xd7, 0x36, 0x15,
    0x74, 0x5b, 0xba, 0x99, 0xf8, 0xdf, 0x3e, 0x1d, 0x7f, 0x60, 0x41, 0xa2,
    0x83, 0xe4, 0xc5, 0x26, 0x07, 0x68, 0x49, 0xaa, 0x8b, 0xec, 0xcd, 0x2e,
    0x0f, 0x70, 0x51, 0xb2, 0x93, 0xf4, 0xd5, 0x36, 0x17, 0x78, 0x59, 0xba,
    0x9b, 0xfc, 0xdd, 0x3e, 0x1e, 0x01, 0x60, 0x43, 0xa2, 0x85, 0xe4, 0xc7,
    0x26, 0x09, 0x68, 0x4b, 0xaa, 0x8d, 0xec, 0xcf, 0x2e, 0x11, 0x70, 0x53,
    0xb2, 0x95, 0xf4, 0xd7, 0x36, 0x19, 0x78, 0x5b, 0xba, 0x9d, 0xfc, 0xdf,
    0x39, 0x26, 0x07, 0x64, 0x45, 0xa2, 0x83, 0xe0, 0xc1, 0x2e, 0x0f, 0x6c,
    0x4d, 0xaa, 0x8b, 0xe8, 0xc9, 0x36, 0x17, 0x74, 0x55, 0xb2, 0x93, 0xf0,
    0xd1, 0x3e, 0x1f, 0x7c, 0x5d, 0xba, 0x9b, 0xf8, 0xd8, 0xc7, 0x26, 0x05,
    0x64, 0x43, 0xa2, 0x81, 0xe0, 0xcf, 0x2e, 0x0d, 0x6c, 0x4b, 0xaa, 0x89,
    0xe8, 0xd7, 0x36, 0x15, 0x74, 0x53, 0xb2, 0x91, 0xf0, 0xdf, 0x3e, 0x1d,
    0x7c, 0x5b, 0xba, 0x99, 0xfb, 0xe4, 0xc5, 0x26, 0x07, 0x60, 0x41, 0xa2,
    0x83, 0xec, 0xcd, 0x2e, 0x0f, 0x68, 0x49, 0xaa, 0x8b, 0xf4, 0xd5, 0x36,
    0x17, 0x70, 0x51, 0xb2, 0x93, 0xfc, 0xdd, 0x3e, 0x1f, 0x78, 0x59, 0xba,
    0x9a, 0x85, 0xe4, 0xc7, 0x26, 0x01, 0x60, 0x43, 0xa2, 0x8d, 0xec, 0xcf,
    0x2e, 0x09, 0x68, 0x4b, 0xaa, 0x95, 0xf4, 0xd7, 0x36, 0x11, 0x70, 0x53,
    0xb2, 0x9d, 0xfc, 0xdf, 0x3e, 0x19, 0x78, 0x5b, 0x4c, 0x37, 0x4f, 0x4b,
};

}  // namespace lexxhard::tof_l7_blob::golden
```
