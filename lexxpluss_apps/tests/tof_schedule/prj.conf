## CMakeLists.txt
```
# Copyright (c) 2026, LexxPluss Inc.
# All rights reserved.
#
# Redistribution and use in source and binary forms, with or without
# modification, are permitted provided that the following conditions are met:
#
# 1. Redistributions of source code must retain the above copyright notice,
#    this list of conditions and the following disclaimer.
# 2. Redistributions in binary form must reproduce the above copyright notice,
#    this list of conditions and the following disclaimer in the documentation
#    and/or other materials provided with the distribution.
#
# THIS SOFTWARE IS PROVIDED BY THE COPYRIGHT HOLDERS AND CONTRIBUTORS "AS IS" AND
# ANY EXPRESS OR IMPLIED WARRANTIES, INCLUDING, BUT NOT LIMITED TO, THE IMPLIED
# WARRANTIES OF MERCHANTABILITY AND FITNESS FOR A PARTICULAR PURPOSE ARE
# DISCLAIMED. IN NO EVENT SHALL THE COPYRIGHT OWNER OR CONTRIBUTORS BE LIABLE FOR
# ANY DIRECT, INDIRECT, INCIDENTAL, SPECIAL, EXEMPLARY, OR CONSEQUENTIAL DAMAGES
# (INCLUDING, BUT NOT LIMITED TO, PROCUREMENT OF SUBSTITUTE GOODS OR SERVICES;
# LOSS OF USE, DATA, OR PROFITS; OR BUSINESS INTERRUPTION) HOWEVER CAUSED AND
# ON ANY THEORY OF LIABILITY, WHETHER IN CONTRACT, STRICT LIABILITY, OR TORT
# (INCLUDING NEGLIGENCE OR OTHERWISE) ARISING IN ANY WAY OUT OF THE USE OF THIS
# SOFTWARE, EVEN IF ADVISED OF THE POSSIBILITY OF SUCH DAMAGE.


# Host-side scheduling model for the six-sensor chain. The model is test-only: it is
# never linked into firmware, so it costs no flash and answers a design question that
# a running board cannot answer cheaply -- what a schedule would do at speeds and block
# sizes we have not built yet.
cmake_minimum_required(VERSION 3.20.0)

find_package(Zephyr REQUIRED HINTS $ENV{ZEPHYR_BASE})
project(tof_schedule_test)

target_sources(app PRIVATE
    src/tof_schedule_model.cpp
    src/test_tof_schedule.cpp
)
target_include_directories(app PRIVATE ${CMAKE_CURRENT_SOURCE_DIR}/src)
```

## prj.conf
```kconfig
CONFIG_ZTEST=y
CONFIG_CPP=y
CONFIG_STD_CPP20=y
CONFIG_GLIBCXX_LIBCPP=y
CONFIG_MAIN_STACK_SIZE=16384
CONFIG_ZTEST_STACK_SIZE=16384
```

## src/test_tof_schedule.cpp
```c
/*
 * Copyright (c) 2026, LexxPluss Inc.
 * All rights reserved.
 *
 * SPDX-License-Identifier: BSD-3-Clause
 *
 * Properties of the scheduling model, and the sweep it exists to produce.
 *
 * These tests assert **structure only** — no starvation, determinism, and monotonicity in
 * the directions physics requires. They deliberately do not assert that any point-sensor
 * rate is achieved: every input is a design-time figure that no logic analyser has
 * confirmed, so a passing threshold here would be a product claim the evidence cannot
 * support. The sweep prints the numbers; a human reads them.
 */

#include <string.h>

#include <zephyr/ztest.h>

#include "tof_schedule_model.hpp"

namespace {

namespace sch = tof_schedule;

constexpr uint32_t k100k{100000}, k400k{400000}, k1M{1000000};
constexpr uint32_t kUntrimmed{1452}, kTrimmed{328};

// Plain arrays rather than braced ranges: this build has no <initializer_list>.
constexpr uint32_t kSpeeds[]{k100k, k400k, k1M};
constexpr uint32_t kBlockSizes[]{kUntrimmed, kTrimmed};
constexpr uint32_t kChunkSizes[]{0, 512, 256, 128, 64};

uint64_t worst_point_interval(const sch::sim_result &r)
{
    uint64_t worst{0};
    for (int i = 0; i < r.device_count; ++i)
        if (r.devices[i].sort == sch::kind::point && r.devices[i].max_interval_ns > worst)
            worst = r.devices[i].max_interval_ns;
    return worst;
}

uint32_t slowest_point_millihz(const sch::sim_result &r)
{
    uint64_t worst_mean{0};
    for (int i = 0; i < r.device_count; ++i)
        if (r.devices[i].sort == sch::kind::point && r.devices[i].mean_interval_ns > worst_mean)
            worst_mean = r.devices[i].mean_interval_ns;
    return worst_mean == 0 ? 0 : static_cast<uint32_t>(1000000000000ull / worst_mean);
}

uint64_t worst_grid_latency(const sch::sim_result &r)
{
    uint64_t worst{0};
    for (int i = 0; i < r.device_count; ++i)
        if (r.devices[i].sort == sch::kind::grid && r.devices[i].max_latency_ns > worst)
            worst = r.devices[i].max_latency_ns;
    return worst;
}

}  // namespace

ZTEST_SUITE(tof_schedule, NULL, NULL, NULL, NULL, NULL);

/* ------------------------------------------------------------------ structure ----- */

ZTEST(tof_schedule, test_no_source_is_starved)
{
    // The case that has to work: both grids ready at once, at the slowest bus, untrimmed.
    // If any source can be starved, it shows here first.
    for (uint32_t speed : kSpeeds) {
        for (uint32_t bytes : kBlockSizes) {
            const auto r{sch::run(sch::six_sensor_chain(speed, bytes, 0, true))};

            for (int i = 0; i < r.device_count; ++i) {
                zassert_true(r.devices[i].completed_reads > 0,
                             "device %d never serviced at %u Hz, %u bytes", i, speed, bytes);
                zassert_true(r.devices[i].max_interval_ns < r.horizon_ns,
                             "device %d starved at %u Hz, %u bytes", i, speed, bytes);
            }
        }
    }
}

ZTEST(tof_schedule, test_the_model_is_deterministic)
{
    // Two runs of one configuration must be identical, jitter included; otherwise the
    // sweep below is not evidence of anything.
    auto cfg{sch::six_sensor_chain(k400k, kTrimmed, 0, true)};
    cfg.scheduler_jitter_max_ns = 200000;
    cfg.can_enqueue_ns = 50000;

    const auto a{sch::run(cfg)};
    const auto b{sch::run(cfg)};

    zassert_equal(memcmp(&a, &b, sizeof a), 0, "the same configuration gave two answers");
}

ZTEST(tof_schedule, test_a_faster_bus_never_makes_a_point_sensor_worse)
{
    const auto slow{sch::run(sch::six_sensor_chain(k100k, kTrimmed, 0, true))};
    const auto mid{sch::run(sch::six_sensor_chain(k400k, kTrimmed, 0, true))};
    const auto fast{sch::run(sch::six_sensor_chain(k1M, kTrimmed, 0, true))};

    zassert_true(worst_point_interval(mid) <= worst_point_interval(slow));
    zassert_true(worst_point_interval(fast) <= worst_point_interval(mid));
    zassert_true(fast.bus_utilisation_permille <= mid.bus_utilisation_permille);
}

ZTEST(tof_schedule, test_trimming_never_makes_a_point_sensor_worse)
{
    // This is the claim trimming exists to make, and the only one the model can support.
    for (uint32_t speed : kSpeeds) {
        const auto untrimmed{sch::run(sch::six_sensor_chain(speed, kUntrimmed, 0, true))};
        const auto trimmed{sch::run(sch::six_sensor_chain(speed, kTrimmed, 0, true))};

        zassert_true(worst_point_interval(trimmed) <= worst_point_interval(untrimmed),
                     "trimming hurt the point sensors at %u Hz", speed);
    }
}

ZTEST(tof_schedule, test_smaller_chunks_never_lengthen_the_uninterruptible_transfer)
{
    // Chunking's only mechanism: it shortens the block during which nothing else can be
    // served. If that ever failed to hold, the model would be wrong.
    uint64_t previous{UINT64_MAX};
    for (uint32_t chunk : kChunkSizes) {
        const auto r{sch::run(sch::six_sensor_chain(k400k, kTrimmed, chunk, true))};

        zassert_true(r.longest_uninterruptible_ns <= previous,
                     "chunk %u lengthened the uninterruptible transfer", chunk);
        previous = r.longest_uninterruptible_ns;
    }
}

ZTEST(tof_schedule, test_grids_in_phase_are_the_harder_case)
{
    // Both frames arriving together is what the point sensors have to survive; the
    // staggered case must not be the one we tune against.
    const auto together{sch::run(sch::six_sensor_chain(k400k, kUntrimmed, 0, true))};
    const auto staggered{sch::run(sch::six_sensor_chain(k400k, kUntrimmed, 0, false))};

    zassert_true(worst_point_interval(together) >= worst_point_interval(staggered),
                 "the in-phase case was not the worse one, so the model is suspect");
}

/* ---------------------------------------------------------------------- sweep ----- */

ZTEST(tof_schedule, test_print_the_sweep)
{
    // Not an assertion — the table this model exists to produce. Everything in it rests
    // on provisional inputs: 1452 / 328 / 133 bytes and the bus speeds are design-time
    // figures, so read it as "what the schedule would do if those hold".
    static const struct {
        const char *name;
        uint32_t bytes;
        uint32_t chunk;
    } shapes[] = {
        {"untrimmed 1452, atomic", kUntrimmed, 0},   {"trimmed 328, atomic", kTrimmed, 0},
        {"trimmed 328, chunk 128", kTrimmed, 128},   {"trimmed 328, chunk 64", kTrimmed, 64},
        {"untrimmed 1452, chunk 256", kUntrimmed, 256},
    };

    TC_PRINT("\nAssumed point-sensor timing budget: 20 ms. Every figure below moves with it.\n");
    TC_PRINT("\n%-28s %8s %11s %11s %10s %9s %7s\n", "grid read shape", "bus", "worst L4 gap",
             "slowest L4", "grid lat", "longest tx", "bus use");
    for (uint32_t speed : kSpeeds) {
        for (const auto &s : shapes) {
            const auto r{sch::run(sch::six_sensor_chain(speed, s.bytes, s.chunk, true))};

            TC_PRINT("%-28s %6u k %8llu ms %8u mHz %7llu ms %6llu ms %5u.%u%%\n", s.name,
                     speed / 1000, static_cast<unsigned long long>(worst_point_interval(r) / 1000000),
                     slowest_point_millihz(r),
                     static_cast<unsigned long long>(worst_grid_latency(r) / 1000000),
                     static_cast<unsigned long long>(r.longest_uninterruptible_ns / 1000000),
                     r.bus_utilisation_permille / 10, r.bus_utilisation_permille % 10);
        }
    }
    // The point-sensor rate is dominated by an input nobody has fixed. Printing the
    // sensitivity is the only way to stop the table above being read as a product claim.
    static const uint64_t budgets[]{10ull * 1000000, 20ull * 1000000, 33ull * 1000000,
                                    50ull * 1000000};
    TC_PRINT("\nSensitivity to that assumption, at 400 kHz with a trimmed atomic grid read:\n");
    TC_PRINT("%-18s %13s %12s\n", "timing budget", "worst L4 gap", "slowest L4");
    for (uint64_t b : budgets) {
        const auto r{sch::run(sch::six_sensor_chain(k400k, kTrimmed, 0, true, b))};

        TC_PRINT("%15llu ms %10llu ms %8u mHz\n", static_cast<unsigned long long>(b / 1000000),
                 static_cast<unsigned long long>(worst_point_interval(r) / 1000000),
                 slowest_point_millihz(r));
    }

    TC_PRINT("\nRead the chunk rows as an upper bound on what chunking could buy, not as a\n"
             "recommendation: splitting a grid read is only safe if the device's result buffer\n"
             "stays coherent between chunks, which this model does not and cannot show.\n\n");
}
```

## src/tof_schedule_model.cpp
```c
/*
 * Copyright (c) 2026, LexxPluss Inc.
 * All rights reserved.
 *
 * SPDX-License-Identifier: BSD-3-Clause
 */

#include "tof_schedule_model.hpp"

namespace tof_schedule {

namespace {

// One transfer is the unit of non-preemptibility: the acquisition thread holds the bus
// for its whole duration and can only switch devices between transfers.
uint64_t transfer_ns(const bus_config &bus, uint32_t payload_bytes)
{
    const uint64_t bytes{static_cast<uint64_t>(payload_bytes) + bus.per_transfer_overhead_bytes};
    return (bytes * bus.bits_per_byte * 1000000000ull) / bus.speed_hz;
}

// Seeded so a configuration always produces the same schedule. A wall clock or an
// unseeded generator would make the CI comparison meaningless.
struct rng {
    uint32_t state;
    uint32_t next()
    {
        state = state * 1664525u + 1013904223u;
        return state >> 16;
    }
};

// What a device is waiting to have done for it.
struct pending {
    bool active{false};
    uint64_t ready_ns{0};       // when the operation became available
    uint32_t bytes_left{0};     // of the read
    bool rearm_left{false};     // point sensors: the re-arm still owed
};

}  // namespace

sim_result run(const sim_config &cfg)
{
    sim_result out{};
    out.device_count = cfg.device_count;
    out.horizon_ns = cfg.horizon_ns;

    pending pend[kMaxDevices]{};
    uint64_t next_frame_ns[kMaxDevices]{};
    uint64_t last_complete_ns[kMaxDevices]{};
    bool have_last[kMaxDevices]{};
    uint64_t interval_sum[kMaxDevices]{};
    rng r{cfg.seed};

    for (int i = 0; i < cfg.device_count; ++i) {
        const device_config &d{cfg.devices[i]};

        out.devices[i].sort = d.sort;
        next_frame_ns[i] = d.phase_ns;
        if (d.sort == kind::point) {
            // A point sensor is measuring from the start; its first result is ready one
            // timing budget in. Without this arming it would never ask for the bus at
            // all, because the only other place that arms one is the end of its own read.
            pend[i] = pending{true, d.phase_ns + d.period_ns, d.read_bytes, true};
        }
    }

    uint64_t now{0};
    while (now < cfg.horizon_ns) {
        // Arrivals first: a grid frame appears whether or not anyone read the last one.
        for (int i = 0; i < cfg.device_count; ++i) {
            const device_config &d{cfg.devices[i]};
            if (d.sort != kind::grid)
                continue;
            while (next_frame_ns[i] <= now) {
                if (pend[i].active) {
                    // The buffer holds the newest frame; the read in flight will return
                    // whatever is there. Whether that is coherent is exactly the question
                    // this model cannot answer -- see the header.
                    ++out.devices[i].frames_skipped;
                } else {
                    pend[i] = pending{true, next_frame_ns[i], d.read_bytes, false};
                }
                next_frame_ns[i] += d.period_ns;
            }
        }

        // Pick the device that has been waiting longest. Deterministic on ties.
        int chosen{-1};
        uint64_t best_ready{0};
        for (int i = 0; i < cfg.device_count; ++i) {
            if (!pend[i].active || pend[i].ready_ns > now)
                continue;
            if (chosen < 0 || pend[i].ready_ns < best_ready) {
                chosen = i;
                best_ready = pend[i].ready_ns;
            }
        }

        if (chosen < 0) {
            // Nothing to do: jump to the next arrival rather than stepping time.
            uint64_t next{cfg.horizon_ns};
            for (int i = 0; i < cfg.device_count; ++i) {
                if (pend[i].active && pend[i].ready_ns > now && pend[i].ready_ns < next)
                    next = pend[i].ready_ns;
                if (cfg.devices[i].sort == kind::grid && next_frame_ns[i] < next)
                    next = next_frame_ns[i];
            }
            now = (next > now) ? next : now + 1;
            continue;
        }

        const device_config &d{cfg.devices[chosen]};
        pending &p{pend[chosen]};

        if (cfg.scheduler_jitter_max_ns != 0)
            now += r.next() % (cfg.scheduler_jitter_max_ns + 1);

        // One transfer only, then the scheduler decides again. For an atomic read that is
        // the whole frame; for a chunked read it is one chunk, which is where another
        // device gets its turn.
        uint32_t this_transfer{0};
        if (p.bytes_left > 0) {
            const uint32_t chunk{d.chunk_bytes == 0 ? p.bytes_left : d.chunk_bytes};
            this_transfer = (chunk < p.bytes_left) ? chunk : p.bytes_left;
            p.bytes_left -= this_transfer;
        } else if (p.rearm_left) {
            this_transfer = d.rearm_bytes;
            p.rearm_left = false;
        }

        const uint64_t dur{transfer_ns(cfg.bus, this_transfer)};
        now += dur;
        out.bus_busy_ns += dur;
        if (dur > out.longest_uninterruptible_ns)
            out.longest_uninterruptible_ns = dur;

        const bool read_done{p.bytes_left == 0};
        if (read_done && d.sort == kind::point && p.rearm_left) {
            // A point sensor's read and its re-arm are issued back to back: letting
            // another device in between would delay this sensor's own next measurement
            // for no gain. Preemption within a device happens only between grid chunks.
            const uint64_t rearm{transfer_ns(cfg.bus, d.rearm_bytes)};
            now += rearm;
            out.bus_busy_ns += rearm;
            if (rearm > out.longest_uninterruptible_ns)
                out.longest_uninterruptible_ns = rearm;
            p.rearm_left = false;
        }

        if (!read_done)
            continue;

        // The operation completed.
        if (cfg.can_enqueue_ns != 0)
            now += cfg.can_enqueue_ns;

        device_result &res{out.devices[chosen]};
        ++res.completed_reads;

        const uint64_t latency{now - p.ready_ns};
        if (latency > res.max_latency_ns)
            res.max_latency_ns = latency;

        if (have_last[chosen]) {
            const uint64_t interval{now - last_complete_ns[chosen]};
            interval_sum[chosen] += interval;
            if (interval > res.max_interval_ns)
                res.max_interval_ns = interval;
            if (d.sort == kind::point && interval > cfg.point_deadline_ns)
                ++res.deadline_misses;
        }
        last_complete_ns[chosen] = now;
        have_last[chosen] = true;

        p.active = false;
        if (d.sort == kind::point) {
            // The next measurement starts only now, which is the whole reason a long read
            // on another sensor costs this one its rate.
            pend[chosen] = pending{true, now + d.period_ns, d.read_bytes, true};
        }
    }

    for (int i = 0; i < cfg.device_count; ++i) {
        device_result &res{out.devices[i]};
        if (res.completed_reads > 1)
            res.mean_interval_ns = interval_sum[i] / (res.completed_reads - 1);
    }
    out.bus_utilisation_permille =
        cfg.horizon_ns == 0 ? 0
                            : static_cast<uint32_t>((out.bus_busy_ns * 1000) / cfg.horizon_ns);
    return out;
}

sim_config six_sensor_chain(uint32_t speed_hz, uint32_t grid_read_bytes,
                            uint32_t grid_chunk_bytes, bool grids_in_phase,
                            uint64_t point_budget_ns)
{
    sim_config cfg{};
    cfg.bus.speed_hz = speed_hz;
    cfg.device_count = 6;

    // Two grids at 5 Hz. In phase is the case that has to be tested: both frames become
    // ready together, and the point sensors wait behind both reads.
    for (int i = 0; i < 2; ++i) {
        cfg.devices[i].sort = kind::grid;
        cfg.devices[i].read_bytes = grid_read_bytes;
        cfg.devices[i].chunk_bytes = grid_chunk_bytes;
        cfg.devices[i].period_ns = 200ull * 1000 * 1000;
        cfg.devices[i].phase_ns = grids_in_phase ? 0 : (i * 100ull * 1000 * 1000);
    }
    // Four point sensors. 133 bytes is the assumed read size and the timing budget is a
    // caller-supplied input; both are provisional, which is why nothing asserts a rate.
    for (int i = 2; i < 6; ++i) {
        cfg.devices[i].sort = kind::point;
        cfg.devices[i].read_bytes = 133;
        cfg.devices[i].rearm_bytes = 2;
        cfg.devices[i].period_ns = point_budget_ns;
    }
    return cfg;
}

}  // namespace tof_schedule
```

## src/tof_schedule_model.hpp
```c
/*
 * Copyright (c) 2026, LexxPluss Inc.
 * All rights reserved.
 *
 * SPDX-License-Identifier: BSD-3-Clause
 */

#pragma once

// A scheduling model for the six-sensor ToF chain: two VL53L7CX grids and four VL53L4CX
// point sensors on one I2C bus, serviced by one acquisition thread.
//
// WHAT IT IS FOR
//
// The binding constraint on this chain is not bus bandwidth, it is scheduling: a VL53L4CX
// does not free-run, so its next measurement starts only after the host has read the
// result and re-armed it. A long blocking read on another sensor is therefore added
// directly to a point sensor's period. This model exists to answer one design question
// before the interface is frozen -- **how much would chunked grid reads gain** -- because
// that decides whether the L7 read interface has to express partial frames.
//
// WHAT IT CANNOT ANSWER, AND MUST NOT BE READ AS ANSWERING
//
//   - It cannot show that chunked reads are LEGAL. Splitting a grid read assumes the
//     device's result buffer stays coherent between the chunks; if it does not, chunking
//     buys latency by returning torn frames. That has to be established from the ULD and
//     the part, not from a simulation, before any chunk-aware interface is designed.
//   - Its inputs are provisional. The block sizes (1452 untrimmed, 328 trimmed, 133 per
//     point read) and the bus speeds are design-time figures that no logic analyser has
//     confirmed. Every number this model produces inherits that status, so the tests
//     assert structure -- no starvation, determinism, monotonicity -- and deliberately do
//     not assert that any product rate is met.
//
// WHAT IS DELIBERATELY NOT MODELLED, IN v1
//
// The CAN transport, the RTOS, and the existing safety tasks. Each would need assumptions
// broad enough to swamp the result. Instead there are two injection points -- scheduler
// jitter and a per-frame CAN enqueue cost -- to be replaced by measurements later.

#include <cstddef>
#include <cstdint>

namespace tof_schedule {

inline constexpr int kMaxDevices{8};

enum class kind : uint8_t {
    grid,  // VL53L7CX: free-running, a new frame every period whether read or not
    point, // VL53L4CX: does not free-run; the next measurement starts after the re-arm
};

struct device_config {
    kind sort{kind::point};
    uint32_t read_bytes{133};
    // 0 means one atomic transfer. Otherwise the read is split, and the scheduler may
    // serve another device between chunks -- which is the entire point of chunking.
    uint32_t chunk_bytes{0};
    uint32_t rearm_bytes{2};  // point sensors only: clear interrupt and restart
    uint64_t period_ns{0};    // grid: frame period. point: measurement timing budget
    uint64_t phase_ns{0};     // grid only: offset of the first frame
};

struct bus_config {
    uint32_t speed_hz{400000};
    // 9 bits per byte: eight data bits plus the acknowledge. This is the same arithmetic
    // the design tables use, so the model reproduces them when the overhead below is 0.
    uint32_t bits_per_byte{9};
    // Address plus the 16-bit register index. Set to 0 to reproduce the hand-calculated
    // tables exactly; 3 is the honest figure for a real transaction.
    uint32_t per_transfer_overhead_bytes{3};
};

struct sim_config {
    bus_config bus{};
    device_config devices[kMaxDevices]{};
    int device_count{0};
    uint64_t horizon_ns{10ull * 1000 * 1000 * 1000};
    // Injection points, both zero by default. Deterministic: the jitter is drawn from a
    // seeded generator so that two runs of one configuration are identical.
    uint64_t scheduler_jitter_max_ns{0};
    uint64_t can_enqueue_ns{0};
    uint32_t seed{1};
    // Reported, never asserted: the interval a point sensor would have to hold to meet a
    // rate someone hopes for.
    uint64_t point_deadline_ns{50ull * 1000 * 1000};
};

struct device_result {
    kind sort{kind::point};
    uint32_t completed_reads{0};
    uint64_t max_interval_ns{0};   // longest gap between two completed reads
    uint64_t mean_interval_ns{0};
    uint64_t max_latency_ns{0};    // grid: ready -> last chunk done
    uint32_t frames_skipped{0};    // grid: a new frame arrived before the old was read
    uint32_t deadline_misses{0};   // point: intervals longer than point_deadline_ns
};

struct sim_result {
    device_result devices[kMaxDevices]{};
    int device_count{0};
    uint64_t bus_busy_ns{0};
    uint64_t horizon_ns{0};
    uint64_t longest_uninterruptible_ns{0};  // the longest single transfer issued
    uint32_t bus_utilisation_permille{0};
};

// Deterministic for a given config: same input, same output, every time.
sim_result run(const sim_config &cfg);

// Helpers for building the standard six-sensor chain used by the tests.
// point_budget_ns is the VL53L4CX measurement timing budget. It is an INPUT, not a
// property of the schedule, and nothing has fixed it yet: the model's point-sensor rates
// move with it, which is why the sweep prints a sensitivity table rather than one number.
sim_config six_sensor_chain(uint32_t speed_hz, uint32_t grid_read_bytes,
                            uint32_t grid_chunk_bytes, bool grids_in_phase,
                            uint64_t point_budget_ns = 20ull * 1000 * 1000);

}  // namespace tof_schedule
```
