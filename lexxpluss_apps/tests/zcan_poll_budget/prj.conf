## CMakeLists.txt
```
# Copyright (c) 2026, LexxPluss Inc.
# All rights reserved.
#
# SPDX-License-Identifier: BSD-2-Clause

# The per-pass budget, exercised through the production pollers themselves rather than a model of
# them: the headers are included as the firmware includes them and the message queues are real
# kernel queues. Only zcan_bounded_send::send is replaced, which is why zcan_bounded_send.cpp is
# not linked here -- its own behaviour is covered in tests/zcan_bounded_send.
cmake_minimum_required(VERSION 3.20.0)

find_package(Zephyr REQUIRED HINTS $ENV{ZEPHYR_BASE})
project(zcan_poll_budget_test)

set(APP_SRC_DIR ${CMAKE_CURRENT_SOURCE_DIR}/../../src)

target_sources(app PRIVATE
    src/poll_probe.cpp
    src/test_imu.cpp
    src/test_board.cpp
    src/test_dfu.cpp
    src/test_actuator_service.cpp)
target_include_directories(app PRIVATE ${APP_SRC_DIR})
```

## prj.conf
```kconfig
CONFIG_ZTEST=y
CONFIG_CAN=y
CONFIG_LOG=y
CONFIG_MAIN_STACK_SIZE=4096
```

## src/poll_probe.cpp
```c
/*
 * Copyright (c) 2026, LexxPluss Inc.
 * All rights reserved.
 *
 * SPDX-License-Identifier: BSD-2-Clause
 */

#include "poll_probe.hpp"

#include "zcan_bounded_send.hpp"
#include "zcan_poll_budget.hpp"

namespace probe {

int rc{-EAGAIN};
int sends{0};
can_frame frames[32]{};
void (*refill)(){nullptr};

void reset()
{
    rc = -EAGAIN;
    sends = 0;
    refill = nullptr;
}

}  // namespace probe

namespace lexxhard::zcan_bounded_send {

/* Replaces the production wrapper for these suites, and asserts two things on the way through.
 *
 * The timeout is checked because a send site left on the old K_MSEC(100) would still pass every
 * count-based assertion below while costing a hundred times as much per refusal -- the regression
 * would be invisible to a host test and visible only on a board with its host switched off.
 *
 * The frame-count ceiling is the termination check. A poller that ignores its budget under a
 * refilling producer does not fail an assertion afterwards; it never returns, and the suite would
 * hang until twister killed it with no indication of which loop was at fault. Failing inside send
 * at a bound no healthy pass can reach turns that hang into a named failure. */
int send(const device *, const can_frame *frame, k_timeout_t timeout)
{
    zassert_true(K_TIMEOUT_EQ(timeout, zcan_poll_budget::kMailboxWait),
                 "send site still uses its own timeout instead of kMailboxWait");
    zassert_true(probe::sends < 32, "poll() did not return under a continuously refilled queue");
    probe::frames[probe::sends++] = *frame;
    if (probe::refill)
        probe::refill();
    return probe::rc;
}

}  // namespace lexxhard::zcan_bounded_send
```

## src/poll_probe.hpp
```c
/*
 * Copyright (c) 2026, LexxPluss Inc.
 * All rights reserved.
 *
 * SPDX-License-Identifier: BSD-2-Clause
 *
 * The substitute transport these suites run the production pollers against.
 *
 * WHAT IS REAL AND WHAT IS NOT. The pollers are the production ones, included from
 * lexxpluss_apps/src and not reimplemented, and the message queues are real Zephyr queues
 * operated by the real k_msgq calls -- that is the whole point, because what is under test is
 * loop termination and queue accounting. What is faked is one function, zcan_bounded_send::send,
 * and the device handle it would need. Nothing here claims anything about a physical CAN bus;
 * the behaviour of the wrapper itself has its own suite in tests/zcan_bounded_send.
 *
 * WHY THE DEVICE IS A NULL POINTER. Each poller's init() resolves a devicetree node that native_sim
 * does not have, so DEVICE_DT_GET is redefined to nullptr and init() is never called. The pollers
 * are constructed and poll()ed directly: poll() passes `dev` to send() and send() does not look at
 * it, so a null device is exactly as much device as these tests need.
 *
 * WHY SEND CAN REFUSE ON DEMAND. The condition the budget exists for is the one where every send
 * is refused for as long as the host stays away -- mailboxes permanently full. `rc` is what send
 * returns, so a suite can hold it at -EAGAIN and ask what the poller does when nothing it sends
 * ever leaves. `refill` is called from inside send, which reproduces the other half of that
 * condition: a producer that keeps putting messages in the queue while the poller is draining it.
 * Before the budget those two together did not terminate.
 */

#pragma once

#include <errno.h>

#include <zephyr/kernel.h>
#include <zephyr/drivers/can.h>
#include <zephyr/ztest.h>

/* Must precede any production zcan header: their init() paths would otherwise need a can2 node. */
#undef DEVICE_DT_GET
#define DEVICE_DT_GET(node_id) nullptr

namespace probe {

/* What the faked send returns. -EAGAIN is the interesting default: it is what a full mailbox set
 * gives back once kMailboxWait expires. */
extern int rc;

/* How many times a poll() called send, and the frames it passed, so a suite can assert on content
 * and order rather than only on counts. */
extern int sends;
extern can_frame frames[32];

/* Called from inside send, if set: a producer that refills the queue the poller is draining. */
extern void (*refill)();

void reset();

}  // namespace probe
```

## src/test_actuator_service.cpp
```c
/*
 * Copyright (c) 2026, LexxPluss Inc.
 * All rights reserved.
 *
 * SPDX-License-Identifier: BSD-2-Clause
 *
 * The same reply obligation as the DFU path, in the other request/response service on this bus. The
 * actuator service answers a host request exactly once, so the hold-and-retry rule and the reasons
 * for it are the ones written down in test_dfu.cpp; what is specific here is that the reply is
 * identified by its counter, which makes the ordering assertions read directly.
 *
 * This suite also covers the receive budget on a path where falling behind costs something: the
 * requests are the host's, and the budget is deliberately larger than the transmit one because the
 * work per frame is local and cheap.
 */

#include "poll_probe.hpp"

#include "zcan_actuator_service.hpp"
#include "zcan_poll_budget.hpp"

namespace lexxhard::actuator_service_controller {
k_msgq msgq_request, msgq_response;
}

namespace {

char alignas(4) requests[16 * sizeof (lexxhard::actuator_service_controller::msg_request)];
char alignas(4) replies[8 * sizeof (lexxhard::actuator_service_controller::msg_response)];

}  // namespace

ZTEST_SUITE(zcan_poll_budget_actuator_service, nullptr, nullptr, nullptr, nullptr, nullptr);

ZTEST(zcan_poll_budget_actuator_service, test_refused_reply_is_held_while_requests_keep_flowing)
{
    using namespace lexxhard;

    probe::reset();
    k_msgq_init(&actuator_service_controller::msgq_request, requests,
                sizeof (actuator_service_controller::msg_request), 16);
    k_msgq_init(&actuator_service_controller::msgq_response, replies,
                sizeof (actuator_service_controller::msg_response), 8);
    k_msgq_purge(&zcan_actuator_service::msgq_can_actuator_service_request);

    actuator_service_controller::msg_response first{}, second{};
    first.counter = 11;
    second.counter = 12;
    zassert_equal(k_msgq_put(&actuator_service_controller::msgq_response, &first, K_NO_WAIT), 0);
    zassert_equal(k_msgq_put(&actuator_service_controller::msgq_response, &second, K_NO_WAIT), 0);

    zcan_actuator_service::zcan_actuator_service poller;

    poller.poll();
    zassert_equal(probe::frames[0].data[7], 11);

    /* A full receive budget arrives while the reply is still held. */
    for (int i{0}; i < zcan_poll_budget::kRxPerPass; ++i) {
        can_frame request{};
        request.id = CAN_ID_ACTUATOR_SERVICE_REQUEST;
        request.dlc = 8;
        zassert_equal(k_msgq_put(&zcan_actuator_service::msgq_can_actuator_service_request,
                                 &request, K_NO_WAIT), 0);
    }
    poller.poll();
    zassert_equal(probe::frames[1].data[7], 11, "the held reply is retried, not re-read");
    zassert_equal(k_msgq_num_used_get(&actuator_service_controller::msgq_request),
                  zcan_poll_budget::kRxPerPass);
    zassert_equal(k_msgq_num_used_get(&actuator_service_controller::msgq_response), 1);

    probe::rc = 0;
    poller.poll();
    zassert_equal(probe::frames[2].data[7], 11);
    poller.poll();
    zassert_equal(probe::frames[3].data[7], 12);

    poller.poll();
    zassert_equal(probe::sends, 4, "an accepted reply must not be sent again");
}
```

## src/test_board.cpp
```c
/*
 * Copyright (c) 2026, LexxPluss Inc.
 * All rights reserved.
 *
 * SPDX-License-Identifier: BSD-2-Clause
 *
 * The consequence that is worse than the watchdog one. zcan_board::poll() drains telemetry towards
 * the host first and receives the host's control frames second. While the transmit drain could run
 * forever, a host that went away stopped the board from consuming that host's control frames --
 * including after the host came back, because the first drain never yielded. No watchdog takes part
 * in that, and no reset repairs it.
 *
 * So this suite asserts ordering, not just counts: with the transmit side refusing every send and
 * its queue refilled from inside send, the receive drain behind it must still run on the same pass,
 * and must take its own, larger budget.
 */

#include "poll_probe.hpp"

#include "zcan_board.hpp"
#include "zcan_poll_budget.hpp"

namespace lexxhard::can_controller {
k_msgq msgq_board, msgq_control;
}

namespace {

char alignas(4) tx[8 * sizeof (lexxhard::can_controller::msg_board)];
char alignas(4) rx[16 * sizeof (lexxhard::can_controller::msg_control)];

void refill()
{
    lexxhard::can_controller::msg_board m{};
    k_msgq_put(&lexxhard::can_controller::msgq_board, &m, K_NO_WAIT);
}

}  // namespace

ZTEST_SUITE(zcan_poll_budget_board, nullptr, nullptr, nullptr, nullptr, nullptr);

ZTEST(zcan_poll_budget_board, test_refused_transmit_still_lets_receive_run_on_the_same_pass)
{
    probe::reset();
    k_msgq_init(&lexxhard::can_controller::msgq_board, tx,
                sizeof (lexxhard::can_controller::msg_board), 8);
    k_msgq_init(&lexxhard::can_controller::msgq_control, rx,
                sizeof (lexxhard::can_controller::msg_control), 16);
    k_msgq_purge(&lexxhard::zcan_board::msgq_can_ros2board);

    /* One more waiting frame than the receive budget, so the budget is observable rather than
     * merely satisfied. */
    for (int i{0}; i < lexxhard::zcan_poll_budget::kRxPerPass + 1; ++i) {
        can_frame f{};
        f.id = CAN_ID_BOARD_RX;
        f.dlc = 5;
        f.data[0] = 1;
        f.data[3] = 1;
        zassert_equal(k_msgq_put(&lexxhard::zcan_board::msgq_can_ros2board, &f, K_NO_WAIT), 0);
    }

    refill();
    probe::refill = refill;

    lexxhard::zcan_board::zcan_board poller;
    poller.poll();
    probe::refill = nullptr;

    zassert_equal(probe::sends, lexxhard::zcan_poll_budget::kTxPerPass);
    zassert_equal(k_msgq_num_used_get(&lexxhard::can_controller::msgq_board), 1,
                  "refused telemetry is dropped, not retried");

    /* The point of the suite: the control frames went through while the transmit side was failing. */
    zassert_equal(k_msgq_num_used_get(&lexxhard::can_controller::msgq_control),
                  lexxhard::zcan_poll_budget::kRxPerPass);
    zassert_equal(k_msgq_num_used_get(&lexxhard::zcan_board::msgq_can_ros2board), 1);
}
```

## src/test_dfu.cpp
```c
/*
 * Copyright (c) 2026, LexxPluss Inc.
 * All rights reserved.
 *
 * SPDX-License-Identifier: BSD-2-Clause
 *
 * The reply that must not be dropped. Shortening the mailbox wait from 100 ms to 1 ms makes refusal
 * an ordinary outcome rather than an exceptional one, and for periodic telemetry that is free: the
 * next pass carries fresher data. For a reply it is not. The updater produces one response per
 * command and never repeats it, so a response taken off the queue and then refused by a busy
 * mailbox is a response the host waits for forever -- a DFU that looks hung, with nothing in the
 * log to say why. That is the failure this path was changed to avoid, and note that it was already
 * reachable at 100 ms; the shorter wait only makes it likely.
 *
 * What is asserted, in order: a refused reply stays, it is not replaced by the next reply queued
 * behind it, holding it does not stop the request drain on the same pass, the hold ends when the
 * send is accepted, the replies then come out in the order the updater produced them, and an
 * accepted reply is not sent a second time.
 */

#include "poll_probe.hpp"

#include "zcan_dfu.hpp"

namespace lexxhard::firmware_updater {
k_msgq msgq_command, msgq_response;
}

namespace {

char alignas(4) cmds[8 * sizeof (lexxhard::firmware_updater::command_packet)];
char alignas(4) replies[8 * sizeof (lexxhard::firmware_updater::response_packet)];

}  // namespace

ZTEST_SUITE(zcan_poll_budget_dfu, nullptr, nullptr, nullptr, nullptr, nullptr);

ZTEST(zcan_poll_budget_dfu, test_refused_reply_is_held_and_retried_in_order)
{
    using namespace lexxhard;

    probe::reset();
    k_msgq_init(&firmware_updater::msgq_command, cmds,
                sizeof (firmware_updater::command_packet), 8);
    k_msgq_init(&firmware_updater::msgq_response, replies,
                sizeof (firmware_updater::response_packet), 8);
    k_msgq_purge(&zcan_dfu::msgq_can_dfu);

    firmware_updater::response_packet first{{1, 2}, 1, 0}, second{{3, 4}, 2, 0};
    zassert_equal(k_msgq_put(&firmware_updater::msgq_response, &first, K_NO_WAIT), 0);
    zassert_equal(k_msgq_put(&firmware_updater::msgq_response, &second, K_NO_WAIT), 0);

    zcan_dfu::zcan_dfu poller;

    /* Refused. The reply is now held, and the one behind it is untouched: a held reply must not be
     * overwritten by the next, or the host receives an answer to a command it did not send. */
    poller.poll();
    zassert_equal(probe::sends, 1);
    zassert_equal(k_msgq_num_used_get(&firmware_updater::msgq_response), 1);

    /* Still refused, and a command arrives meanwhile. Holding a reply must not cost the board its
     * request handling, and the retry must be the same bytes rather than a fresh read of the
     * queue. */
    can_frame request{};
    request.id = CAN_ID_DFU_DATA;
    request.dlc = 8;
    zassert_equal(k_msgq_put(&zcan_dfu::msgq_can_dfu, &request, K_NO_WAIT), 0);
    poller.poll();
    zassert_equal(k_msgq_num_used_get(&firmware_updater::msgq_command), 1);
    zassert_mem_equal(probe::frames[0].data, probe::frames[1].data, sizeof first);

    /* Accepted. The hold ends, and the reply behind it follows on the next pass in the order the
     * updater produced them. */
    probe::rc = 0;
    poller.poll();
    zassert_mem_equal(probe::frames[2].data, &first, sizeof first);
    poller.poll();
    zassert_mem_equal(probe::frames[3].data, &second, sizeof second);

    /* Nothing is left held, so a pass with no reply to send sends nothing: the retry must not turn
     * a one-shot answer into a repeating one. */
    poller.poll();
    zassert_equal(probe::sends, 4, "an accepted reply must not be sent again");
}
```

## src/test_imu.cpp
```c
/*
 * Copyright (c) 2026, LexxPluss Inc.
 * All rights reserved.
 *
 * SPDX-License-Identifier: BSD-2-Clause
 *
 * The loop that did not terminate. zcan_imu's transmit drain is the plainest instance of the
 * pattern the budget fixes: one queue, one send site, a producer at 40 Hz and a drain that used to
 * run `while (k_msgq_get(..., K_NO_WAIT) == 0)`. With the host answering the queue empties long
 * before the producer catches up, so the old form terminated and the defect never showed. With the
 * host gone every send waits out the mailbox timeout and returns -EAGAIN, the drain rate falls
 * below the producer, and the condition for leaving the loop stops being reachable.
 *
 * The producer here refills from inside send, which is the worst arrangement rather than a
 * representative one: the queue is non-empty at every single loop test. Nothing but a budget gets
 * out of that.
 */

#include "poll_probe.hpp"

#include "zcan_imu.hpp"
#include "zcan_poll_budget.hpp"

/* The acquisition side of this queue is not built here; the queue is, and that is what is drained. */
namespace lexxhard::imu_controller {
k_msgq msgq;
}

namespace {

char alignas(4) storage[8 * sizeof (lexxhard::imu_controller::msg)];

void refill()
{
    lexxhard::imu_controller::msg m{};
    k_msgq_put(&lexxhard::imu_controller::msgq, &m, K_NO_WAIT);
}

}  // namespace

ZTEST_SUITE(zcan_poll_budget_imu, nullptr, nullptr, nullptr, nullptr, nullptr);

ZTEST(zcan_poll_budget_imu, test_refilling_producer_does_not_hold_the_pass)
{
    probe::reset();
    k_msgq_init(&lexxhard::imu_controller::msgq, storage, sizeof (lexxhard::imu_controller::msg), 8);

    refill();
    probe::refill = refill;

    lexxhard::zcan_imu::zcan_imu poller;
    poller.poll();
    probe::refill = nullptr;

    /* One message becomes two frames, acceleration and angular rate, so the budget shows up here
     * as twice itself. The assertion that matters is less the number than the fact that poll()
     * returned at all, which the frame ceiling inside send is what enforces. */
    zassert_equal(probe::sends, 2 * lexxhard::zcan_poll_budget::kTxPerPass);

    /* And it returned with work left over rather than by exhausting the queue -- the backlog is
     * carried to the next pass instead of being finished inside this one. */
    zassert_true(k_msgq_num_used_get(&lexxhard::imu_controller::msgq) > 0);
}
```
