/*
 * Copyright (c) 2026, LexxPluss Inc.
 * All rights reserved.
 *
 * SPDX-License-Identifier: BSD-2-Clause
 */

/*
 * The hardware random number generator, for the automatic-commissioning build ONLY.
 *
 * WHY IT IS HERE AND NOT IN THE BOARD DTS. Every other image -- the product firmware, the chain
 * build, the cliff build -- must come out byte for byte as it did before this existed. Enabling the
 * peripheral in lexxpluss_scb.dts would put the driver, its init entry and its clock configuration
 * into all of them for a feature none of them uses. This overlay is stacked on top of
 * tof_chain.overlay by one Makefile target and by nothing else.
 *
 * WHAT IT IS FOR. The commissioning session token, which must be unguessable and must differ across
 * adjacent boots: it is what tells a request from this boot from one that a finished boot's host is
 * still retransmitting. stm32f7.dtsi declares this node `disabled`, so without this file there is no
 * entropy device at all and the session layer refuses every request -- which is the correct failure
 * and is tested.
 */

&rng {
	status = "okay";
};

/*
 * The downlink's cadences, written down in the image that starts one.
 *
 * The two DEPLOYMENT DECISIONS are deliberately NOT here: commission-profile-enabled and
 * commission-enumeration-permitted are both absent, so this image comes up, draws a session token,
 * announces it and answers every request with `disabled`. It does not prove and it does not touch
 * the chain's enable lines.
 *
 * That is not a placeholder. One of them is a statement about where the board is deployed and the
 * other is permission to re-address sensors on a machine that nothing in this firmware can tell is
 * stationary. Adding either is a bench or a deployment act and belongs to whoever is making it, in
 * a diff of this file. The wiring below is what makes that act a one-line change rather than a
 * code change.
 *
 * The budgets stay at their defaulted zero for the same reason: a session that may not prove is the
 * correct state for an image nobody has said may.
 */
&tof_chain {
	commission-announce-period-ms = <1000>;
	commission-poll-ms = <20>;
};
