/*
 * Copyright (c) 2026, LexxPluss Inc.
 * SPDX-License-Identifier: BSD-2-Clause
 *
 * ToF chain enumeration glue (AMRSW-2322 Phase 2, ENABLE_TOF_CHAIN builds).
 *
 * The control-line roles are the ones measured on DS20001 and pending the
 * frozen J29 mapping document (Request C): SparePinGPIO1 (PI15) is the
 * enable data line, wired directly to chain position 1, SparePinGPIO2 (PJ1)
 * is the shared flip-flop clock.
 *
 * Both wait durations are DS20001 PROVISIONAL values, not product timing:
 * the data line settles over seconds at the register end (measured
 * behaviourally); the final numbers come from hardware documentation or a
 * scope (Request B).
 */

/ {
	tof_chain: tof_chain {
		compatible = "lexxpluss,tof-chain";
		data-gpios = <&gpioi 15 GPIO_ACTIVE_HIGH>;
		clock-gpios = <&gpioj 1 GPIO_ACTIVE_HIGH>;
		data-settle-ms = <2000>;
		sensor-boot-ms = <2000>;
		/* PROVISIONAL, and unresolved in the cliff wire contract. Stated
		 * here rather than defaulted in firmware so that the number is
		 * visible in a diff and has an owner. 20 Hz acquisition with a
		 * 5 Hz heartbeat is the shape the contract's timing section
		 * assumes; both must be replaced by approved values before
		 * release. */
		cycle-period-ms = <50>;
		health-period-ms = <200>;
		/* Also provisional. The join timeout has to cover a cycle (50 ms)
		 * plus one blocking sensor read, and 500 ms is a generous bound
		 * chosen to make a REFUSAL the outcome rather than a long wait;
		 * the stack is a guess until a watermark exists, and the priority
		 * is preemptible and below the shell so a stuck cycle cannot
		 * starve the console. */
		stop-join-timeout-ms = <500>;
		acq-stack-size = <2048>;
		acq-thread-priority = <7>;
		/* THE FOUR CLIFF SENSORS' RANGING PROFILE, and setting it changes
		 * how the robot ranges. Until now configure() was a no-op that
		 * reported success, so the parts ran on what VL53LX_DataInit left
		 * them: MEDIUM at 33333 us.
		 *
		 * 15000 is the budget the E3 rate experiment ran at, and the
		 * per-corner rate recorded for E3 belongs to that configuration.
		 * It is a historical measurement on a different image -- not a
		 * property of this one, and not a guarantee of any frequency.
		 * What a shorter budget costs in maximum distance, ambient-light
		 * behaviour and error rate has not been measured at this value on
		 * the installed harness.
		 *
		 * Read by an image that enables ENABLE_TOF_CLIFF_ULD. This overlay
		 * is shared with firmware_tof_chain, which does not -- that image
		 * carries the properties and reads neither. */
		cliff-timing-budget-us = <15000>;
		cliff-distance-mode = <2>;	/* MEDIUM */
		/* THE GRID PAIR'S RATE, and provisional in the strong sense: the
		 * sustainable rate has never been measured on this chain. 5 Hz is
		 * below the 20 Hz cycle on purpose -- most cycles then find nothing
		 * ready, which is the ordinary case and costs one non-blocking check.
		 * Read only by an image that enables ENABLE_TOF_L7_ULD. */
		grid-frequency-hz = <5>;
	};
};

/* 400 kHz is the only speed with a feasible read schedule; provisional until
 * Request B settles speed versus installed harness length.
 *
 * KNOWN, MEASURED, AND NOT FIXED BY THIS IMAGE: commissioning does not complete
 * at this bitrate on the machine it was measured on -- 0 of 69 walks reached
 * COMPLETE at 400 kHz, while 7 of 7 did at 100 kHz and it is sensor bring-up
 * that times out there instead. Each rate breaks the other half, and the cause
 * is still open (INC-L01-001): the 100 kHz A/B ruled out the shared clock-net
 * explanation without replacing it.
 *
 * So `tof enum` on an image built with this overlay is expected to fail, and
 * that is a property of the image rather than of the operator running it. The
 * resolution is a transactional retime inside the proof's commit -- walk at
 * 100 kHz, switch to 400 kHz, re-read identity per position, revoke on any
 * failure -- which is NOT in this change. Until it arrives, treat this target
 * as the acquisition-schedule image, not a commissioning tool.
 */
&i2c2 {
	clock-frequency = <I2C_BITRATE_FAST>;
};
