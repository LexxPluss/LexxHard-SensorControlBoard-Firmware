/*
 * Copyright (c) 2026, LexxPluss Inc.
 * All rights reserved.
 *
 * SPDX-License-Identifier: BSD-2-Clause
 */

/* Deployment permissions for the ToF release image, stacked after the chain and
 * commissioning overlays by cmake/features_tof_release.cmake. Every other image
 * keeps the permissions it has, which is none. */

&tof_chain {
	/* Accept commissioning requests instead of replying disabled. */
	commission-profile-enabled;

	/* The host must prevent motion and task start during re-addressing; neither
	 * side enforces this. Firmware cannot reject requests based on motion.
	 * Measurements remain gated until the new mapping is PROVEN. */
	commission-enumeration-permitted;

	/* Per-boot ceilings, shared across requests and host restarts, not automatic
	 * retries. The host latches one terminal transaction per run; retransmission
	 * does not repeat it. Three is a deployment limit, not measured recovery capacity. */
	commission-max-proof-attempts = <3>;
	commission-max-start-attempts = <3>;
};
