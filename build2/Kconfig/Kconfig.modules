## build2/Kconfig/Kconfig.modules
```kconfig
menu "CANopenNode (/workdir/LexxHard-SensorControlBoard-Firmware/modules/lib/canopennode)"
osource "$(ZEPHYR_CANOPENNODE_KCONFIG)"
config ZEPHYR_CANOPENNODE_MODULE
	bool
	default y
endmenu
menu "hal_nordic (/workdir/LexxHard-SensorControlBoard-Firmware/modules/hal/nordic)"
osource "$(ZEPHYR_HAL_NORDIC_KCONFIG)"
config ZEPHYR_HAL_NORDIC_MODULE
	bool
	default y
endmenu
menu "hal_nxp (/workdir/LexxHard-SensorControlBoard-Firmware/modules/hal/nxp)"
osource "$(ZEPHYR_HAL_NXP_KCONFIG)"
config ZEPHYR_HAL_NXP_MODULE
	bool
	default y
endmenu
menu "loramac-node (/workdir/LexxHard-SensorControlBoard-Firmware/modules/lib/loramac-node)"
osource "$(ZEPHYR_LORAMAC_NODE_KCONFIG)"
config ZEPHYR_LORAMAC_NODE_MODULE
	bool
	default y
endmenu
menu "lz4 (/workdir/LexxHard-SensorControlBoard-Firmware/modules/lib/lz4)"
osource "$(ZEPHYR_LZ4_KCONFIG)"
config ZEPHYR_LZ4_MODULE
	bool
	default y
endmenu
menu "mbedtls (/workdir/LexxHard-SensorControlBoard-Firmware/modules/crypto/mbedtls)"
osource "$(ZEPHYR_MBEDTLS_KCONFIG)"
config ZEPHYR_MBEDTLS_MODULE
	bool
	default y
endmenu
menu "nanopb (/workdir/LexxHard-SensorControlBoard-Firmware/modules/lib/nanopb)"
osource "$(ZEPHYR_NANOPB_KCONFIG)"
config ZEPHYR_NANOPB_MODULE
	bool
	default y
endmenu
menu "sof (/workdir/LexxHard-SensorControlBoard-Firmware/modules/audio/sof)"
osource "/workdir/LexxHard-SensorControlBoard-Firmware/modules/audio/sof/zephyr/Kconfig"
config ZEPHYR_SOF_MODULE
	bool
	default y
endmenu
menu "tflite-micro (/workdir/LexxHard-SensorControlBoard-Firmware/modules/lib/tflite-micro)"
osource "$(ZEPHYR_TFLITE_MICRO_KCONFIG)"
config ZEPHYR_TFLITE_MICRO_MODULE
	bool
	default y
endmenu
menu "TraceRecorder (/workdir/LexxHard-SensorControlBoard-Firmware/modules/debug/TraceRecorder)"
osource "/workdir/LexxHard-SensorControlBoard-Firmware/modules/debug/TraceRecorder/kernelports/Zephyr/Kconfig"
config ZEPHYR_TRACERECORDER_MODULE
	bool
	default y
endmenu
menu "extradrivers (/workdir/LexxHard-SensorControlBoard-Firmware/extra)"
osource "/workdir/LexxHard-SensorControlBoard-Firmware/extra/Kconfig"
config ZEPHYR_EXTRADRIVERS_MODULE
	bool
	default y
endmenu
```

## build2/Kconfig/Kconfig.shield
```kconfig
osource "/workdir/LexxHard-SensorControlBoard-Firmware/extra/boards/shields/*/Kconfig.shield"
```

## build2/Kconfig/Kconfig.shield.defconfig
```kconfig
osource "/workdir/LexxHard-SensorControlBoard-Firmware/extra/boards/shields/*/Kconfig.defconfig"
```

## extra/boards/arm/lexxpluss_scb/lexxpluss_scb_defconfig
```kconfig
# Copyright (c) 2024, LexxPluss Inc.
# All rights reserved.
# 
# Redistribution and use in source and binary forms, with or without
# modification, are permitted provided that the following conditions are met:
# 
# 1. Redistributions of source code must retain the above copyright notice,
#    this list of conditions and the following disclaimer.
# 2. Redistributions in binary form must reproduce the above copyright notice,
#    this list of conditions and the following disclaimer in the documentation
#    and/or other materials provided with the distribution.
# 
# THIS SOFTWARE IS PROVIDED BY THE COPYRIGHT HOLDERS AND CONTRIBUTORS "AS IS" AND
# ANY EXPRESS OR IMPLIED WARRANTIES, INCLUDING, BUT NOT LIMITED TO, THE IMPLIED
# WARRANTIES OF MERCHANTABILITY AND FITNESS FOR A PARTICULAR PURPOSE ARE
# DISCLAIMED. IN NO EVENT SHALL THE COPYRIGHT OWNER OR CONTRIBUTORS BE LIABLE FOR
# ANY DIRECT, INDIRECT, INCIDENTAL, SPECIAL, EXEMPLARY, OR CONSEQUENTIAL DAMAGES
# (INCLUDING, BUT NOT LIMITED TO, PROCUREMENT OF SUBSTITUTE GOODS OR SERVICES;
# LOSS OF USE, DATA, OR PROFITS; OR BUSINESS INTERRUPTION) HOWEVER CAUSED AND
# ON ANY THEORY OF LIABILITY, WHETHER IN CONTRACT, STRICT LIABILITY, OR TORT
# (INCLUDING NEGLIGENCE OR OTHERWISE) ARISING IN ANY WAY OUT OF THE USE OF THIS
# SOFTWARE, EVEN IF ADVISED OF THE POSSIBILITY OF SUCH DAMAGE.

CONFIG_SOC_SERIES_STM32F7X=y
CONFIG_SOC_STM32F769XX=y

CONFIG_ARM_MPU=y

CONFIG_HW_STACK_PROTECTION=y

CONFIG_SERIAL=y

CONFIG_CONSOLE=y
CONFIG_UART_CONSOLE=y

CONFIG_GPIO=y
CONFIG_SPI=y
CONFIG_ADC=y
CONFIG_PWM=y
CONFIG_CAN=y
CONFIG_I2C=y

CONFIG_CLOCK_CONTROL=y

CONFIG_LOG=y
CONFIG_LOG_RUNTIME_FILTERING=y

CONFIG_LED_STRIP=y
CONFIG_WS2812_STRIP=y
CONFIG_SENSOR=y

CONFIG_PINCTRL=y
```

## extra/drivers/sensor/Kconfig
```kconfig
rsource "maxbotix/Kconfig"
rsource "adis16470/Kconfig"
rsource "iim42652/Kconfig"
```

## extra/drivers/sensor/iim42652/Kconfig
```kconfig
# IIM42652 Six-Axis Motion Tracking device configuration options

# Copyright (c) 2020 TDK Invensense
# SPDX-License-Identifier: Apache-2.0

menuconfig IIM42652
	bool "IIM42652 Six-Axis Motion Tracking Device"
	depends on SPI
	help
	  Enable driver for IIM42652 SPI-based six-axis motion tracking device.

if IIM42652

choice
	prompt "Trigger mode"
	default IIM42652_TRIGGER_GLOBAL_THREAD
	help
	  Specify the type of triggering to be used by the driver.

config IIM42652_TRIGGER_NONE
	bool "No trigger"

config IIM42652_TRIGGER_GLOBAL_THREAD
	bool "Use global thread"
	depends on GPIO
	select IIM42652_TRIGGER

config IIM42652_TRIGGER_OWN_THREAD
	bool "Use own thread"
	depends on GPIO
	select IIM42652_TRIGGER


endchoice

config IIM42652_TRIGGER
	bool

config IIM42652_THREAD_PRIORITY
	int "Thread priority"
	depends on IIM42652_TRIGGER_OWN_THREAD
	default 10
	help
	  Priority of thread used by the driver to handle interrupts.

config IIM42652_THREAD_STACK_SIZE
	int "Thread stack size"
	depends on IIM42652_TRIGGER_OWN_THREAD
	default 1024
	help
	  Stack size of thread used by the driver to handle interrupts.

endif # IIM42652
```
